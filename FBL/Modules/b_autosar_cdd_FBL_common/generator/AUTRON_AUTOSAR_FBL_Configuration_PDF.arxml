AUTOSAR XML (schema 4-0-1)
# (C) 2019~2020 HYUNDAI AUTRON Co., Ltd.
# Confidential Proprietary Information. Distribution Limited.
# Do Not Copy Without Prior Permission
package /AUTRON
  ecuc definition collection ParameterDefinition_FBL: module=Fbl
  module definition Fbl: variants pre-compile  # Configuration of the FBL (Flash BootLoader) module.
    container FblGeneral
      enumeration FblSupportMcu: {FBL_MCU_TC38X, FBL_MCU_TC39X, FBL_MCU_SPC58X, FBL_MCU_RH850F1KM, FBL_MCU_CYTXXX, FBL_MCU_TC23X, FBL_MCU_TC29X, FBL_MCU_TC33X, FBL_MCU_TC36X, FBL_MCU_TC37X}, origin=AUTRON, default-value=FBL_MCU_TC38X  # Supporeted MCU by FBL
      enumeration FblSupportHsm: {FBL_HSM_NONE, FBL_HSM_AUTHSM_1_0, FBL_HSM_HAEHSM_2_0}, origin=AUTRON, default-value=FBL_HSM_NONE  # FBL_HSM_NONE : HSM is disabled FBL_HSM_AUTHSM_1_0 : Autron HSM 1.0 is enabled (only SPC58XX, RH850F1KM) FBL_HSM_HAEHSM_2_0 : Autoever HSM 2.0 is enabled
      boolean FblDevErrorDetect: set at pre-compile, origin=AUTRON  # Preprocessor switch to enable or disable the Development Error Detection (DET) mechanism.
      boolean FblSoftwareVersionCheck: set at pre-compile, origin=AUTRON  # Preprocessor switch to enable or disable the Version Check. When Version Check is enabled, downgrade version can not be flashed.
      container FblOta [0..1]
        boolean FblMemorySwapEnable [0..1]: origin=AUTRON, default-value=false  # Whether to support memory swap feature in FBL.
        boolean FblDecompressEnable [0..1]: origin=AUTRON, default-value=false  # Whether to use decompress freature.
        integer FblPartitionFlagAddress [0..1]  # Partition flag address to check RTSW validity when using memory swap function.
        integer FblPartitionFlagSize [0..1]  # Size of partiton flag.
        boolean FblOTAEnable [0..1]: origin=AUTRON, default-value=false  # Whether to use OTA freature.
        integer FblDecompressBufSize [0..1]  # Decompress buffer size
      choice container FblSupportMcuName
        container FblMcuSpc58x
          enumeration FblMcuName: {SPC582B50, SPC582B54, SPC582B60, SPC584B60, SPC584B64, SPC584B70, SPC584C70, SPC584C74, SPC584C80, SPC58EC70, SPC58EC74, SPC58EC80}
        container FblMcuCytxxx
          enumeration FblMcuName: {CYT2B7XX, CYT2B9XX, CYT2BLXX, CYT3BBXX, CYT4BBXX, CYT4BFXX}
    container FblPllConfig
      enumeration FblCpuClock: {FBL_CPU_80MHZ, FBL_CPU_160MHZ, FBL_CPU_200MHZ, FBL_CPU_300MHZ}, origin=AUTRON, default-value=FBL_CPU_200MHZ  # CPU frequency used by FBL. TC23X only supports 200 MHz. TC3XX only supports 300 MHz. SPC58X only supports 160 MHz.
      enumeration FblQuartzClock: {FBL_QUARTZ_8MHZ, FBL_QUARTZ_16MHZ, FBL_QUARTZ_20MHZ, FBL_QUARTZ_24MHZ, FBL_QUARTZ_32MHZ, FBL_QUARTZ_40MHZ}, origin=AUTRON, default-value=FBL_QUARTZ_20MHZ  # Quartz frequency used by FBL. TC23X supports 40 MHz. TC3XX supports 20 MHz or 40 MHz. SPC58X supports 16 MHz or 40 MHz.
      integer FblTimerPrescaler: origin=AUTRON, default-value=1  # Timer prescaler used by FBL. TC23X does not use this value. TC3XX does not use this value. SPC58X use this value.
      integer PllNDiv
      integer PllPDiv
      integer PllK2Div
      integer OscValue
      integer CLK_TRIM_ECO_WDTRIM: origin=AUTRON
      integer CLK_TRIM_ECO_ATRIM: origin=AUTRON
      integer CLK_TRIM_ECO_FTRIM: origin=AUTRON
      integer CLK_TRIM_ECO_RTRIM: origin=AUTRON
      integer CLK_TRIM_ECO_GTRIM: origin=AUTRON
      integer CLK_ECO_AGC_EN: 0..1, origin=AUTRON
    container FblFlashConfig
      integer FblMainSwEntryAddress1: 0..4294967295, origin=AUTRON, default-value=0  # Location of entry point 1 of Main SW
      integer FblMainSwEntryAddress2 [0..1]: 0..4294967295, origin=AUTRON, default-value=0  # Location of entry point 2 of Main SW
      integer FblFlashAlignment: 1.., origin=AUTRON, default-value=256  # Bytes for flash alignment.
      integer FblStartupCommandAddress: 0..4294967295, origin=AUTRON, default-value=0  # RAM address for Main SW to apply startup command
      integer FblCommonRamAddress: 0..4294967295, origin=AUTRON, default-value=0  # RAM address shared by Main SW and FBL
      integer FblEraseSectorNum: origin=AUTRON
      integer FblFlashEraseUnit: 1..4294967295, origin=AUTRON, default-value=0  # Bytes for flash erase max unit
    container FblSecurityConfig
      enumeration FblCrc16BlockSize: {FBL_CRC16_BLOCK_4096_BYTES, FBL_CRC16_BLOCK_2048_BYTES, FBL_CRC16_BLOCK_1024_BYTES, FBL_CRC16_BLOCK_512_BYTES, FBL_CRC16_BLOCK_256_BYTES, FBL_CRC16_BLOCK_128_BYTES}, origin=AUTRON, default-value=FBL_CRC16_BLOCK_4096_BYTES  # The block size in bytes for CRC16. CRC16BlockSize 4096 is OK, normally. But if external watchdog timeout is extremely short(shorter than 10ms), CRC16BlockSize have to be reduced.
      container FblSecurityAccess
        enumeration FblSecurityAccessLevel: {FBL_SA_SEEDKEY, FBL_SA_ADVANCED_SEEDKEY, FBL_SA_SECUREACCESS_1_0, FBL_SA_SECUREACCESS_2_0}, origin=AUTRON, default-value=FBL_SA_SEEDKEY  # Security level of security access FBL_SA_SEEDKEY : 4-byte based seedkey algorithm authentication FBL_SA_ADVANCED_SEEDKEY : 8-byte advanced seedkey algorithm authentication FBL_SA_SECUREACCESS_1_0 : Digital signature based authentication FBL_SA_SECUREACCESS_2_0 : Digital signature based authentication with CRL
        enumeration FblSecureAccessCertificateHashAlgorithm: {FBL_SA_HASH_SHA160, FBL_SA_HASH_SHA256}, origin=AUTRON, default-value=FBL_SA_HASH_SHA160  # Hash algorithm used by certificate of secure access FBL_SA_HASH_SHA160 : SHA160 algorithm implemented by HAE SW library FBL_SA_HASH_SHA256 : SHA256 algorithm implemented by HAE SW library
        integer FblSecurityNumAttDelay: 0..255, origin=AUTRON, default-value=3  # Number of failed security accesses after which the delay time is activated
        integer FblSecurityDelayTime: 0..20000, default-value=180  # Delay time after failed security access (in ms). This is started after FblSecurityNumAttDelay number of failed security accesses. | The AUTOSAR configuration standard is to use SI units, so this parameter is defined as integer value in seconds. FBL configuration tools must convert this integer value to the appropriate value format for the use in the software implementation of FBL. min: A negative value is not allowed. upperMultiplicity: Exactly one delay time must be specified per security level configuration. lowerMultiplicity: Exactly one delay time must be specified per security level configuration. origin: Standard AUTOSAR configuration parameter.
      container FblSecureFlash
        enumeration FblSecureFlashVersion: {FBL_SF_CRC, FBL_SF_VER_1_0, FBL_SF_VER_2_0}, origin=AUTRON, default-value=FBL_SF_CRC  # ES95489-52 Secure Flash Version.
        enumeration FblSecureFlashSignatureHashAlgorithm: {FBL_SF_HASH_SHA160, FBL_SF_HASH_SHA256}, origin=AUTRON, default-value=FBL_SF_HASH_SHA160  # Hash algorithm used by secure flash FBL_SF_HASH_SHA160 : SHA160 algorithm implemented by HAE SW library FBL_SF_HASH_SHA256 : SHA256 algorithm implemented by HAE SW library
        boolean FblRevisedSecureFlash_2_0 [0..1]: default-value=false  # Whether to apply revised secure flash 2.0
        boolean FblWriteSignature [0..1]: default-value=false  # Whether to write the signature on flash memory
        boolean FblWriteSignatureDelimiter [0..1]: default-value=false  # Whether to write the signature delimiter on flash memory Precondition : FblWriteSignature must be set.
    container FblDiagConfig
      boolean FblDiagResponseBeforeResetEnable: origin=AUTRON, default-value=true  # Whether to respond before reset
      boolean FblDiagResponseBeforeSessionChangeEnable: origin=AUTRON, default-value=true  # Whether to respond before session change
      integer FblDiagMaxNumResponsePending: 0..255, origin=AUTRON, default-value=25  # Maximum number of pending diagnostic response messages. Recommended value - TC38X : 25 - TC39X : 35
      enumeration FblSupportDiagnosticStandard: {FBL_ES95486_00, FBL_ES95486_02}, origin=AUTRON, default-value=FBL_ES95486_00  # Diagnostic Specifications Supported by FBL.
      enumeration FblDiagSignatureTxMode: {FBL_TXDATA, FBL_REQDOWNLOAD}, origin=AUTRON, default-value=FBL_TXDATA  # Select Signature receive mode.
      integer FblDiagMaxNumSignArea: 0..128, origin=AUTRON, default-value=16  # Maximum number of Signing Area. Recommended value - 8
      integer FblDiagEraseRID: 0..65535, origin=AUTRON, default-value=65280  # RoutineControl Erase RID
      integer FblDiagChkProgDepRID: 0..65535, origin=AUTRON, default-value=65281  # RoutineControl CheckProgrammingDependancy RID
      integer FblDiagOTAReadyRID: 0..65535, origin=AUTRON, default-value=768  # RoutineControl OTAReady RID
      boolean FblDiagTransferDataChunkMode: origin=AUTRON, default-value=false  # Write chunk data to flash while receiving block data
      integer FblDiagMaxNumOfBlockLength: 0..65535, origin=AUTRON, default-value=2050  # This parameter is used by the requestDownload positive response message to inform the client how many data bytes (maxNumberOfBlockLength) shall be included in each TransferData request message from the client. This length reflects the complete message length, including the service identifier and the data parameters present in the TransferData request message. This parameter allows the client to adapt to the receive buffer size of the server before it starts transferring data to the server.
    container FblWatchdogConfig
      boolean FblIntWdgEnable: origin=AUTRON, default-value=true  # Whether to use internal watchdog
      integer FblIntWdgTimeoutMs: 0..4294967295, origin=AUTRON, default-value=100  # Timeout value in milliseconds for internal watchdog
    container ModuleInformation
      container SwModule [0..*]
        integer SwModuleIndex: 0..255, origin=AUTRON, default-value=0  # SW module index. FBL should have index 0. Main SW should have index 1 and is subject to reprogramming. Index must increase sequentially.
        integer StartAddress: 0..4294967295, origin=AUTRON, default-value=0  # The start address of the SW module.
        integer EndAddress: 0..4294967295, origin=AUTRON, default-value=0  # The end address of the SW module.
        integer ModuleInfoAddress: 0..4294967295, origin=AUTRON, default-value=0  # The address of the SW module information.
        integer SpecialDataAddress: 0..4294967295, origin=AUTRON, default-value=0  # The special data address of the SW module. In the case of FBL, this address points to shared information. In the case of the Main SW, this address points to the security key information. Otherwise, do not use.
        integer CrcInfoAddress: 0..4294967295, origin=AUTRON, default-value=0  # The adress that points to the CRC information of the sw module
        integer SignatureAddress: 0..4294967295, origin=AUTRON, default-value=0  # The address of the signature information.
        integer FblECUSoftwareUNIT [0..1]: origin=AUTRON, default-value=0  # ECUSoftwareUNIT’s area
        integer BlkHeaderAddress: 0..4294967295, origin=AUTRON, default-value=0  # The address of the rom block header
        integer BlkTrailerAddress: 0..4294967295, origin=AUTRON, default-value=0  # The address of the rom block trailer
        container SwMemoryBlockArea [0..*]
          integer SwBlockIndex: 0..255, origin=AUTRON, default-value=0  # SW module index. FBL should have index 0. Main SW should have index 1 and is subject to reprogramming. Index must increase sequentially.
          integer StartAddress: 0..4294967295, origin=AUTRON, default-value=0  # The start address of the SW module.
          integer EndAddress: 0..4294967295, origin=AUTRON, default-value=0  # The end address of the SW module.
      container SwVersionInfo [0..1]
        integer CustomerId: 0..255, origin=AUTRON, default-value=0  # CC: Customer ID (1 byte)
        integer ProductId: 0..255, origin=AUTRON, default-value=0  # AA: Product ID (1 byte)
        integer ProductVariant: 0..255, origin=AUTRON, default-value=0  # V_: Product variant (high digit only) from 0:(0x00) to F:(0xF0)
        integer SwVersion: 0..255, origin=AUTRON, default-value=1  # VV: SW version (1 byte)
        integer IntSwVersion: 0..255, origin=AUTRON, default-value=0  # ZZ: Intermidiate SW version (1 byte)
        integer Synchro1: 0..255, origin=AUTRON, default-value=0  # E_: Synchro byte 1 (1 byte)
        integer Synchro2: 0..255, origin=AUTRON, default-value=0  # _E: Synchro byte 2 (1 byte)
        string BuildDate: origin=AUTRON  # Build date represented using hyphen separators in hexadecimal format. ex) 2019-01-31
    container FblCommConfig
      container FblEthernetConfig [0..1]
        integer FblReceivedDataBufferSize: 0..65535, origin=AUTRON, default-value=8191  # Number of bytes of data to be received per request download
        integer FblProgramDataBufferSize: 0..65535, origin=AUTRON, default-value=256  # Number of bytes of data to be programmed per request download
        integer FblEthDiagProtocolVersion: 0..65535, origin=AUTRON, default-value=204
        container FblEcuIpAddress
          string FblEcuIpAddressFixed: origin=AUTRON  # IP address of ECU. Represented using dot separators in decimal format. If the value is set then the FblEcuIpAddressRef setting is ignored
          reference FblEcuIpAddressRef [0..1]: origin=AUTRON, destination=TcpIpStaticIpAddressConfig  # Use the value of the TcpIpStaticIpAddress parameter of the referenced container
        container FblEcuMacAddress
          string FblEcuMacAddressFixed: origin=AUTRON  # MAC address of ECU. Represented using hyphen or colon separators in hexadecimal format. If the value is set then the FblEcuMacAddressRef setting is ignored
          reference FblEcuMacAddressRef [0..1]: origin=AUTRON, destination=EthCtrlConfig  # Use the value of the EthCtrlPhyAddress parameter of the referenced container
        container FblEcuTcpPort
          integer FblEcuTcpPortFixed: 0..65535, origin=AUTRON, default-value=0  # TCP port for Ethernet Reprogramming Tool. If the value is set then the FblEcuTcpPortRef setting is ignored
          reference FblEcuTcpPortRef [0..1]: origin=AUTRON, destination=SoAdSocketConnectionGroup  # Use the value of the SoAdSocketLocalPort parameter of the referenced container
        container FblEthDiagLocalAddress
          integer FblEcuPhysicalLocalAddressForRequestFixed: 0..65535, category=FIXED, origin=AUTRON, default-value=0  # ECU Physical local address for request. If the value is set then the FblEcuPhysicalLocalAddressForRequestRef setting is ignored
          integer FblEcuPhysicalLocalAddressForResponseFixed: 0..65535, category=FIXED, origin=AUTRON, default-value=0  # ECU Physical local address for response. If the value is set then the FblEcuPhysicalLocalAddressForResponseRef setting is ignored
          integer FblEcuFunctionalLocalAddressFixed: 0..65535, category=FIXED, origin=AUTRON, default-value=0  # ECU Functional local address. If the value is set then the FblEcuFunctionalLocalAddressRef setting is ignored
          integer FblTesterPhysicalLocalAddressFixed: 0..65535, origin=AUTRON, default-value=0  # Tester Physical local address. If the value is set then the FblTesterPhysicalLocalAddressRef setting is ignored
          integer FblRemotePhysicalLocalAddressFixed: 0..65535, origin=AUTRON, default-value=0  # Remote Physical local address. If the value is set then the FblRemotePhysicalLocalAddressRef setting is ignored
          reference FblEcuPhysicalLocalAddressForRequestRef [0..1]: category=FIXED, origin=AUTRON, destination=EthDiagReprogramRxNSdu  # Use the value of the EthDiagLocalAddress parameter of the referenced container
          reference FblEcuPhysicalLocalAddressForResponseRef [0..1]: category=FIXED, origin=AUTRON, destination=EthDiagReprogramTxNSdu  # Use the value of the EthDiagLocalAddress parameter of the referenced container
          reference FblEcuFunctionalLocalAddressRef [0..1]: category=FIXED, origin=AUTRON, destination=EthDiagReprogramRxNSdu  # Use the value of the EthDiagLocalAddress parameter of the referenced container
          reference FblTesterPhysicalLocalAddressRef [0..1]: origin=AUTRON, destination=EthDiagReprogramRxNSdu  # Use the value of the EthDiagRemoteAddress parameter of the referenced container
        container FblVlan
          boolean FblVlanEnable: category=FIXED, origin=AUTRON, default-value=false  # Whether to use VLAN feature
          integer FblVlanIdFixed: 0..65535, category=FIXED, origin=AUTRON, default-value=0  # VLAN ID value. If the value is set then the FblVlanIdRef setting is ignored
          reference FblVlanIdRef [0..1]: category=FIXED, origin=AUTRON, destination=EthIfController  # Use the value of the EthIfVlanId parameter of the referenced container
        container FblEthType
          enumeration FblEthType: {FBL_ETH_TRANCEIVER, FBL_ETH_SWITCH}, origin=AUTRON
          enumeration FblEthSpeed: {FBL_ETH_SPEED_1000M, FBL_ETH_SPEED_100M}, origin=AUTRON
          integer CCUCON{0..2}: origin=AUTRON
          integer CCUCON5: origin=AUTRON
          integer SCU_SYSPLLCON0_NDIV: origin=AUTRON
          integer SCU_SYSPLLCON0_PDIV: origin=AUTRON
          integer SCU_SYSPLLCON1_K2DIV: origin=AUTRON
          integer SCU_PERPLLCON0_DIVBY: origin=AUTRON
          integer SCU_PERPLLCON0_NDIV: origin=AUTRON
          integer ETH_BMCR_DATA: origin=AUTRON
      container FblCanConfig [0..1]
        integer FblReceivedDataBufferSize: 0..65535, origin=AUTRON, default-value=8191  # Number of bytes of data to be received per request download
        integer FblProgramDataBufferSize: 0..65535, origin=AUTRON, default-value=256  # Number of bytes of data to be programmed per request download
        enumeration FblCanType: {FBL_CAN_CLASSIC, FBL_CAN_FD}, origin=AUTRON, default-value=FBL_CAN_11BIT_ID
        choice container FblCanDrvConfig
          container FblCanDrvTc2xx
            enumeration FblCanCell: {FBL_CAN0, FBL_CAN1, FBL_CAN2}, category=FIXED, origin=AUTRON
            enumeration FblCanNode: {FBL_CAN_NODE0, FBL_CAN_NODE1, FBL_CAN_NODE2, FBL_CAN_NODE3}, category=FIXED, origin=AUTRON
            enumeration FblCanRXD: {FBL_CAN_RXDA, FBL_CAN_RXDB, FBL_CAN_RXDC, FBL_CAN_RXDD, FBL_CAN_RXDE, FBL_CAN_RXDF, FBL_CAN_RXDG, FBL_CAN_RXDH}, category=FIXED, origin=AUTRON
          container FblCanDrvTc3xx
            enumeration FblCanCell: {FBL_CAN0, FBL_CAN1, FBL_CAN2}, origin=AUTRON
            enumeration FblCanNode: {FBL_CAN_NODE0, FBL_CAN_NODE1, FBL_CAN_NODE2, FBL_CAN_NODE3}, origin=AUTRON
            enumeration FblCanRXD: {FBL_CAN_RXDA, FBL_CAN_RXDB, FBL_CAN_RXDC, FBL_CAN_RXDD, FBL_CAN_RXDE, FBL_CAN_RXDF, FBL_CAN_RXDG, FBL_CAN_RXDH}, origin=AUTRON
          container FblCanDrvSpc58x
            enumeration FblCanCell: {FBL_CAN0, FBL_CAN1, FBL_CAN2, FBL_CAN3, FBL_CAN4, FBL_CAN5, FBL_CAN6, FBL_CAN7}, origin=AUTRON
            integer FblCanClockDivider: 0..255, origin=AUTRON, default-value=1  # Specifies propagation delay in time quantas.
            enumeration FblProtocolClockSelection: {FBL_XOSC, FBL_PLL}, origin=AUTRON
            enumeration FblCanRxPort: {SPC58_CAN0_PE6, SPC58_CAN0_PD15, SPC58_CAN0_PK3, SPC58_CAN0_PC7, SPC58_CAN0_PM8, SPC58_CAN0_PG14, SPC58_CAN1_PB9, SPC58_CAN1_PA13, SPC58_CAN1_PD4, SPC58_CAN1_PL0, SPC58_CAN1_PL3, SPC58_CAN1_PA11, SPC58_CAN2_PC8, SPC58_CAN2_PA11, SPC58_CAN2_PA1, SPC58_CAN2_PH9, SPC58_CAN2_PA13, SPC58_CAN3_PD4, SPC58_CAN3_PI2, SPC58_CAN3_PI9, SPC58_CAN3_PE0, SPC58_CAN3_PJ0, SPC58_CAN3_PH1, SPC58_CAN4_PA11, SPC58_CAN4_PM14, SPC58_CAN4_PC12, SPC58_CAN4_PL6, SPC58_CAN4_PF6, SPC58_CAN4_PH12, SPC58_CAN5_PE11, SPC58_CAN5_PE9, SPC58_CAN5_PL4, SPC58_CAN5_PC7, SPC58_CAN5_PB8, SPC58_CAN5_PD7, SPC58_CAN5_PJ15, SPC58_CAN5_PL2, SPC58_CAN6_PC3, SPC58_CAN6_PF2, SPC58_CAN6_PL6, SPC58_CAN6_PF1, SPC58_CAN6_PJ13, SPC58_CAN6_PC14, SPC58_CAN6_PM2, SPC58_CAN6_PC5, SPC58_CAN6_PA14, SPC58_CAN7_PE11, SPC58_CAN7_PG4, SPC58_CAN7_PK13, SPC58_CAN7_PC0, SPC58_CAN7_PB9, SPC58_CAN7_PF9, SPC58_CAN7_PD1, SPC58_CAN7_PM3, SPC58_CAN7_PI14, SPC58_CAN7_PA8}, origin=AUTRON
            enumeration FblCanTxPort: {SPC58_CAN0_PC6, SPC58_CAN0_PD14, SPC58_CAN0_PE5, SPC58_CAN0_PK2, SPC58_CAN0_PM7, SPC58_CAN1_PA10, SPC58_CAN1_PA12, SPC58_CAN1_PB10, SPC58_CAN1_PE7, SPC58_CAN1_PL1, SPC58_CAN1_PL4, SPC58_CAN2_PA10, SPC58_CAN2_PA2, SPC58_CAN2_PC9, SPC58_CAN2_PH7, SPC58_CAN3_PC0, SPC58_CAN3_PE7, SPC58_CAN3_PF15, SPC58_CAN3_PG0, SPC58_CAN3_PH0, SPC58_CAN3_PI1, SPC58_CAN3_PJ1, SPC58_CAN4_PA10, SPC58_CAN4_PA4, SPC58_CAN4_PC13, SPC58_CAN4_PF7, SPC58_CAN4_PH13, SPC58_CAN4_PL7, SPC58_CAN5_PA3, SPC58_CAN5_PC6, SPC58_CAN5_PD5, SPC58_CAN5_PE10, SPC58_CAN5_PE8, SPC58_CAN5_PF13, SPC58_CAN5_PJ14, SPC58_CAN5_PL4, SPC58_CAN5_PL5, SPC58_CAN6_PC13, SPC58_CAN6_PC4, SPC58_CAN6_PF0, SPC58_CAN6_PF3, SPC58_CAN6_PJ12, SPC58_CAN6_PL6, SPC58_CAN6_PM0, SPC58_CAN7_PB8, SPC58_CAN7_PD0, SPC58_CAN7_PE0, SPC58_CAN7_PE10, SPC58_CAN7_PF10, SPC58_CAN7_PG3, SPC58_CAN7_PK12, SPC58_CAN7_PM1}, origin=AUTRON
          container FblCanDrvRh850f1km
            enumeration FblCanCell: {FBL_CAN0, FBL_CAN1, FBL_CAN2, FBL_CAN3, FBL_CAN4, FBL_CAN5, FBL_CAN6, FBL_CAN7}, category=FIXED, origin=AUTRON
            enumeration FblProtocolClockSelection: {FBL_XOSC, FBL_PLL}, category=FIXED, origin=AUTRON
            enumeration FblCanRxPort: {CAN0_P0_1, CAN0_P10_0, CAN1_P0_2, CAN1_P10_6, CAN2_P0_5, CAN2_P11_15, CAN3_P1_2, CAN3_P0_7, CAN3_P11_3, CAN4_P1_12, CAN4_P0_9, CAN4_P20_2, CAN5_P0_13, CAN5_P11_5, CAN6_P2_0, CAN6_P8_0, CAN6_P10_5, CAN6_P20_0, CAN7_P1_14, CAN7_P8_4, CAN7_P10_14, CAN7_P20_4}, category=FIXED, origin=AUTRON
            enumeration FblCanTxPort: {CAN0_P0_0, CAN0_P10_1, CAN1_P0_3, CAN1_P10_7, CAN2_P0_4, CAN2_P12_0, CAN3_P1_3, CAN3_P0_8, CAN3_P11_4, CAN4_P1_13, CAN4_P0_10, CAN4_P20_3, CAN5_P0_14, CAN5_P11_6, CAN6_P2_1, CAN6_P8_1, CAN6_P10_4, CAN6_P20_1, CAN7_P1_15, CAN7_P8_3, CAN7_P10_13, CAN7_P20_5}, category=FIXED, origin=AUTRON
            integer FblCanClockDivider: 0..255, origin=AUTRON, default-value=1  # Specifies propagation delay in time quantas.
          container FblCanDrvCytxxx
            enumeration FblCanCell: {FBL_CAN0, FBL_CAN1}, origin=AUTRON
            enumeration FblCanNode: {FBL_CAN_NODE0, FBL_CAN_NODE1, FBL_CAN_NODE2, FBL_CAN_NODE3, FBL_CAN_NODE4}, origin=AUTRON
            enumeration FblCanRxPort: {P2_1_CAN0_0_RX, P8_1_CAN0_0_RX, P0_3_CAN0_1_RX, P4_4_CAN0_1_RX, P6_3_CAN0_2_RX, P12_1_CAN0_2_RX, P3_1_CAN0_3_RX, P14_1_CAN1_0_RX, P23_1_CAN1_0_RX, P17_1_CAN1_1_RX, P22_1_CAN1_1_RX, P18_7_CAN1_2_RX, P20_4_CAN1_2_RX, P15_1_CAN1_3_RX, P19_1_CAN1_3_RX, P3_7_CAN1_2_RX, P12_5_CAN1_1_RX, P30_3_CAN1_3_RX, P7_4_CAN0_4_RX, P20_7_CAN1_4_RX, P32_7_CAN1_4_RX}, origin=AUTRON
            enumeration FblCanTxPort: {P2_0_CAN0_0_TX, P8_0_CAN0_0_TX, P0_2_CAN0_1_TX, P4_3_CAN0_1_TX, P6_2_CAN0_2_TX, P12_0_CAN0_2_TX, P3_0_CAN0_3_TX, P14_0_CAN1_0_TX, P23_0_CAN1_0_TX, P17_0_CAN1_1_TX, P22_0_CAN1_1_TX, P18_6_CAN1_2_TX, P23_0_CAN1_2_TX, P15_0_CAN1_3_TX, P19_0_CAN1_3_TX, P3_6_CAN1_2_TX, P12_4_CAN1_1_TX, P21_5_CAN1_1_TX, P30_2_CAN1_3_TX, P7_3_CAN0_4_TX, P20_6_CAN1_4_TX, P32_6_CAN1_4_TX}, origin=AUTRON
        container FblCanDiagMessageConfig
          container FblCanDiagMsgPhysReqConfig
            enumeration FblCanDiagMsgPhysReqAddrFormat: {FBL_CAN_ADDR_STANDARD, FBL_CAN_ADDR_EXTENDED}, category=FIXED, origin=AUTRON, default-value=FBL_CAN_ADDR_STANDARD  # Declares which communication addressing mode is supported
            integer FblCanDiagMsgPhysReqId: 0..536870911, origin=AUTRON  # CAN Identifier of Receive CAN L-PDUs used by the CAN Interface for diagonostic physical message.
            integer FblCanDiagMsgPhysReqSTmin: 0..255, origin=AUTRON, default-value=0  # Sets the duration of the minimum time the CanTp sender shall wait between the transmissions of two CF N-PDUs.
          container FblCanDiagMsgPhysResConfig
            enumeration FblCanDiagMsgPhysResAddrFormat: {FBL_CAN_ADDR_STANDARD, FBL_CAN_ADDR_EXTENDED}, category=FIXED, origin=AUTRON, default-value=FBL_CAN_ADDR_STANDARD  # Declares which communication addressing mode is supported
            integer FblCanDiagMsgPhysResId: 0..536870911, origin=AUTRON  # CAN Identifier of transmit CAN L-PDUs used by the CAN Driver for CAN L-PDU transmission for diagonostic physical message.
          container FblCanDiagMsgFuncConfig
            enumeration FblCanDiagMsgFuncAddrFormat: {FBL_CAN_ADDR_STANDARD, FBL_CAN_ADDR_EXTENDED}, category=FIXED, origin=AUTRON, default-value=FBL_CAN_ADDR_STANDARD  # Declares which communication addressing mode is supported
            integer FblCanDiagMsgFuncId: 0..536870911, origin=AUTRON, default-value=2015  # CAN Identifier of Receive CAN L-PDUs used by the CAN Interface for diagonostic functional message.
        container FblCanBaudRateConfig
          enumeration FblCanBaudRate: {FBL_CAN_100KBPS, FBL_CAN_250KBPS, FBL_CAN_500KBPS}, origin=AUTRON, default-value=FBL_CAN_500KBPS
          integer FblCanPropSeg: 0..255, origin=AUTRON, default-value=47  # Specifies propagation delay in time quantas.
          integer FblCanSeg1: 1..255, origin=AUTRON, default-value=16  # Specifies phase segment 1 in time quantas.
          integer FblCanSeg2: 0..128, origin=AUTRON, default-value=16  # Specifies phase segment 2 in time quantas.
          integer FblCanSyncJumpWith: 1..128, origin=AUTRON, default-value=4  # Specifies the synchronization jump width for the controller in time quantas.
          integer FblCanPrescaler: 1..512, origin=AUTRON, default-value=1  # Specifies The value by which the oscillator frequency is divided for generating the bit time quanta.
          container FblCanFdBaudRateConfig [0..1]
            enumeration FblCanFdBaudRate: {FBL_CAN_1MBPS, FBL_CAN_2MBPS}, origin=AUTRON, default-value=FBL_CAN_2MBPS
            integer FblCanFdPropSeg: 0..31, origin=AUTRON, default-value=1  # Specifies propagation delay in time quantas.
            integer FblCanFdSeg1: 0..32, origin=AUTRON, default-value=2  # Specifies phase segment 1 in time quantas.
            integer FblCanFdSeg2: 0..16, origin=AUTRON, default-value=1  # Specifies phase segment 2 in time quantas.
            integer FblCanFdSyncJumpWith: 0..16, origin=AUTRON, default-value=1  # Specifies the synchronization jump width for the controller in time quantas.
            integer FblCanFdTrcvDelayCompensationOffset [0..1]: 0..65535, origin=AUTRON, default-value=1  # Specifies propagation delay in time quantas.
            boolean FblCanFdTxBitRateSwitch: origin=AUTRON, default-value=true
            integer FblCanFdPrescaler: 1..32, origin=AUTRON, default-value=1  # Specifies The value by which the oscillator frequency is divided for generating the bit time quanta.
        choice container FblCanTrcvConfig
          container FblCanTrcvSpc58x
            integer FblCanTrcvEnablePinPad: category=FIXED
            integer FblCanTrcvEnablePinValue: category=FIXED, default-value=0  # Specifies can transceiver enable pin value.
            integer FblCanTrcvErrorPinPad: category=FIXED
            integer FblCanTrcvStandbyPinPad: category=FIXED
            integer FblCanTrcvStandbyPinValue: category=FIXED, default-value=0  # Specifies can transceiver standby pin value
          container FblCanTrcvRh850f1km
            string FblCanTrcvErrorPinSetToInput
            string FblCanTrcvEnablePinWriteDirect
            string FblCanTrcvEnablePinSetToOutput
            string FblCanTrcvStandbyPinWriteDirect
            string FblCanTrcvStandbyPinSetToOutput
          container FblCanTrcvCytxxx
      choice container FblSpiConfig
        container FblSpiSpc58x
          integer FblSpiChannel: 0..7, origin=AUTRON  # SPI_Channel
          boolean FblSpiLsbUse
          boolean FblSpiUseLeadingEdge
          enumeration FblSpiPBR: {PBR_2, PBR_3, PBR_5, PBR_7}
          enumeration FblSpiBR: {BR_2, BR_4, BR_6, BR_8, BR_16, BR_32, BR_64, BR_128, BR_256, BR_512, BR_1024, BR_2048, BR_4096, BR_8192, BR_16384, BR_32768}
          enumeration FblSpiSoutPort: {SPC58_DSPI0_PD5, SPC58_DSPI0_PD11, SPC58_DSPI0_PE9, SPC58_DSPI0_PG12, SPC58_DSPI0_PJ11, SPC58_DSPI0_PK13, SPC58_DSPI1_PC12, SPC58_DSPI1_PC13, SPC58_DSPI1_PC15, SPC58_DSPI1_PD7, SPC58_DSPI1_PF13, SPC58_DSPI1_PF2, SPC58_DSPI1_PH7, SPC58_DSPI1_PM2, SPC58_DSPI1_PM6, SPC58_DSPI2_PA0, SPC58_DSPI2_PA3, SPC58_DSPI2_PB10, SPC58_DSPI2_PB9, SPC58_DSPI2_PD0, SPC58_DSPI2_PD1, SPC58_DSPI2_PD8, SPC58_DSPI2_PG15, SPC58_DSPI2_PH0, SPC58_DSPI2_PH3, SPC58_DSPI2_PI12, SPC58_DSPI2_PJ13, SPC58_DSPI2_PM6, SPC58_DSPI2_PM9, SPC58_DSPI3_PC5, SPC58_DSPI3_PC6, SPC58_DSPI3_PD12, SPC58_DSPI3_PE10, SPC58_DSPI3_PE11, SPC58_DSPI3_PE2, SPC58_DSPI3_PF2, SPC58_DSPI3_PJ14, SPC58_DSPI3_PL5, SPC58_DSPI3_PL6, SPC58_DSPI4_PD12, SPC58_DSPI4_PD15, SPC58_DSPI4_PE2, SPC58_DSPI4_PF0, SPC58_DSPI4_PF1, SPC58_DSPI4_PG0, SPC58_DSPI4_PI8, SPC58_DSPI4_PK0, SPC58_DSPI5_PA3, SPC58_DSPI5_PB12, SPC58_DSPI5_PB13, SPC58_DSPI5_PD8, SPC58_DSPI5_PF10, SPC58_DSPI5_PF11, SPC58_DSPI5_PF9, SPC58_DSPI6_PA1, SPC58_DSPI6_PB4, SPC58_DSPI6_PD14, SPC58_DSPI6_PD15, SPC58_DSPI6_PE13, SPC58_DSPI6_PF0, SPC58_DSPI6_PF11, SPC58_DSPI6_PH1, SPC58_DSPI6_PH9, SPC58_DSPI7_PA0, SPC58_DSPI7_PA12, SPC58_DSPI7_PB2, SPC58_DSPI7_PB3, SPC58_DSPI7_PE8, SPC58_DSPI7_PH7, SPC58_DSPI7_PM12}
          enumeration FblSpiSinPort: {SPC58_DSPI0_PE9, SPC58_DSPI0_PD11, SPC58_DSPI0_PE15, SPC58_DSPI0_PD15, SPC58_DSPI0_PJ13, SPC58_DSPI0_PG12, SPC58_DSPI0_PD5, SPC58_DSPI0_PJ14, SPC58_DSPI0_PK13, SPC58_DSPI0_PJ11, SPC58_DSPI1_PC13, SPC58_DSPI1_PF13, SPC58_DSPI1_PC10, SPC58_DSPI1_PH14, SPC58_DSPI1_PH9, SPC58_DSPI1_PD7, SPC58_DSPI1_PC15, SPC58_DSPI1_PH7, SPC58_DSPI2_PB9, SPC58_DSPI2_PD8, SPC58_DSPI2_PM4, SPC58_DSPI2_PF0, SPC58_DSPI2_PA0, SPC58_DSPI2_PB10, SPC58_DSPI2_PH0, SPC58_DSPI2_PA3, SPC58_DSPI2_PG15, SPC58_DSPI2_PH8, SPC58_DSPI2_PH7, SPC58_DSPI3_PD12, SPC58_DSPI3_PE10, SPC58_DSPI3_PC3, SPC58_DSPI3_PH13, SPC58_DSPI3_PL5, SPC58_DSPI3_PE2, SPC58_DSPI3_PE11, SPC58_DSPI3_PC6, SPC58_DSPI3_PD14, SPC58_DSPI3_PC5, SPC58_DSPI3_PL6, SPC58_DSPI4_PF0, SPC58_DSPI4_PG1, SPC58_DSPI4_PI9, SPC58_DSPI4_PE2, SPC58_DSPI4_PI8, SPC58_DSPI4_PD12, SPC58_DSPI4_PF1, SPC58_DSPI4_PG0, SPC58_DSPI5_PF11, SPC58_DSPI5_PB12, SPC58_DSPI5_PN2, SPC58_DSPI5_PA3, SPC58_DSPI5_PF9, SPC58_DSPI5_PB13, SPC58_DSPI5_PF10, SPC58_DSPI5_PD14, SPC58_DSPI5_PD15, SPC58_DSPI5_PC6, SPC58_DSPI5_PD8, SPC58_DSPI6_PD15, SPC58_DSPI6_PB4, SPC58_DSPI6_PA0, SPC58_DSPI6_PD10, SPC58_DSPI6_PH1, SPC58_DSPI6_PD14, SPC58_DSPI6_PE13, SPC58_DSPI6_PF11, SPC58_DSPI7_PB3, SPC58_DSPI7_PH9, SPC58_DSPI7_PK5, SPC58_DSPI7_PE7, SPC58_DSPI7_PA0, SPC58_DSPI7_PB2, SPC58_DSPI7_PA12}
          enumeration FblSpiSckPort: {SPC58_DSPI0_PD4, SPC58_DSPI0_PG11, SPC58_DSPI0_PJ12, SPC58_DSPI0_PJ15, SPC58_DSPI0_PL2, SPC58_DSPI1_PC14, SPC58_DSPI1_PD6, SPC58_DSPI1_PH8, SPC58_DSPI1_PH13, SPC58_DSPI1_PM0, SPC58_DSPI1_PM4, SPC58_DSPI1_PM5, SPC58_DSPI2_PA13, SPC58_DSPI2_PB8, SPC58_DSPI2_PD0, SPC58_DSPI2_PH0, SPC58_DSPI2_PH1, SPC58_DSPI2_PI10, SPC58_DSPI2_PI12, SPC58_DSPI3_PA11, SPC58_DSPI3_PC4, SPC58_DSPI3_PD13, SPC58_DSPI3_PH12, SPC58_DSPI3_PL7, SPC58_DSPI4_PD9, SPC58_DSPI4_PD13, SPC58_DSPI4_PI9, SPC58_DSPI4_PK1, SPC58_DSPI4_PN0, SPC58_DSPI5_PB5, SPC58_DSPI5_PB8, SPC58_DSPI5_PF9, SPC58_DSPI5_PF10, SPC58_DSPI5_PF12, SPC58_DSPI5_PN1, SPC58_DSPI6_PA13, SPC58_DSPI6_PC9, SPC58_DSPI6_PD9, SPC58_DSPI6_PE14, SPC58_DSPI6_PH0, SPC58_DSPI7_PA13, SPC58_DSPI7_PB1, SPC58_DSPI7_PD4, SPC58_DSPI7_PH8, SPC58_DSPI7_PK3}
          enumeration FblSpiCs0Port: {SPC58_DSPI0_PB11, SPC58_DSPI0_PC3, SPC58_DSPI0_PC5, SPC58_DSPI0_PC12, SPC58_DSPI0_PD12, SPC58_DSPI0_PE5, SPC58_DSPI0_PE6, SPC58_DSPI0_PE7, SPC58_DSPI0_PE8, SPC58_DSPI0_PE12, SPC58_DSPI0_PF0, SPC58_DSPI0_PF15, SPC58_DSPI0_PG13, SPC58_DSPI0_PJ9, SPC58_DSPI0_PK12, SPC58_DSPI0_PL3, SPC58_DSPI0_PL4, SPC58_DSPI0_PL5, SPC58_DSPI0_PL6, SPC58_DSPI0_PL7, SPC58_DSPI1_PA4, SPC58_DSPI1_PB9, SPC58_DSPI1_PC10, SPC58_DSPI1_PC11, SPC58_DSPI1_PC12, SPC58_DSPI1_PE5, SPC58_DSPI1_PE6, SPC58_DSPI1_PE8, SPC58_DSPI1_PE12, SPC58_DSPI1_PF0, SPC58_DSPI1_PF2, SPC58_DSPI1_PF3, SPC58_DSPI1_PH14, SPC58_DSPI1_PK14, SPC58_DSPI1_PM1, SPC58_DSPI1_PM5, SPC58_DSPI1_PM7, SPC58_DSPI2_PA3, SPC58_DSPI2_PA12, SPC58_DSPI2_PB0, SPC58_DSPI2_PB9, SPC58_DSPI2_PB10, SPC58_DSPI2_PB11, SPC58_DSPI2_PD9, SPC58_DSPI2_PD10, SPC58_DSPI2_PE7, SPC58_DSPI2_PE10, SPC58_DSPI2_PF0, SPC58_DSPI2_PF1, SPC58_DSPI2_PF15, SPC58_DSPI2_PG13, SPC58_DSPI2_PH2, SPC58_DSPI2_PH4, SPC58_DSPI2_PH10, SPC58_DSPI2_PI1, SPC58_DSPI2_PI2, SPC58_DSPI2_PI10, SPC58_DSPI2_PI11, SPC58_DSPI2_PJ1, SPC58_DSPI2_PJ3, SPC58_DSPI2_PL15, SPC58_DSPI3_PA0, SPC58_DSPI3_PA10, SPC58_DSPI3_PA14, SPC58_DSPI3_PC0, SPC58_DSPI3_PC1, SPC58_DSPI3_PC3, SPC58_DSPI3_PC7, SPC58_DSPI3_PC8, SPC58_DSPI3_PC9, SPC58_DSPI3_PC12, SPC58_DSPI3_PD13, SPC58_DSPI3_PD14, SPC58_DSPI3_PD15, SPC58_DSPI3_PE0, SPC58_DSPI3_PE1, SPC58_DSPI3_PE2, SPC58_DSPI3_PE3, SPC58_DSPI3_PE4, SPC58_DSPI3_PF3, SPC58_DSPI3_PF13, SPC58_DSPI3_PG13, SPC58_DSPI3_PH4, SPC58_DSPI3_PH12, SPC58_DSPI3_PH14, SPC58_DSPI3_PJ13, SPC58_DSPI3_PJ14, SPC58_DSPI3_PL3, SPC58_DSPI3_PL4, SPC58_DSPI4_PA13, SPC58_DSPI4_PC0, SPC58_DSPI4_PC1, SPC58_DSPI4_PC3, SPC58_DSPI4_PE0, SPC58_DSPI4_PE1, SPC58_DSPI4_PE3, SPC58_DSPI4_PE4, SPC58_DSPI4_PE12, SPC58_DSPI4_PF6, SPC58_DSPI4_PF7, SPC58_DSPI4_PG2, SPC58_DSPI4_PG15, SPC58_DSPI4_PH7, SPC58_DSPI4_PH8, SPC58_DSPI4_PH9, SPC58_DSPI4_PJ4, SPC58_DSPI4_PK5, SPC58_DSPI4_PL0, SPC58_DSPI4_PM11, SPC58_DSPI4_PM12, SPC58_DSPI4_PM15, SPC58_DSPI4_PN0, SPC58_DSPI4_PN1, SPC58_DSPI5_PB3, SPC58_DSPI5_PB9, SPC58_DSPI5_PB10, SPC58_DSPI5_PD10, SPC58_DSPI5_PD15, SPC58_DSPI5_PF8, SPC58_DSPI5_PF9, SPC58_DSPI5_PH5, SPC58_DSPI5_PH6, SPC58_DSPI5_PI0, SPC58_DSPI5_PJ5, SPC58_DSPI5_PJ8, SPC58_DSPI5_PJ10, SPC58_DSPI5_PJ12, SPC58_DSPI5_PM13, SPC58_DSPI5_PN6, SPC58_DSPI6_PA0, SPC58_DSPI6_PC3, SPC58_DSPI6_PC4, SPC58_DSPI6_PC5, SPC58_DSPI6_PC6, SPC58_DSPI6_PC7, SPC58_DSPI6_PC8, SPC58_DSPI6_PD1, SPC58_DSPI6_PD2, SPC58_DSPI6_PE9, SPC58_DSPI6_PE15, SPC58_DSPI6_PH1, SPC58_DSPI6_PH2, SPC58_DSPI6_PH3, SPC58_DSPI6_PH6, SPC58_DSPI6_PH9, SPC58_DSPI6_PK15, SPC58_DSPI6_PM8, SPC58_DSPI7_PA1, SPC58_DSPI7_PA15, SPC58_DSPI7_PB4, SPC58_DSPI7_PB14, SPC58_DSPI7_PE5, SPC58_DSPI7_PG4, SPC58_DSPI7_PH10, SPC58_DSPI7_PI9, SPC58_DSPI7_PN2, SPC58_DSPI7_PN4}
      container FblCanIfConfig
        boolean FblCanIfCANFDDiscreteDlcSupport [0..1]: origin=AUTRON, default-value=false  # Selects support for CAN FD discrete DLC | True: Enabled False: Disabled
      container FblGpioPortPinControl [0..*]
        integer PortPinIndex: 0..255, origin=AUTRON, default-value=0  # SW module index. FBL should have index 0. Main SW should have index 1 and is subject to reprogramming. Index must increase sequentially.
        integer FblPortNum
        integer FblPinNum
        integer FblPortPinVal
      container FblSpiControl [0..*]
        integer FblSpiChannel: 0..255, origin=AUTRON
        enumeration FblSpiCPOL: {CPOL_0, CPOL_1}, origin=AUTRON
        enumeration FblSpiCPHA: {CPHA_0, CPHA_1}, origin=AUTRON
        enumeration FblSpiTranferStart: {MSB_FIRST, LSB_FIRST}, origin=AUTRON
        enumeration FblSpiSelect: {SELECT_0, SELECT_1, SELECT_2, SELECT_3, SELECT_4, SELECT_5, SELECT_6, SELECT_7}, origin=AUTRON
        integer FblSpiClock: 0..2147483647, origin=AUTRON
        integer FblSpiDataWidth: 0..255, scope=ECU, origin=AUTRON
        integer FblSpiNumberOfSendCommand: 0..255, origin=AUTRON
        enumeration FblSpiSelectPolarity: {HIGH_LEVEL, LOW_LEVEL}, origin=AUTRON
        container FblSpiIn
          integer FblSpiInPortNum: 0..255, origin=AUTRON
          integer FblSpiInPinNum: 0..255, origin=AUTRON
          enumeration FblSpiInPortAlphabet: {PORT_A, PORT_B, PORT_C, PORT_D, PORT_E, PORT_F, PORT_G, PORT_H, PORT_I, PORT_J, PORT_K, PORT_L, PORT_M, PORT_N, PORT_O, PORT_P, PORT_Q, PORT_R, PORT_S, NOT_USED}
        container FblSpiOut
          integer FblSpiOutPortNum: 0..255, origin=AUTRON
          integer FblSpiOutPinNum: 0..255, origin=AUTRON
          enumeration FblSpiOutPortAlphabet: {PORT_A, PORT_B, PORT_C, PORT_D, PORT_E, PORT_F, PORT_G, PORT_H, PORT_I, PORT_J, PORT_K, PORT_L, PORT_M, PORT_N, PORT_O, PORT_P, PORT_Q, PORT_R, PORT_S}
        container FblSpiClk
          integer FblSpiClkPortNum: 0..255, origin=AUTRON
          integer FblSpiClkPinNum: 0..255, origin=AUTRON
          enumeration FblSpiClkPortAlphabet: {PORT_A, PORT_B, PORT_C, PORT_D, PORT_E, PORT_F, PORT_G, PORT_H, PORT_I, PORT_J, PORT_K, PORT_L, PORT_M, PORT_N, PORT_O, PORT_P, PORT_Q, PORT_R, PORT_S}
        container FblSpiCs
          integer FblSpiCsPortNum: 0..255, origin=AUTRON
          integer FblSpiCsPinNum: 0..255, scope=ECU, origin=AUTRON
          enumeration FblSpiCsPortAlphabet: {PORT_A, PORT_B, PORT_C, PORT_D, PORT_E, PORT_F, PORT_G, PORT_H, PORT_I, PORT_J, PORT_K, PORT_L, PORT_M, PORT_N, PORT_O, PORT_P, PORT_Q, PORT_R, PORT_S}
        container FblSpiSendCommand [1..*]
          integer FblSpiData: origin=AUTRON

AUTOSAR XML (schema 4-0-3)
package /AUTRON
  module config SCons_FBL: definition=SCons
    FBL (Build): McuFamilyType=CYT2B9XX, CopyToCProject=1, FBLFolder=FBL
      Compile:
        CompilerPath = D:\ts_mirr\gh\ARM.V2017.1.4\comp_201714\ccarm.exe
        CompilerType = multiide
        LinkDiscriptFile = Build\CYTXXXX_FBL.ld
        CompilerLicense = ip=10.208.199.229
        LibraryDirectory = D:\ts_mirr\gh\ARM.V2017.1.4\comp_201714\lib\thumb2
        CSuffixes = asm
        CSuffixes = c
        CSuffixes = s
        CSuffixes = arm
        LibraryFiles = arch
        LibraryFiles = ind_sf
        LibraryFiles = math_fp
        LibraryFiles = startup
        LibraryFiles = sys
        LibraryFiles = ansi
        ReleaseExceptedDirectory = lib
        LinkOption = -delete
        LinkOption = -errmax=20
        LinkOption = -keepmap
        LinkOption = -nocpp
        LinkOption = -Mn
        DefaultCompileOption = --no_alternative_tokens
        DefaultCompileOption = --no_commons
        DefaultCompileOption = --prototype_errors
        DefaultCompileOption = --short_enum
        DefaultCompileOption = -DCPU_BOARD_REVC
        DefaultCompileOption = -DCYT2B93CAS
        DefaultCompileOption = -DCY_USE_PSVP=0
        DefaultCompileOption = -D__GHS__
        DefaultCompileOption = -D__ghs__
        DefaultCompileOption = -Dcyt2b9
        DefaultCompileOption = -Dtviibe2m
        DefaultCompileOption = -G
        DefaultCompileOption = -OI
        DefaultCompileOption = -Ointerproc
        DefaultCompileOption = -Olink
        DefaultCompileOption = -Omax
        DefaultCompileOption = -Ospeed
        DefaultCompileOption = -Wformat
        DefaultCompileOption = -Wimplicit-int
        DefaultCompileOption = -Wshadow
        DefaultCompileOption = -Wtrigraphs
        DefaultCompileOption = -Wundef
        DefaultCompileOption = -align4
        DefaultCompileOption = -asm3g
        DefaultCompileOption = -c
        DefaultCompileOption = -cpu=cortexm4f
        DefaultCompileOption = -dwarf2
        DefaultCompileOption = -globalcheck=normal
        DefaultCompileOption = -globalcheck_qualifiers
        DefaultCompileOption = -list
        DefaultCompileOption = -nostartfiles
        DefaultCompileOption = -preprocess_assembly_files
        DefaultCompileOption = -reject_duplicates
        DefaultCompileOption = -thumb
        DefaultCompileOption = -thumb_lib
        DefaultCompileOption = --gnu_asm
        DefaultCompileOption = -D__cortexm4__
        DefaultCompileOption = -fsoft
        LibraryDirectory = CryptoLib\HAE_ASK\FBL
        LibraryDirectory = CryptoLib\HAE_Crypto\FBL
        LibraryDirectory = CryptoLib\HAE_HSM\HSM_Driver\lib
        LibraryDirectory = CryptoLib\HAE_SFM2\HAE_SFM2_FBL
        LibraryFiles = ASK_150_cyt2b9_fbl
        LibraryFiles = CryptoLib_cyt2b9_fbl
        LibraryFiles = HSM_Driver_CYT2B9X_rel
        LibraryFiles = HKMC_SecureFlash2_Except_Crypto
        FBL (Pattern):
          IsInternalFile = 1
          PatternType = FBL
          SourcePath = CryptoLib
          SourcePath = FBL
          DefineOption = FLASH_START
          DefineOption = GHS
          DefineOption = IN_BOOT
          DefineOption = _GHS_C_ARM_
          DefineOption = __EDG__
          DefineOption = DISABLE_MCAL_INTERMODULE_ASR_CHECK
          CompileOption = -D__GHS__
          CompileOption = --no_alternative_tokens
          CompileOption = --no_commons
          CompileOption = --prototype_errors
          CompileOption = --short_enum
          CompileOption = -DCPU_BOARD_REVC
          CompileOption = -DCYT2B98CAE
          CompileOption = -DCY_USE_PSVP=0
          CompileOption = -D__ghs__
          CompileOption = -Dcyt2b9
          CompileOption = -Dtviibe2m
          CompileOption = -G
          CompileOption = -OI
          CompileOption = -Ointerproc
          CompileOption = -Olink
          CompileOption = -Omax
          CompileOption = -Ospeed
          CompileOption = -Wformat
          CompileOption = -Wimplicit-int
          CompileOption = -Wshadow
          CompileOption = -Wtrigraphs
          CompileOption = -Wundef
          CompileOption = -align4
          CompileOption = -asm3g
          CompileOption = -c
          CompileOption = -cpu=cortexm4f
          CompileOption = -dwarf2
          CompileOption = -fsingle
          CompileOption = -globalcheck=normal
          CompileOption = -globalcheck_qualifiers
          CompileOption = -list
          CompileOption = -nostartfiles
          CompileOption = -preprocess_assembly_files
          CompileOption = -reject_duplicates
          CompileOption = -thumb
          CompileOption = -thumb_lib
          CompileOption = --gnu_asm
          CompileOption = -D__cortexm4__
        3 x CompileCmdChoice:
          Build
            Build:
              ExcludeList = Static_Code
              ExcludeList = Generated
              ExcludeList = Application
              ExcludeList = CryptoLib\DummyCrypto
              ExcludeList = CryptoLib\HAE_HSM\HOST_SAMPLE
              ExcludeList = CryptoLib\HAE_SFM2\HAE_SFM2_RTSW
              ExcludeList = CryptoLib\HAE_ASK\RTSW
              ExcludeList = CryptoLib\HAE_Crypto\RTSW
          Compile
            Compile:
              ExcludeList = Static_Code
              ExcludeList = Generated
              ExcludeList = Application
              ExcludeList = CryptoLib\DummyCrypto
              ExcludeList = CryptoLib\HAE_HSM\HOST_SAMPLE
              ExcludeList = CryptoLib\HAE_SFM2\HAE_SFM2_RTSW
              ExcludeList = CryptoLib\HAE_ASK\RTSW
              ExcludeList = CryptoLib\HAE_Crypto\RTSW
          Release
            Release:
              ExcludeList = Static_Code
              ExcludeList = Generated
              ExcludeList = Configuration
              ExcludeList = Application
              ExcludeList = CryptoLib\DummyCrypto
              ExcludeList = CryptoLib\HAE_HSM\HOST_SAMPLE
              ExcludeList = CryptoLib\HAE_SFM2\HAE_SFM2_RTSW
              ExcludeList = CryptoLib\HAE_ASK\RTSW
              ExcludeList = CryptoLib\HAE_Crypto\RTSW
      Generation
        FBL (Module):
          ModuleName = FBL
          InputFilesList = Bswmd_Fbl
          Used = 1
          IsMCAL = 0
          InputFilesList = Ecud_Fbl
          ExpectedFilesList = Fbl_Cfg.c
          ExpectedFilesList = Fbl_SharedMemMap.h
          ExpectedFilesList = Fbl_Cfg.h

AUTOSAR XML (schema 4-0-3)
package /AUTRON
  module config SCons
    RTSW (Build): McuFamilyType=CYT2B9XX, CopyToCProject=1, FBLFolder=Fbl
      Compile:
        CompilerPath = D:\ts_mirr\gh\ARM.V2017.1.4\comp_201714\ccarm.exe
        CompilerType = multiide
        CompilerLicense = ip=10.208.199.229
        LinkOption = --nocpp
        LibraryDirectory = D:\ts_mirr\gh\ARM.V2017.1.4\comp_201714\lib\thumb2
        LinkOption = -Mn
        LinkOption = -delete
        LinkOption = -keepmap
        ReleaseExceptedDirectory = ext_lib
        ReleaseExceptedDirectory = lib
        DefaultCompileOption = -cpu=cortexm4f
        DefaultCompileOption = -thumb
        DefaultCompileOption = -thumb_lib
        DefaultCompileOption = --short_enum
        DefaultCompileOption = -align4
        DefaultCompileOption = --no_commons
        DefaultCompileOption = --no_alternative_tokens
        DefaultCompileOption = -asm3g
        DefaultCompileOption = -preprocess_assembly_files
        CSuffixes = arm
        CSuffixes = asm
        CSuffixes = s
        CSuffixes = c
        DefaultCompileOption = -nostartfiles
        DefaultCompileOption = -globalcheck=normal
        DefaultCompileOption = -globalcheck_qualifiers
        DefaultCompileOption = --prototype_errors
        DefaultCompileOption = -Wformat
        DefaultCompileOption = -Wimplicit-int
        DefaultCompileOption = -Wshadow
        DefaultCompileOption = -Wtrigraphs
        DefaultCompileOption = -Wundef
        DefaultCompileOption = -reject_duplicates
        DefaultCompileOption = -c
        DefaultCompileOption = -list
        DefaultCompileOption = -Ospeed
        DefaultCompileOption = -OI
        DefaultCompileOption = -Olink
        DefaultCompileOption = -Ointerproc
        DefaultCompileOption = -Omax
        DefaultCompileOption = -dwarf2
        DefaultCompileOption = -G
        DefaultCompileOption = -Dtviibe2m
        DefaultCompileOption = -DCPU_BOARD_REVC
        DefaultCompileOption = -D__ghs__
        DefaultCompileOption = -D__GHS__
        DefaultCompileOption = -Dcyt2b9
        DefaultCompileOption = -DCY_USE_PSVP=0
        LinkDiscriptFile = Build\\CYTXXXX_RTSW.ld
        ObjectFiles = D:\ts_mirr\gh\ARM.V2017.1.4\comp_201714\lib\thumb2\crt0.o
        LinkOption = -cpu=cortexm4f
        LinkOption = --preprocess_linker_directive_full
        LinkOption = -nostartfiles
        LinkOption = -D_LINK_flash_=1
        LinkOption = -D_CORE_cm4_=1
        LinkerPath = D:\ts_mirr\gh\ARM.V2017.1.4\comp_201714\ccarm.exe
        DefaultCompileOption = -DCYT2B93CAS
        DefaultCompileOption = -fsoft
        LibraryDirectory = CryptoLib\HAE_ASK\RTSW
        LibraryDirectory = CryptoLib\HAE_Crypto\RTSW
        LibraryDirectory = CryptoLib\HAE_HSM\HSM_Driver\lib
        LibraryDirectory = CryptoLib\HAE_SFM2\HAE_SFM2_RTSW
        LibraryFiles = ASK_150_cyt2b9_rtsw
        LibraryFiles = CryptoLib_cyt2b9_rtsw
        LibraryFiles = HSM_Driver_CYT2B9X_rel
        LibraryFiles = HKMC_SecureFlash2_Except_Crypto
        LibraryFiles = math_fp
        LibraryFiles = ind_sf
        LibraryFiles = arch
        LibraryFiles = ansi
        LibraryFiles = startup
        LibraryFiles = sys
        3 x Pattern, all with CompileOption=--gnu_asm, CompileOption=--no_alternative_tokens, CompileOption=--no_commons, CompileOption=--prototype_errors, CompileOption=--short_enum, CompileOption=-DCPU_BOARD_REVC, CompileOption=-DCY_USE_PSVP=0, CompileOption=-D__ghs__, CompileOption=-D__GHS__, CompileOption=-Dcyt2b9, CompileOption=-Dtviibe2m, CompileOption=-G, CompileOption=-OI, CompileOption=-Ointerproc, CompileOption=-Olink, CompileOption=-Omax, CompileOption=-Ospeed, CompileOption=-Wformat, CompileOption=-Wimplicit-int, CompileOption=-Wshadow, CompileOption=-Wtrigraphs, CompileOption=-Wundef, CompileOption=-align4, CompileOption=-asm3g, CompileOption=-c, CompileOption=-dwarf2, CompileOption=-globalcheck=normal, CompileOption=-globalcheck_qualifiers, CompileOption=-list, CompileOption=-nostartfiles, CompileOption=-preprocess_assembly_files, CompileOption=-reject_duplicates, CompileOption=-thumb, CompileOption=-thumb_lib, CompileOption=-cpu=cortexm4f, CompileOption=-DCYT2B93CAS, CompileOption=-fsoft:
          ASW: PatternType=ASW, SourcePath=Static_Code\Reference_Code, IsInternalFile=0, SourcePath=Application
          BSW: PatternType=BSW, IsInternalFile=1, SourcePath=Static_Code\Integration_Code, SourcePath=Static_Code\Modules\b_autosar_HwResource, SourcePath=Static_Code\Modules\b_autosar_Rte_R40, SourcePath=Static_Code\Modules\b_autosar_cdd_CanCM, SourcePath=Static_Code\Modules\b_autosar_cdd_DataLog, SourcePath=Static_Code\Modules\b_autosar_com_CanIf_R40, SourcePath=Static_Code\Modules\b_autosar_com_CanSm_R40, SourcePath=Static_Code\Modules\b_autosar_com_CanTp_R40, SourcePath=Static_Code\Modules\b_autosar_com_CanTrcv_R40, SourcePath=Static_Code\Modules\b_autosar_com_Com_R40, SourcePath=Static_Code\Modules\b_autosar_com_IpduM_R40, SourcePath=Static_Code\Modules\b_autosar_com_Nm_R40, SourcePath=Static_Code\Modules\b_autosar_com_OsekNm, SourcePath=Static_Code\Modules\b_autosar_com_PduR_R40, SourcePath=Static_Code\Modules\b_autosar_diag_Dcm_R40, SourcePath=Static_Code\Modules\b_autosar_diag_Dem_R40, SourcePath=Static_Code\Modules\b_autosar_diag_Det_R40, SourcePath=Static_Code\Modules\b_autosar_diag_FiM_R40, SourcePath=Static_Code\Modules\b_autosar_mem_MemIf_R40, SourcePath=Static_Code\Modules\b_autosar_mem_NvM_R40, SourcePath=Static_Code\Modules\b_autosar_mem_RamTst_R40, SourcePath=Static_Code\Modules\b_autosar_mem_RomTst_R40, SourcePath=Static_Code\Modules\b_autosar_per_IoHwAb_R40, SourcePath=Static_Code\Modules\b_autosar_sys_BswM_R40, SourcePath=Static_Code\Modules\b_autosar_sys_ComM_R40, SourcePath=Static_Code\Modules\b_autosar_sys_Crc_R40, SourcePath=Static_Code\Modules\b_autosar_sys_E2E_R40, SourcePath=Static_Code\Modules\b_autosar_sys_EcuM_R40, SourcePath=Static_Code\Modules\b_autosar_sys_WdgIf_R40, SourcePath=Static_Code\Modules\b_autosar_sys_WdgM_R40, SourcePath=Generated\Bsw_Output, SourcePath=Static_Code\Modules\b_autosar_com_ComXf_R43, SourcePath=Static_Code\Modules\b_autosar_sys_E2EXf_R40, SourcePath=Static_Code\Modules\b_autosar_sys_Os_cytxxx_R40, DefineOption=FEE_DECLARATION_MAINFUNCTION, SourcePath=Static_Code\Modules\b_autosar_imp_Os_cytxxx, SourcePath=Static_Code\Modules\b_autosar_sys_Csm_R40, SourcePath=Static_Code\Modules\b_autosar_sys_CryptoLib, SourcePath=CryptoLib, SourcePath=Static_Code\Modules\b_autosar_cdd_OsProfiler
          MCAL: PatternType=MCAL, IsInternalFile=0, CompileOption=-C99, SourcePath=Generated\Mcal_Output, SourcePath=Static_Code\Modules\b_mcal_cypress_cyt2b9xx, SourcePath=Static_Code\Modules\b_mcal_infineon_CYTxxx
        3 x CompileCmdChoice:
          Build
            Build:
              ExcludeList = Generated/Mcal_Output/src/Wdg_66_IA_Trigger_Asm_IAR.s
              ExcludeList = Static_Code/Modules/b_mcal_cypress_cyt2b9xx/b_pf_autosar_cypress_bundle/Startup_Files_Multi/tviibe2m/src/system/system_tviibe2m_cm4.c
              ExcludeList = Static_Code/Modules/b_mcal_cypress_cyt2b9xx/b_pf_autosar_cypress_bundle/Startup_Files_Multi/tviibe2m/src/drivers
              ExcludeList = Static_Code/Modules/b_mcal_cypress_cyt2b9xx/b_pf_autosar_cypress_bundle/Startup_Files_Multi/common/src
              ExcludeList = Static_Code/Modules/b_autosar_com_CanTrcv_R40/delivery/CanTrcv_Version.c
              ExcludeList = Static_Code/Modules/b_autosar_com_CanIf_R40/delivery/CanIf_Version.c
              ExcludeList = Static_Code/Modules/b_autosar_sys_WdgM_R40/delivery/WdgM_Version.c
              ExcludeList = Static_Code/Modules/b_autosar_per_IoHwAb_R40/delivery/IoHwAb_Version.c
              ExcludeList = Static_Code/Modules/b_autosar_mem_MemIf_R40/delivery/MemIf_Version.c
              ExcludeList = Static_Code/Modules/b_mcal_cypress_cyt2b9xx/b_mcal_can_cypress_traveo_II/lib_src/Can_BitSearch_IAR.s
              ExcludeList = Static_Code/Modules/b_autosar_com_CanSm_R40/delivery/CanSM_Version.c
              ExcludeList = Static_Code/Modules/b_autosar_mem_NvM_R40/lib/NvM_Version.c
              ExcludeList = Static_Code/Modules/b_mcal_infineon_CYTxxx/b_mcal_Lin_infineon_CYTxxx/src/Lin.c
              ExcludeList = Static_Code/Modules/b_mcal_infineon_CYTxxx/b_mcal_Lin_infineon_CYTxxx/include/Lin.h
              ExcludeList = Static_Code/Modules/b_mcal_infineon_CYTxxx/b_mcal_Lin_infineon_CYTxxx
              ExcludeList = Static_Code/Modules/b_mcal_infineon_CYTxxx/b_mcal_Ocu_infineon_CYTxxx
              ExcludeList = Static_Code/Modules/b_mcal_infineon_CYTxxx/b_mcal_Can_infineon_CYTxxx/lib_src/Can_BitSearch_IAR.s
              ExcludeList = Fbl
              ExcludeList = CryptoLib\DummyCrypto
              ExcludeList = CryptoLib\HAE_HSM\HOST_SAMPLE
              ExcludeList = CryptoLib\HAE_SFM2\HAE_SFM2_FBL
              ExcludeList = CryptoLib\HAE_ASK\FBL
              ExcludeList = CryptoLib\HAE_Crypto\FBL
          Compile
            Compile:
              ExcludeList = Static_Code/Modules/b_mcal_cypress_cyt2b9xx/b_pf_autosar_cypress_bundle/Startup_Files_Multi/tviibe2m/src/system/system_tviibe2m_cm4.c
              ExcludeList = Static_Code/Modules/b_mcal_cypress_cyt2b9xx/b_pf_autosar_cypress_bundle/Startup_Files_Multi/tviibe2m/src/drivers
              ExcludeList = Static_Code/Modules/b_mcal_cypress_cyt2b9xx/b_pf_autosar_cypress_bundle/Startup_Files_Multi/common/src
              ExcludeList = Generated/Mcal_Output/src/Wdg_66_IA_Trigger_Asm_IAR.s
              ExcludeList = Static_Code/Modules/b_autosar_com_CanTrcv_R40/delivery/CanTrcv_Version.c
              ExcludeList = Static_Code/Modules/b_autosar_com_CanIf_R40/delivery/CanIf_Version.c
              ExcludeList = Static_Code/Modules/b_autosar_sys_WdgM_R40/delivery/WdgM_Version.c
              ExcludeList = Static_Code/Modules/b_autosar_per_IoHwAb_R40/delivery/IoHwAb_Version.c
              ExcludeList = Static_Code/Modules/b_autosar_mem_MemIf_R40/delivery/MemIf_Version.c
              ExcludeList = Static_Code/Modules/b_mcal_cypress_cyt2b9xx/b_mcal_can_cypress_traveo_II/lib_src/Can_BitSearch_IAR.s
              ExcludeList = Static_Code/Modules/b_autosar_com_CanSm_R40/delivery/CanSM_Version.c
              ExcludeList = Static_Code/Modules/b_autosar_mem_NvM_R40/lib/NvM_Version.c
              ExcludeList = Static_Code/Modules/b_mcal_infineon_CYTxxx/b_mcal_Lin_infineon_CYTxxx/src/Lin.c
              ExcludeList = Static_Code/Modules/b_mcal_infineon_CYTxxx/b_mcal_Lin_infineon_CYTxxx/include/Lin.h
              ExcludeList = Static_Code/Modules/b_mcal_infineon_CYTxxx/b_mcal_Lin_infineon_CYTxxx
              ExcludeList = Static_Code/Modules/b_mcal_infineon_CYTxxx/b_mcal_Ocu_infineon_CYTxxx
              ExcludeList = Static_Code/Modules/b_mcal_infineon_CYTxxx/b_mcal_Can_infineon_CYTxxx/lib_src/Can_BitSearch_IAR.s
              ExcludeList = Fbl
              ExcludeList = CryptoLib\DummyCrypto
              ExcludeList = CryptoLib\HAE_HSM\HOST_SAMPLE
              ExcludeList = CryptoLib\HAE_SFM2\HAE_SFM2_FBL
              ExcludeList = CryptoLib\HAE_ASK\FBL
              ExcludeList = CryptoLib\HAE_Crypto\FBL
          Release
            Release:
              ExcludeList = Fbl
              ExcludeList = CryptoLib\DummyCrypto
              ExcludeList = CryptoLib\HAE_HSM\HOST_SAMPLE
              ExcludeList = CryptoLib\HAE_SFM2\HAE_SFM2_FBL
              ExcludeList = CryptoLib\HAE_ASK\FBL
              ExcludeList = CryptoLib\HAE_Crypto\FBL
      Generation:
        TransformerGeneratorPath = D:\ts_mirr\xml
        McalGeneratorPath = D:\ts_mirr\xml\eb-tresos-TRAVEO-II_V1.13.0\bin\tresos_cmd.bat
        JavaHomePath = D:\ts_mirr\xml\eb-tresos-TRAVEO-II_V1.13.0\jre_x86_64\win32\bin\javaw.exe
        58 x Module, all with Used=1:
          Adc: IsMCAL=1, MCAL_GeneratorPostfix=_TS_T40D13M1I0R0, McalDefineDerivate=CYT2B0, McalDefineTarget=MXS40, ModuleName=Adc, InputFilesList=Ecud_Resource, InputFilesList=Ecud_Adc, InputFilesList=Ecud_Dem_Mcal, ExpectedFilesList=Adc_PBcfg.h, ExpectedFilesList=Adc_Irq.c, ExpectedFilesList=Adc_PBcfg.c, ExpectedFilesList=Adc_ExternalInclude.h, ExpectedFilesList=Adc_Irq.h, ExpectedFilesList=Adc_Cfg.h
          Can: InputFilesList=Ecud_Mcu, InputFilesList=Ecud_Resource, InputFilesList=Ecud_Can, InputFilesList=Ecud_Os_Mcal, IsMCAL=1, MCAL_GeneratorPostfix=_TS_T40D13M1I0R0, McalDefineDerivate=CYT2B0, McalDefineTarget=MXS40, ModuleName=Can, InputFilesList=Ecud_EcuM_Mcal, InputFilesList=Ecud_Dem_Mcal, ExpectedFilesList=Can_ExternalInclude.h, ExpectedFilesList=Can_Irq.c, ExpectedFilesList=Can_PBcfg.c, ExpectedFilesList=Can_PBcfg.h, ExpectedFilesList=Can_Cfg.h
          Dio: ExpectedFilesList=Dio_Cfg_Include.h, InputFilesList=Ecud_Dio, InputFilesList=Ecud_Resource, IsMCAL=1, MCAL_GeneratorPostfix=_TS_T40D13M1I0R0, McalDefineDerivate=CYT2B0, McalDefineTarget=MXS40, ModuleName=Dio, ExpectedFilesList=Dio_Cfg_Internal.h, ExpectedFilesList=Dio_Cfg.h
          Fee: IsMCAL=1, MCAL_GeneratorPostfix=_TS_T40D13M1I0R0, McalDefineDerivate=CYT2B0, McalDefineTarget=MXS40, ModuleName=Fee, InputFilesList=Ecud_Resource, InputFilesList=Ecud_Fee, InputFilesList=Ecud_Dem_Mcal, ExpectedFilesList=Fee_Cfg.h
          Fls: InputFilesList=Ecud_Resource, IsMCAL=1, MCAL_GeneratorPostfix=_TS_T40D13M1I0R0, McalDefineDerivate=CYT2B0, McalDefineTarget=MXS40, ModuleName=Fls, InputFilesList=Ecud_Fls, ExpectedFilesList=Fls_Cfg.h, ExpectedFilesList=Fls_CfgDer.h, ExpectedFilesList=Fls_Irq.h, ExpectedFilesList=Fls_PBcfg.h, ExpectedFilesList=Fls_CfgDer.c, ExpectedFilesList=Fls_Irq.c, ExpectedFilesList=Fls_PBcfg.c
          Gpt: InputFilesList=Ecud_Gpt, IsMCAL=1, MCAL_GeneratorPostfix=_TS_T40D13M1I0R0, McalDefineDerivate=CYT2B0, McalDefineTarget=MXS40, ModuleName=Gpt, InputFilesList=Ecud_Resource, InputFilesList=Ecud_Dem_Mcal, InputFilesList=Ecud_EcuM_Mcal, ExpectedFilesList=Gpt_Cfg.h, ExpectedFilesList=Gpt_Irq.c, ExpectedFilesList=Gpt_PBcfg.c, ExpectedFilesList=Gpt_PBcfg.h, ExpectedFilesList=Gpt_Cfg_Include.h
          Icu: InputFilesList=Ecud_Resource, InputFilesList=Ecud_Icu, InputFilesList=Ecud_Dem_Mcal, IsMCAL=1, MCAL_GeneratorPostfix=_TS_T40D13M1I0R0, McalDefineDerivate=CYT2B0, McalDefineTarget=MXS40, ModuleName=Icu, InputFilesList=Ecud_EcuM_Mcal, ExpectedFilesList=Icu_Cfg_Include.h, ExpectedFilesList=Icu_Cfg.h, ExpectedFilesList=Icu_Irq.h, ExpectedFilesList=Icu_PBcfg.h, ExpectedFilesList=Icu_Irq.c, ExpectedFilesList=Icu_PBcfg.c
          Mcu: ExpectedFilesList=Mcu_Cfg_Arch.h, InputFilesList=Ecud_Resource, InputFilesList=Ecud_Mcu, IsMCAL=1, MCAL_GeneratorPostfix=_TS_T40D13M1I0R0, McalDefineDerivate=CYT2B0, McalDefineTarget=MXS40, ModuleName=Mcu, InputFilesList=Ecud_Dem_Mcal, ExpectedFilesList=Mcu_Cfg.h, ExpectedFilesList=Mcu_ExternalInclude.h, ExpectedFilesList=Mcu_PBcfg_Arch.h, ExpectedFilesList=Mcu_PBcfg.h, ExpectedFilesList=Mcu_Irq.c, ExpectedFilesList=Mcu_PBcfg.c
          Port: ExpectedFilesList=Port_Cfg_Der_Internal_Defaults.h, InputFilesList=Ecud_Port, IsMCAL=1, MCAL_GeneratorPostfix=_TS_T40D13M1I0R0, McalDefineDerivate=CYT2B0, McalDefineTarget=MXS40, ModuleName=Port, InputFilesList=Ecud_Resource, ExpectedFilesList=Port_Cfg_Der_Internal_User.h, ExpectedFilesList=Port_Cfg_Der.h, ExpectedFilesList=Port_Cfg_Include.h, ExpectedFilesList=Port_Cfg.h, ExpectedFilesList=Port_PBcfg_Der.c, ExpectedFilesList=Port_PBcfg.c
          Pwm: IsMCAL=1, MCAL_GeneratorPostfix=_TS_T40D13M1I0R0, McalDefineDerivate=CYT2B0, McalDefineTarget=MXS40, ModuleName=Pwm, ExpectedFilesList=Pwm_Cfg_Include.h, ExpectedFilesList=Pwm_Cfg.h, ExpectedFilesList=Pwm_PBcfg.h, ExpectedFilesList=Pwm_Irq.c, ExpectedFilesList=Pwm_PBcfg.c, InputFilesList=Ecud_Dem_Mcal, InputFilesList=Ecud_Pwm, InputFilesList=Ecud_Resource
          Spi: IsMCAL=1, MCAL_GeneratorPostfix=_TS_T40D13M1I0R0, McalDefineDerivate=CYT2B0, McalDefineTarget=MXS40, ModuleName=Spi, ExpectedFilesList=Spi_Cfg_Der.h, ExpectedFilesList=Spi_Cfg.h, ExpectedFilesList=Spi_ExternalInclude.h, ExpectedFilesList=Spi_Irq.c, ExpectedFilesList=Spi_MainFunction_Handling.c, ExpectedFilesList=Spi_PBCfg_Der.c, ExpectedFilesList=Spi_PBCfg.c, InputFilesList=Ecud_Dem_Mcal, InputFilesList=Ecud_Mcu, InputFilesList=Ecud_Spi, InputFilesList=Ecud_Resource
          Wdg: InputFilesList=Ecud_Resource, IsMCAL=1, MCAL_GeneratorPostfix=_TS_T40D13M1I0R0, McalDefineDerivate=CYT2B0, McalDefineTarget=MXS40, ModuleName=Wdg, InputFilesList=Ecud_Wdg, InputFilesList=Ecud_Dem_Mcal, ExpectedFilesList=Wdg_66_IA_Cfg_Arch.h, ExpectedFilesList=Wdg_66_IA_Cfg.h, ExpectedFilesList=Wdg_66_IA_IncludeFiles.h, ExpectedFilesList=Wdg_66_IA_PBcfg.h, ExpectedFilesList=Wdg_66_IA_Irq.c, ExpectedFilesList=Wdg_66_IA_PBcfg.c, ExpectedFilesList=Wdg_66_IA_Trigger_Asm_GHS.s, ExpectedFilesList=Wdg_66_IA_Trigger_Asm_IAR.s
          BswM: IsMCAL=0, ModuleName=BswM, ExpectedFilesList=BswM.h, ExpectedFilesList=BswM_ActionList.h, ExpectedFilesList=BswM_Cfg.h, ExpectedFilesList=BswM_PCTypes.h, ExpectedFilesList=BswM_Ram.h, ExpectedFilesList=BswM_Rule.h, ExpectedFilesList=BswM.c, ExpectedFilesList=BswM_ActionList.c, ExpectedFilesList=BswM_Cfg.c, ExpectedFilesList=BswM_Ram.c, ExpectedFilesList=BswM_Rule.c, InputFilesList=Ecud_BswM, InputFilesList=Ecud_Os, InputFilesList=Ecud_Com, InputFilesList=Ecud_ComM, InputFilesList=Ecud_EcuM, InputFilesList=Ecud_NvM, InputFilesList=Bswmd_BswM, InputFilesList=Bswmd_Dcm, InputFilesList=Bswmd_EcuM, InputFilesList=EcuM_PortInterface, InputFilesList=Swcd_Bsw_BswM, InputFilesList=Swcd_Bsw_EcuM, InputFilesList=AUTOSAR_DataTypes, InputFilesList=MODE_PortInterfaces, InputFilesList=Ecud_PduR
          Bswmd_Csm: BswDefines=B, ExpectedFilesList=Bswmd_Csm.arxml, IsMCAL=0, ModuleName=Csm, InputFilesList=Ecud_HwResource, InputFilesList=Ecud_Csm
          Bswmd_IoHwAb: BswDefines=B, ExpectedFilesList=Bswmd_IoHwAb.arxml, IsMCAL=0, ModuleName=IoHwAb, InputFilesList=Ecud_Gpt, InputFilesList=Ecud_Os, InputFilesList=Ecud_Port, InputFilesList=Ecud_Mcu, InputFilesList=Ecud_Adc, InputFilesList=Ecud_Dio, InputFilesList=Ecud_Icu, InputFilesList=Ecud_Pwm, InputFilesList=Ecud_Spi, InputFilesList=Ecud_IoHwAb, InputFilesList=Ecud_Ocu
          Bswmd_WdgIf: BswDefines=B, ExpectedFilesList=Bswmd_WdgIf.arxml, IsMCAL=0, ModuleName=WdgIf, InputFilesList=Ecud_Wdg, InputFilesList=Ecud_WdgIf, InputFilesList=Bswmd_Wdg, InputFilesList=Bswmd_Wdg_76_Acw, InputFilesList=Ecud_Wdg_76_Acw
          Bswmd_WdgM: BswDefines=B, ExpectedFilesList=Bswmd_WdgM.arxml, IsMCAL=0, ModuleName=WdgM, InputFilesList=Ecud_WdgIf, InputFilesList=Ecud_WdgM, InputFilesList=Ecud_Dem, InputFilesList=Ecud_EcuC, InputFilesList=Ecud_Mcu, InputFilesList=Ecud_Os
          Bswmd_Wdg_76_Acw: BswDefines=B, ExpectedFilesList=Bswmd_Wdg_76_Acw.arxml, IsMCAL=0, ModuleName=Wdg, InputFilesList=Ecud_Dem, InputFilesList=Ecud_Dio, InputFilesList=Ecud_Gpt, InputFilesList=Ecud_Mcu, InputFilesList=Ecud_Wdg_76_Acw
          CanCM: IsMCAL=0, ModuleName=CanCM, ExpectedFilesList=CanCM_Cfg.c, ExpectedFilesList=CanCM_Cfg.h, InputFilesList=Ecud_CanCM, InputFilesList=Bswmd_CanCM, InputFilesList=Ecud_CanSM, InputFilesList=Ecud_ComM, InputFilesList=Ecud_EcuM, InputFilesList=Ecud_CanIf, InputFilesList=Ecud_Dem, InputFilesList=Ecud_IoHwAb
          CanIf: ExpectedFilesList=CanIf_Cfg.c, IsMCAL=0, ModuleName=CanIf, ExpectedFilesList=CanIf_Cbk.h, ExpectedFilesList=CanIf_Cfg.h, ExpectedFilesList=CanIf_UserInc.h, ExpectedFilesList=CanIf_Can.h, InputFilesList=Ecud_CanIf, InputFilesList=Bswmd_CanIf, InputFilesList=Ecud_Can, InputFilesList=Ecud_CanTp, InputFilesList=Bswmd_Can, InputFilesList=Ecud_Nm, InputFilesList=Ecud_OsekNm, InputFilesList=Ecud_PduR, InputFilesList=Ecud_EcuC, ExpectedFilesList=CanIf_CanTrcv.h, InputFilesList=Ecud_CanTrcv_255_Autron, InputFilesList=Bswmd_CanTrcv_255_Autron
          CanSM: InputFilesList=Ecud_Dem, IsMCAL=0, ModuleName=CanSM, ExpectedFilesList=CanSM_Cfg.c, ExpectedFilesList=CanSM_Cfg.h, InputFilesList=Ecud_CanSM, InputFilesList=Bswmd_CanSM, InputFilesList=Ecud_CanIf, InputFilesList=Bswmd_CanIf, InputFilesList=Ecud_ComM, InputFilesList=Bswmd_ComM, InputFilesList=Bswmd_CanTrcv_255_Autron, InputFilesList=Ecud_CanTrcv_255_Autron
          CanTp: IsMCAL=0, ModuleName=CanTp, ExpectedFilesList=CanTp_Cfg.h, ExpectedFilesList=CanTp_Cfg.c, InputFilesList=Ecud_CanIf, InputFilesList=Ecud_PduR, InputFilesList=Bswmd_CanTp, InputFilesList=Ecud_CanTp, InputFilesList=Ecud_EcuC, BswDefines=411
          Com: BswDefines=Lend, InputFilesList=Ecud_EcuC, IsMCAL=0, ModuleName=Com, ExpectedFilesList=Com_Cbk.h, ExpectedFilesList=Com_Cfg.c, ExpectedFilesList=Com_Cfg.h, InputFilesList=Ecud_Com, InputFilesList=Bswmd_Com, InputFilesList=Ecud_PduR, InputFilesList=Bswmd_PduR, InputFilesList=Ecud_CanIf, InputFilesList=Bswmd_CanIf, InputFilesList=Ecud_ComM
          ComM: IsMCAL=0, ModuleName=ComM, ExpectedFilesList=ComM_Cfg.c, ExpectedFilesList=ComM_Cfg.h, InputFilesList=Bswmd_ComM, InputFilesList=Ecud_ComM, InputFilesList=Ecud_CanIf, InputFilesList=Ecud_CanSM
          Crc: ExpectedFilesList=Crc_Cfg.h, IsMCAL=0, ModuleName=Crc, InputFilesList=Ecud_Crc, InputFilesList=Bswmd_Crc
          CryptoLib: ExpectedFilesList=CryptoLib_Cfg.h, InputFilesList=Ecud_CryptoLib, IsMCAL=0, ModuleName=CryptoLib
          Csm: IsMCAL=0, ModuleName=Csm, ExpectedFilesList=Csm_Cfg.c, ExpectedFilesList=Csm_Cfg.h, InputFilesList=Bswmd_Csm, InputFilesList=Ecud_HwResource, InputFilesList=Ecud_Csm
          Dcm: IsMCAL=0, ModuleName=Dcm, ExpectedFilesList=Dcm_Cfg.c, ExpectedFilesList=Dcm_Cfg.h, ExpectedFilesList=Dcm_Routine.c, ExpectedFilesList=Dcm_Routine.h, InputFilesList=Ecud_ComM, InputFilesList=Ecud_Dcm, InputFilesList=Ecud_EcuC, InputFilesList=Ecud_NvM, InputFilesList=Ecud_PduR, InputFilesList=Bswmd_Dcm
          Dem: IsMCAL=0, ModuleName=Dem, ExpectedFilesList=Dem_Cfg.c, ExpectedFilesList=Dem_Cfg.h, InputFilesList=Ecud_Dcm, InputFilesList=Ecud_Dem, InputFilesList=Ecud_NvM, InputFilesList=Bswmd_Dem
          Det: IsMCAL=0, ModuleName=Det, ExpectedFilesList=Det_Cfg.c, ExpectedFilesList=Det_Cfg.h, InputFilesList=Ecud_Det, InputFilesList=Ecud_EcuC, InputFilesList=Bswmd_Det
          EcuM: IsMCAL=0, ModuleName=EcuM, ExpectedFilesList=EcuM_Cfg.c, ExpectedFilesList=EcuM_Cfg.h, ExpectedFilesList=EcuM_Generated_Callouts.c, ExpectedFilesList=EcuM_Generated_Callouts.h, ExpectedFilesList=EcuM_Generated_Types.h, ExpectedFilesList=EcuM_Lcfg.c, ExpectedFilesList=EcuM_PBcfg.c, InputFilesList=Bswmd_Adc, InputFilesList=Bswmd_Can, InputFilesList=Bswmd_CanCM, InputFilesList=Bswmd_CanIf, InputFilesList=Bswmd_CanSM, InputFilesList=Bswmd_CanTp, InputFilesList=Bswmd_Com, InputFilesList=Bswmd_ComM, InputFilesList=Bswmd_Dcm, InputFilesList=Bswmd_Dem, InputFilesList=Bswmd_Det, InputFilesList=Bswmd_Dio, InputFilesList=Bswmd_Gpt, InputFilesList=Bswmd_Icu, InputFilesList=Bswmd_IoHwAb, InputFilesList=Bswmd_Mcu, InputFilesList=Bswmd_Nm, InputFilesList=Bswmd_OsekNm, InputFilesList=Bswmd_PduR, InputFilesList=Bswmd_Port, InputFilesList=Bswmd_Pwm, InputFilesList=Bswmd_RamTst, InputFilesList=Bswmd_Spi, InputFilesList=Bswmd_Wdg, InputFilesList=Bswmd_WdgM, InputFilesList=Ecud_Adc, InputFilesList=Ecud_Can, InputFilesList=Ecud_CanCM, InputFilesList=Ecud_CanIf, InputFilesList=Ecud_CanSM, InputFilesList=Ecud_CanTp, InputFilesList=Ecud_Com, InputFilesList=Ecud_ComM, InputFilesList=Ecud_Dcm, InputFilesList=Ecud_Dem, InputFilesList=Ecud_Det, InputFilesList=Ecud_Dio, InputFilesList=Ecud_EcuM, InputFilesList=Ecud_Gpt, InputFilesList=Ecud_Icu, InputFilesList=Ecud_IoHwAb, InputFilesList=Ecud_Mcu, InputFilesList=Ecud_Nm, InputFilesList=Ecud_Os, InputFilesList=Ecud_OsekNm, InputFilesList=Ecud_PduR, InputFilesList=Ecud_Port, InputFilesList=Ecud_Pwm, InputFilesList=Ecud_RamTst, InputFilesList=Ecud_Spi, InputFilesList=Ecud_Wdg, InputFilesList=Ecud_WdgM, InputFilesList=Bswmd_EcuM, InputFilesList=Bswmd_Csm, InputFilesList=Ecud_Csm, ExpectedFilesList=EcuM_Dem_Cfg.h, InputFilesList=Ecud_CanTrcv_255_Autron, InputFilesList=Bswmd_CanTrcv_255_Autron, InputFilesList=Ecud_EcuC, InputFilesList=Ecud_RomTst, InputFilesList=Bswmd_RomTst, InputFilesList=AUTRON_AUTOSAR_RomTst_ECU_Configuration_PDF
          FiM: IsMCAL=0, ModuleName=FiM, ExpectedFilesList=FiM_Cfg.c, ExpectedFilesList=FiM_Cfg.h, InputFilesList=Ecud_Dem, InputFilesList=Bswmd_FiM, InputFilesList=Ecud_FiM
          HwResource: ExpectedFilesList=HwResource.h, InputFilesList=Ecud_HwResource, IsMCAL=0, ModuleName=HwResource
          IoHwAb: IsMCAL=0, ModuleName=IoHwAb, ExpectedFilesList=IoHwAb_Cfg.h, ExpectedFilesList=IoHwAb_Cfg.c, InputFilesList=Bswmd_Icu, InputFilesList=Bswmd_Pwm, InputFilesList=Ecud_Adc, InputFilesList=Ecud_Dio, InputFilesList=Ecud_Gpt, InputFilesList=Ecud_Icu, InputFilesList=Ecud_Mcu, InputFilesList=Ecud_Os, InputFilesList=Ecud_Pwm, InputFilesList=Ecud_Spi, InputFilesList=Bswmd_IoHwAb, InputFilesList=Ecud_IoHwAb, InputFilesList=Ecud_Port, InputFilesList=Ecud_Ocu
          MemIf: IsMCAL=0, ModuleName=MemIf, ExpectedFilesList=MemIf.c, ExpectedFilesList=MemIf.h, ExpectedFilesList=MemIf_Cfg.h, InputFilesList=Ecud_Fee, InputFilesList=Ecud_Fls, InputFilesList=Ecud_NvM, InputFilesList=Bswmd_MemIf, InputFilesList=Ecud_MemIf
          Nm: IsMCAL=0, ModuleName=Nm, ExpectedFilesList=Nm_Cfg.c, ExpectedFilesList=Nm_Cfg.h, InputFilesList=Ecud_ComM, InputFilesList=Bswmd_Nm, InputFilesList=Ecud_Nm
          NvM: IsMCAL=0, ModuleName=NvM, ExpectedFilesList=NvM_Cfg.h, ExpectedFilesList=NvM_Cfg.c, InputFilesList=Bswmd_NvM, InputFilesList=Ecud_NvM, InputFilesList=Ecud_Dem, InputFilesList=Ecud_Os, InputFilesList=Ecud_BswM, InputFilesList=Ecud_Gpt, InputFilesList=Ecud_Fee, ExpectedFilesList=NvM_Dem_Cfg.h, InputFilesList=Ecud_Fls
          Os: ExpectedFilesList=Os_PCfg.c, InputFilesList=Ecud_Os, ModuleName=Os, ExpectedFilesList=Os_PCfg.h, ExpectedFilesList=Os_Vector.c, ExpectedFilesList=Os_LSL.ld, IsMCAL=0, InputFilesList=Bswmd_Os, BswDefines=ldfile, BswDefines=Build\CYTXXXX_RTSW.ld
          OsImp: ExpectedFilesList=Os_Imp_Cfg.h, IsMCAL=0, ModuleName=OsImp, InputFilesList=Bswmd_OsImp, InputFilesList=Ecud_OsImp, ExpectedFilesList=Os_Imp_Cfg.c
          OsProfiler: IsMCAL=0, ModuleName=OsProfiler, ExpectedFilesList=Opf_Cfg.h, ExpectedFilesList=Opf_Cfg.c, InputFilesList=Ecud_Os, InputFilesList=Bswmd_OsProfiler, InputFilesList=Ecud_OsProfiler
          Os_Common: ModuleName=Os_Common, IsMCAL=0, InputFilesList=Ecud_Os, InputFilesList=Bswmd_Os, ExpectedFilesList=Os_Cfg.c, ExpectedFilesList=Os_Cfg.h, BswDefines=ORTI, BswDefines=rteiocspinlock, ExpectedFilesList=Os_Types.h, InputFilesList=Ecud_EcuC, InputFilesList=AUTOSAR_DataTypes, InputFilesList=Swcd_ComM
          OsekNm: IsMCAL=0, ModuleName=OsekNm, ExpectedFilesList=OsekNm_Cfg.h, ExpectedFilesList=OsekNm_Cfg.c, InputFilesList=Ecud_CanIf, InputFilesList=Ecud_CanSM, InputFilesList=Ecud_Nm, InputFilesList=Bswmd_OsekNm, InputFilesList=Ecud_OsekNm
          PduR: IsMCAL=0, ModuleName=PduR, ExpectedFilesList=PduR_Cfg.c, ExpectedFilesList=PduR_Cfg.h, ExpectedFilesList=PduR_Com.h, ExpectedFilesList=PduR_Incl.h, ExpectedFilesList=PduR_CallBk.c, InputFilesList=Bswmd_CanIf, InputFilesList=Bswmd_CanTp, InputFilesList=Bswmd_Com, InputFilesList=Bswmd_Dcm, InputFilesList=Ecud_CanIf, InputFilesList=Ecud_CanTp, InputFilesList=Ecud_Com, InputFilesList=Ecud_Dcm, InputFilesList=Ecud_EcuC, InputFilesList=Ecud_PduR, InputFilesList=Bswmd_PduR, BswDefines=411
          RamTst: IsMCAL=0, ModuleName=RamTst, ExpectedFilesList=RamTst_Cfg.c, ExpectedFilesList=RamTst_Cfg.h, InputFilesList=Ecud_Dem, InputFilesList=Bswmd_RamTst, InputFilesList=Ecud_RamTst, ExpectedFilesList=RamTst_Dem_Cfg.h
          Rte: IsMCAL=0, ModuleName=Rte, BswDefines=genmemmap, BswDefines=EXCLFUNC, BswDefines=StrictUnconnRPortChk, BswDefines=CustomPrefix, BswDefines=Macro, BswDefines=GenMemMapOption::Ghs, BswDefines=validate, ExpectedFilesList=Rte.c, ExpectedFilesList=Rte_PBCfg.c, BswDefines=IOC, BswIncludePath=Static_Code\b_autosar_swc_IntegrationTest, ExpectedFilesList=BswMdt.arxml, ExpectedFilesList=Rte_Cbk.h, ExpectedFilesList=Rte_Cfg.h, ExpectedFilesList=Rte_DataHandleType.h, ExpectedFilesList=Rte_Hook.h, ExpectedFilesList=Rte_MemMap.h, ExpectedFilesList=Rte_Main.h, ExpectedFilesList=Rte_Type.h, ExpectedFilesList=Rte_PBCfg.h, ExpectedFilesList=SchM_Os.h, ExpectedFilesList=SchM_Os_Type.h, BswDefines=ParameterDirection, InputFilesList=AUTOSAR_DataTypes, InputFilesList=AUTOSAR_DataTypes_Etc, InputFilesList=AUTOSAR_Dem_ECU_Configuration_PDF, InputFilesList=AUTOSAR_EcuM_ECU_Configuration_PDF, InputFilesList=AUTOSAR_Os_ECU_Configuration_PDF, InputFilesList=App_Dcm, InputFilesList=App_Dem, InputFilesList=App_Mode, InputFilesList=App_WdgM, InputFilesList=BCAN, InputFilesList=Bswmd_Adc, InputFilesList=Bswmd_BswM, InputFilesList=Bswmd_Can, InputFilesList=Bswmd_CanCM, InputFilesList=Bswmd_CanIf, InputFilesList=Bswmd_CanSM, InputFilesList=Bswmd_CanTp, InputFilesList=Bswmd_CanTrcv_255_Autron, InputFilesList=Bswmd_Com, InputFilesList=Bswmd_ComM, InputFilesList=Bswmd_Crc, InputFilesList=Bswmd_CryptoLib, InputFilesList=Bswmd_Csm, InputFilesList=Bswmd_DataLog, InputFilesList=Bswmd_Dcm, InputFilesList=Bswmd_Dem, InputFilesList=Bswmd_Det, InputFilesList=Bswmd_Dio, InputFilesList=Bswmd_EcuM, InputFilesList=Bswmd_Fee, InputFilesList=Bswmd_FiM, InputFilesList=Bswmd_Fls, InputFilesList=Bswmd_Gpt, InputFilesList=Bswmd_Icu, InputFilesList=Bswmd_IoHwAb, InputFilesList=Bswmd_Mcu, InputFilesList=Bswmd_MemIf, InputFilesList=Bswmd_Nm, InputFilesList=Bswmd_NvM, InputFilesList=Bswmd_Ocu, InputFilesList=Bswmd_Os, InputFilesList=Bswmd_OsekNm, InputFilesList=Bswmd_PduR, InputFilesList=Bswmd_Port, InputFilesList=Bswmd_Pwm, InputFilesList=Bswmd_RamTst, InputFilesList=Bswmd_RomTst, InputFilesList=Bswmd_Spi, InputFilesList=Bswmd_Wdg, InputFilesList=Bswmd_WdgIf, InputFilesList=Bswmd_WdgM, InputFilesList=Bswmd_Wdg_76_Acw, InputFilesList=ECUConfigurationParameters, InputFilesList=ECUConfigurationParameters_4.3.1, InputFilesList=EcuExtract, InputFilesList=Ecud_Com, InputFilesList=Ecud_Det, InputFilesList=Ecud_EcuC, InputFilesList=Ecud_Os, InputFilesList=Ecud_Rte, InputFilesList=LOCALCAN, InputFilesList=MODE_PortInterfaces, InputFilesList=Swcd_Bsw_BswM, InputFilesList=Swcd_Bsw_Csm, InputFilesList=Swcd_Bsw_Dcm, InputFilesList=Swcd_Bsw_Dem, InputFilesList=Swcd_Bsw_EcuM, InputFilesList=Swcd_Bsw_NvM, InputFilesList=Swcd_Bsw_Os, InputFilesList=Swcd_CanTp, InputFilesList=Swcd_ComM, InputFilesList=Swcd_DataLog, InputFilesList=Swcd_Det, InputFilesList=Swcd_FiM, InputFilesList=Swcd_IoHwAb, InputFilesList=Swcd_WdgM, InputFilesList=ECUCD_EcucValueCollection, InputFilesList=EcuM_PortInterface, InputFilesList=Swcd_WdgM_Fixed, InputFilesList=app_wpc, InputFilesList=DataTypes, InputFilesList=Interface, InputFilesList=cdd_nfcic, InputFilesList=cdd_slpwup, InputFilesList=cdd_wpcic, InputFilesList=cdd_uds
          Swcd_Bsw_Csm: BswDefines=S, ExpectedFilesList=Swcd_Bsw_Csm.arxml, IsMCAL=0, ModuleName=Csm, InputFilesList=Bswmd_Csm, InputFilesList=Ecud_HwResource, InputFilesList=Ecud_Csm
          Swcd_Bsw_Dcm: BswDefines=S, ExpectedFilesList=Swcd_Bsw_Dcm.arxml, IsMCAL=0, ModuleName=Dcm, InputFilesList=Ecud_ComM, InputFilesList=Ecud_Dcm, InputFilesList=Ecud_EcuC, InputFilesList=Ecud_NvM, InputFilesList=Ecud_PduR, InputFilesList=Bswmd_Dcm
          Swcd_Bsw_Dem: BswDefines=S, ExpectedFilesList=Swcd_Bsw_Dem.arxml, IsMCAL=0, ModuleName=Dem, InputFilesList=Ecud_Dcm, InputFilesList=Ecud_Dem, InputFilesList=Ecud_NvM, InputFilesList=Bswmd_Dem, InputFilesList=Ecud_FiM
          Swcd_Bsw_EcuM: BswDefines=S, ExpectedFilesList=Swcd_Bsw_EcuM.arxml, IsMCAL=0, ModuleName=EcuM, InputFilesList=Ecud_EcuM
          Swcd_Bsw_IoHwAb: BswDefines=S, ExpectedFilesList=Swcd_IoHwAb.arxml, IsMCAL=0, ModuleName=IoHwAb, InputFilesList=Ecud_Adc, InputFilesList=Ecud_Dio, InputFilesList=Ecud_Gpt, InputFilesList=Ecud_Icu, InputFilesList=Ecud_Mcu, InputFilesList=Ecud_Os, InputFilesList=Ecud_Port, InputFilesList=Ecud_Pwm, InputFilesList=Ecud_Spi, InputFilesList=Ecud_IoHwAb, InputFilesList=Bswmd_Icu, InputFilesList=Bswmd_Pwm, InputFilesList=Bswmd_IoHwAb, InputFilesList=Ecud_Ocu, InputFilesList=Bswmd_Ocu
          Swcd_Bsw_Nvm: BswDefines=S, BswDefines=P, ExpectedFilesList=Swcd_Bsw_NvM.arxml, IsMCAL=0, ModuleName=NvM, InputFilesList=Bswmd_NvM, InputFilesList=Ecud_Dem, InputFilesList=Ecud_Fee, InputFilesList=Ecud_NvM
          Swcd_WdgM: BswDefines=S, ExpectedFilesList=Swcd_WdgM.arxml, IsMCAL=0, ModuleName=WdgM, InputFilesList=Bswmd_WdgM, InputFilesList=Ecud_Dem, InputFilesList=Ecud_EcuC, InputFilesList=Ecud_Mcu, InputFilesList=Ecud_Os, InputFilesList=Ecud_WdgIf, InputFilesList=Ecud_WdgM
          WdgIf: IsMCAL=0, ModuleName=WdgIf, ExpectedFilesList=WdgIf.c, ExpectedFilesList=WdgIf.h, ExpectedFilesList=WdgIf_Cfg.h, ExpectedFilesList=WdgIf_Types.h, ExpectedFilesList=WdgIf_Version.c, ExpectedFilesList=WdgIf_Version.h, InputFilesList=Bswmd_Wdg, InputFilesList=Bswmd_WdgIf, InputFilesList=Ecud_Wdg, InputFilesList=Ecud_WdgIf, InputFilesList=Bswmd_Wdg_76_Acw, InputFilesList=Ecud_Wdg_76_Acw
          WdgM: IsMCAL=0, ModuleName=WdgM, ExpectedFilesList=WdgM_Cfg.c, ExpectedFilesList=WdgM_Cfg.h, ExpectedFilesList=WdgM_GenExterns.h, InputFilesList=Bswmd_WdgM, InputFilesList=Ecud_Dem, InputFilesList=Ecud_EcuC, InputFilesList=Ecud_Mcu, InputFilesList=Ecud_Os, InputFilesList=Ecud_WdgIf, InputFilesList=Ecud_WdgM, ExpectedFilesList=WdgM_Dem_Cfg.h
          Wdg_76_Acw: IsMCAL=0, ModuleName=Wdg, ExpectedFilesList=Wdg_76_Acw_Cfg.c, ExpectedFilesList=Wdg_76_Acw_Cfg.h, InputFilesList=Bswmd_Wdg_76_Acw, InputFilesList=Ecud_BswM, InputFilesList=Ecud_Dem, InputFilesList=Ecud_Dio, InputFilesList=Ecud_Gpt, InputFilesList=Ecud_Mcu, InputFilesList=Ecud_Wdg_76_Acw
          Bswmd_EcuM: BswDefines=B, ExpectedFilesList=Bswmd_EcuM.arxml, IsMCAL=0, ModuleName=EcuM, InputFilesList=Ecud_EcuM
          Fbl: ModuleName=FBL, InputFilesList=Ecud_Fbl, InputFilesList=Bswmd_Fbl, ExpectedFilesList=Fbl_SharedCfg.h, ExpectedFilesList=Fbl_SharedCfg.c, ExpectedFilesList=Fbl_SharedMemMap.h, BswDefines=R, IsMCAL=0
          RomTst: ModuleName=RomTst, InputFilesList=Ecud_RomTst, InputFilesList=Bswmd_RomTst, ExpectedFilesList=RomTst_Cfg.h, ExpectedFilesList=RomTst_Cfg.c, IsMCAL=0

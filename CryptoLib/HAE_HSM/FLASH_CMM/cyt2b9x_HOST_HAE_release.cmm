;Thanks for buying our HAE HSM product
;HSM framework empower customer's security
;version: 2021. 02. 19@hae

local &filePath
entry &filePath


gosub Main
enddo


Main:
(
	gosub parsePath
	gosub initCpu
	gosub haltSys
	gosub flashSetup
	gosub eraseFlash
	gosub writeFw
	
	sys.down
	sys.up
	
	return
)

parsePath:
(
	&filePath=STRing.SCANAndExtract(STRing.UPpeR("&filePath"),"HOSTPATH=","")
    IF !OS.FILE("&filePath")
	(
		DIALOG.FILE *
		ENTRY &filePath
	)
	return
)

initCpu:
(
	SYStem.cpu CYT2B98CA-CM0+
	;system.cpu
	RETURN
)

haltSys:
(
	sys.m.down
	sys.reset
	SYS.CONFIG DEBUGPORTTYPE JTAG
	SYS.JtagClock 10MHz
	
	sys.option enreset on
	sys.option waitidcode on
	sys.option coresightreset on
	
	sys.option cypressacquire on
	sys.up
	sys.option cypressacquire off
	
	GOSUB wdtDisable
	return
)

;work flash: 0x14000000 + 0x1BFFF (112KB)
;code flash: 0x10028000 + 0x1E7FFF (1952KB)
flashSetup:
(
	PRIVATE &nHostCodeLargeSectors  &nHostCodeSmallSectors
	;PRIVATE &nHostWorkFlashLargeSectors &nHostWorkFlashSmallSectors

	&nHostCodeLargeSectors=62.			;32KB
	&nHostCodeSmallSectors=16.			;8KB
	// 128kB
	;&nHostWorkFlashLargeSectors=48.			;2KB
	;&nHostWorkFlashSmallSectors=256.		;128B

	flash.reset

	; <code flash>
	; large
	FLASH.Create 1. (0x10000000)++(&nHostCodeLargeSectors*0x8000-0x1) 0x8000 TARGET LONG
	; small
	FLASH.Create 1. (0x10000000+&nHostCodeLargeSectors*0x8000)++(&nHostCodeSmallSectors*0x2000-0x1) 0x2000 TARGET LONG
	
	; <work flash>
	; large
	;FLASH.Create 2. (0x14000000)++(&nHostWorkFlashLargeSectors*0x800-0x1) 0x800 TARGET LONG
	; small
	;FLASH.Create 2. (0x14000000+&nHostWorkFlashLargeSectors*0x800)++(&nHostWorkFlashSmallSectors*0x80-0x1) 0x80 TARGET LONG
	
	gosub doFlashAlgorithm
	
	return
)

eraseFlash:
(
	DIALOG.YESNO "Program flash memory?"
	LOCAL &progflash
	ENTRY &progflash
	IF &progflash
	(
		;erase work flash(112KB)
		;flash.erase 0x14000000++0x1BFFF

		;erase code flash
		flash.erase 0x10028000++0x1E7FFF
	)	
	return
)

writeFw:
(
	flash.reprogram all
	data.load.elf "&filePath"
	flash.reprogram off
	
	return
)

doFlashAlgorithm:
(
	PRIVATE &nSRamBaseAddress &sFirmwareRam &use_dualport &algoPath
	&nSRamBaseAddress=0x08000000
	&algoPath="~~/demo/arm/flash/long/traveo_ii.bin"
	
	&use_dualport="1"
	;&sFirmwareRam="0x0803f800++0x7ff"		;rev B
	;&sFirmwareRam="0x08000000++0x7ff"		;rev C
	;&sFirmwareRam="/FirmwareRAM &(sFirmwareRam)"
	&sFirmwareRam=""

	IF (("&use_dualport"!="1")||SYStem.ACCESS.DENIED())
	FLASH.TARGET &nSRamBaseAddress+0x1000   &nSRamBaseAddress+0x2000 0x1000 "&algoPath" /STACKSIZE 0x800 &sFirmwareRam
	ELSE
	FLASH.TARGET &nSRamBaseAddress+0x1000 E:&nSRamBaseAddress+0x2000 0x1000 "&algoPath" /STACKSIZE 0x800 &sFirmwareRam /DUALPORT

	FLASH.CLOCK AUTO
	return
)

wdtDisable:
(	
	;unlock
	Data.Set AD:0x4026C040 %Long 1
	Data.Set AD:0x4026C040 %Long 2
	
	;jk@devel - global disable
	;additional information refer to wdt_config debug_trigger_en reg in trm 
	Data.Set AD:0x4026C000 %Long 0
	
	;lock again
	Data.Set AD:0x4026C040 %Long 3

	return
)
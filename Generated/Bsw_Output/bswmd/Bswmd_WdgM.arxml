AUTOSAR XML (schema 4-0-3)
package /Bsw_WdgM
  bsw implementation BswImplementation_WdgM: programming-language=C, sw-version=1.2.17, swc-bsw-mapping=SwcBswMapping_WdgM, vendor-id=39, ar-release-version=4.0.3, behavior=BswInternalBehavior_WdgM, vendor-specific-module-def=WdgM
  bsw module description WdgM: module-id=13
    provided-entrys:
      WdgM_Init
      WdgM_DeInit
      WdgM_GetVersionInfo
      WdgM_SetMode
      WdgM_UpdateAliveCounter
      WdgM_MainFunction
      WdgM_GetMode
      WdgM_GetLocalStatus
      WdgM_GetGlobalStatus
      WdgM_CheckpointReached
      WdgM_PerformReset
      WdgM_GetFirstExpiredSEID
    bsw module dependency BswModuleDependency_WdgIf: target-module-id=43
    required-mode-groups:
      mode declaration group prototype modeNotificationPort_EcuMode: type=EcuMode
    bsw internal behavior BswInternalBehavior_WdgM: data-type-mapping=EcuModeMap, bsw-mode-receiver-policy{enhanced-mode-api=true, required-mode-group=modeNotificationPort_EcuMode, supports-asynchronous-mode-switch=true}
      exclusive area GLOBALSUPVSNSTATUS_PROTECTION
      bsw schedulable entity BswSE_WdgM_MainFunction: can-enter-exclusive-area=GLOBALSUPVSNSTATUS_PROTECTION, accessed-mode-groups=modeNotificationPort_EcuMode, implemented-entry=WdgM_MainFunction
      11 x bsw called entity:
        BswCE_WdgM_Init: implemented-entry=WdgM_Init
        BswCE_WdgM_DeInit: implemented-entry=WdgM_DeInit
        BswCE_WdgM_GetVersionInfo: implemented-entry=WdgM_GetVersionInfo
        BswCE_WdgM_SetMode: implemented-entry=WdgM_SetMode
        BswCE_WdgM_UpdateAliveCounter: implemented-entry=WdgM_UpdateAliveCounter
        BswCE_WdgM_GetMode: implemented-entry=WdgM_GetMode
        BswCE_WdgM_GetLocalStatus: implemented-entry=WdgM_GetLocalStatus
        BswCE_WdgM_GetGlobalStatus: implemented-entry=WdgM_GetGlobalStatus
        BswCE_WdgM_CheckpointReached: implemented-entry=WdgM_CheckpointReached
        BswCE_WdgM_PerformReset: implemented-entry=WdgM_PerformReset
        BswCE_WdgM_GetFirstExpiredSEID: implemented-entry=WdgM_GetFirstExpiredSEID
      bsw timing event BswTE_WdgM_MainFunction: disabled-in-mode=modeNotificationPort_EcuMode.ECUM_STATE_SHUTDOWN, starts-on-event=BswSE_WdgM_MainFunction, period=0.010
      bsw-service-dependency assigned-entry-roles=role-based-bsw-module-entry-assignment=WdgM_MainFunction:
        service-needs:
          bsw mgr needs BswMgrNeeds
  12 x bsw module entry, all with is-synchronous=true, sw-service-impl-policy=STANDARD:
    WdgM_Init: service-id=0, is-reentrant=false, call-type=REGULAR, execution-context=UNSPECIFIED
    WdgM_DeInit: service-id=1, is-reentrant=false, call-type=REGULAR, execution-context=UNSPECIFIED
    WdgM_GetVersionInfo: service-id=2, is-reentrant=true, call-type=REGULAR, execution-context=UNSPECIFIED
      sw service arg pVersionInfo: direction=OUT
    WdgM_SetMode: service-id=3, is-reentrant=false, call-type=REGULAR, execution-context=UNSPECIFIED
      sw service arg ddMode: direction=IN
      sw service arg usCallerID: direction=IN
    WdgM_UpdateAliveCounter: service-id=4, is-reentrant=true, call-type=REGULAR, execution-context=UNSPECIFIED
      sw service arg ddSEID: direction=IN
    WdgM_MainFunction: service-id=8, is-reentrant=false, call-type=SCHEDULED, execution-context=TASK
    WdgM_GetMode: service-id=11, is-reentrant=true, call-type=REGULAR, execution-context=UNSPECIFIED
      sw service arg pMode: direction=OUT
    WdgM_GetLocalStatus: service-id=12, is-reentrant=true, call-type=REGULAR, execution-context=UNSPECIFIED
      sw service arg ddSEID: direction=IN
      sw service arg pStatus: direction=OUT
    WdgM_GetGlobalStatus: service-id=13, is-reentrant=true, call-type=REGULAR, execution-context=UNSPECIFIED
      sw service arg pStatus: direction=OUT
    WdgM_CheckpointReached: service-id=14, is-reentrant=true, call-type=REGULAR, execution-context=UNSPECIFIED
      sw service arg ddSEID: direction=IN
      sw service arg ddCheckpointID: direction=IN
    WdgM_PerformReset: service-id=15, is-reentrant=false, call-type=REGULAR, execution-context=UNSPECIFIED
    WdgM_GetFirstExpiredSEID: service-id=16, is-reentrant=true, call-type=REGULAR, execution-context=UNSPECIFIED
      sw service arg pSEID: direction=OUT

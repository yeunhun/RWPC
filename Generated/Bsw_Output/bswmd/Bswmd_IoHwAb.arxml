AUTOSAR XML (schema 4-0-3)
package /Bsw_IoHwAb
  bsw module description IoHwAb: module-id=254
    required-mode-groups:
      mode declaration group prototype IoHwAb_EM_R: type=EcuMode
    bsw internal behavior BswInternalBehavior_IoHwAb: data-type-mapping=EcuModeMap
      exclusive area IoHwAbProtection
      bsw schedulable entity BswSE_IoHwAb_IOM_10ms: accessed-mode-groups=IoHwAb_EM_R, implemented-entry=IoHwAb_IOM_10ms
      bsw schedulable entity BswSE_IoHwAb_IOM_5ms: accessed-mode-groups=IoHwAb_EM_R, implemented-entry=IoHwAb_IOM_5ms
      43 x bsw called entity, all with can-enter-exclusive-area=IoHwAbProtection:
        IoHwAb_AnaInFreeze: implemented-entry=IoHwAb_AnaInFreeze
        IoHwAb_AnaInRead: implemented-entry=IoHwAb_AnaInRead
        IoHwAb_AnaInUnfreeze: implemented-entry=IoHwAb_AnaInUnfreeze
        IoHwAb_AnaInDirReadDirect: implemented-entry=IoHwAb_AnaInDirReadDirect
        IoHwAb_DigDirIsInput: implemented-entry=IoHwAb_DigDirIsInput
        IoHwAb_DigDirIsOutput: implemented-entry=IoHwAb_DigDirIsOutput
        IoHwAb_DigDirReadDirect: implemented-entry=IoHwAb_DigDirReadDirect
        IoHwAb_DigDirSetToInput: implemented-entry=IoHwAb_DigDirSetToInput
        IoHwAb_DigDirSetToOutput: implemented-entry=IoHwAb_DigDirSetToOutput
        IoHwAb_DigDirWriteDirect: implemented-entry=IoHwAb_DigDirWriteDirect
        IoHwAb_GptDisableNotification: implemented-entry=IoHwAb_GptDisableNotification
        IoHwAb_GptEnableNotification: implemented-entry=IoHwAb_GptEnableNotification
        IoHwAb_GptGetTimeElapsed: implemented-entry=IoHwAb_GptGetTimeElapsed
        IoHwAb_GptGetTimeRemaining: implemented-entry=IoHwAb_GptGetTimeRemaining
        IoHwAb_GptStartTimer: implemented-entry=IoHwAb_GptStartTimer
        IoHwAb_GptStopTimer: implemented-entry=IoHwAb_GptStopTimer
        IoHwAb_IcuDisableEdgeCount: implemented-entry=IoHwAb_IcuDisableEdgeCount
        IoHwAb_IcuDisableEdgeDetection: implemented-entry=IoHwAb_IcuDisableEdgeDetection
        IoHwAb_IcuDisableNotification: implemented-entry=IoHwAb_IcuDisableNotification
        IoHwAb_IcuEnableEdgeCount: implemented-entry=IoHwAb_IcuEnableEdgeCount
        IoHwAb_IcuEnableEdgeDetection: implemented-entry=IoHwAb_IcuEnableEdgeDetection
        IoHwAb_IcuEnableNotification: implemented-entry=IoHwAb_IcuEnableNotification
        IoHwAb_IcuGetDutyCycleValues: implemented-entry=IoHwAb_IcuGetDutyCycleValues
        IoHwAb_IcuGetEdgeNumbers: implemented-entry=IoHwAb_IcuGetEdgeNumbers
        IoHwAb_IcuGetInputState: implemented-entry=IoHwAb_IcuGetInputState
        IoHwAb_IcuGetTimeElapsed: implemented-entry=IoHwAb_IcuGetTimeElapsed
        IoHwAb_IcuGetTimestampIndex: implemented-entry=IoHwAb_IcuGetTimestampIndex
        IoHwAb_IcuResetEdgeCount: implemented-entry=IoHwAb_IcuResetEdgeCount
        IoHwAb_IcuSetActivationCondition: implemented-entry=IoHwAb_IcuSetActivationCondition
        IoHwAb_IcuStartSignalMeasurement: implemented-entry=IoHwAb_IcuStartSignalMeasurement
        IoHwAb_IcuStartTimestamp: implemented-entry=IoHwAb_IcuStartTimestamp
        IoHwAb_IcuStopSignalMeasurement: implemented-entry=IoHwAb_IcuStopSignalMeasurement
        IoHwAb_IcuStopTimestamp: implemented-entry=IoHwAb_IcuStopTimestamp
        IoHwAb_PwmDisableNotification: implemented-entry=IoHwAb_PwmDisableNotification
        IoHwAb_PwmEnableNotification: implemented-entry=IoHwAb_PwmEnableNotification
        IoHwAb_PwmGetOutputState: implemented-entry=IoHwAb_PwmGetOutputState
        IoHwAb_PwmSetDutyCycle: implemented-entry=IoHwAb_PwmSetDutyCycle
        IoHwAb_PwmSetOutputToIdle: implemented-entry=IoHwAb_PwmSetOutputToIdle
        IoHwAb_PwmSetPeriodAndDuty: implemented-entry=IoHwAb_PwmSetPeriodAndDuty
        IoHwAb_VolMonGetStatus: implemented-entry=IoHwAb_VolMonGetStatus
        IoHwAb_VolMonIsThresholdOver: implemented-entry=IoHwAb_VolMonIsThresholdOver
        IoHwAb_VolMonIsThresholdUnder: implemented-entry=IoHwAb_VolMonIsThresholdUnder
        IoHwAb_VolMonRead: implemented-entry=IoHwAb_VolMonRead
      bsw timing event BswTE_IoHwAb_IOM_10ms: context-limitation=BswDistinguishedPartition_IoHwAb, disabled-in-mode=[IoHwAb_EM_R.ECUM_STATE_STARTUP_ONE, IoHwAb_EM_R.ECUM_STATE_STARTUP_TWO], starts-on-event=BswSE_IoHwAb_IOM_10ms, period=0.01
      bsw timing event BswTE_IoHwAb_IOM_5ms: context-limitation=BswDistinguishedPartition_IoHwAb, starts-on-event=BswSE_IoHwAb_IOM_5ms, period=0.005
      bsw distinguished partition BswDistinguishedPartition_IoHwAb
  bsw implementation BswImplementation_IoHwAb: sw-version=1.15.0, swc-bsw-mapping=SwcBswMapping_IoHwAb, vendor-id=76, ar-release-version=4.0.3, behavior=BswInternalBehavior_IoHwAb
  43 x bsw module entry, all with is-synchronous=true, call-type=REGULAR, execution-context=UNSPECIFIED, sw-service-impl-policy=STANDARD:
    IoHwAb_AnaInFreeze: service-id=0, is-reentrant=true
      sw service arg ChIdx: direction=IN
    IoHwAb_AnaInRead: service-id=1, is-reentrant=true
      sw service arg ChIdx: direction=IN
      sw service arg Value: direction=OUT
    IoHwAb_AnaInUnfreeze: service-id=2, is-reentrant=true
      sw service arg ChIdx: direction=IN
    IoHwAb_AnaInDirReadDirect: service-id=3, is-reentrant=false
      sw service arg ChIdx: direction=IN
      sw service arg Value: direction=OUT
      sw service arg AnaInDirLength: direction=IN
    IoHwAb_DigDirIsInput: service-id=4, is-reentrant=true
      sw service arg ChIdx: direction=IN
      sw service arg blResult: direction=OUT
    IoHwAb_DigDirIsOutput: service-id=5, is-reentrant=true
      sw service arg ChIdx: direction=IN
      sw service arg blResult: direction=OUT
    IoHwAb_DigDirReadDirect: service-id=6, is-reentrant=true
      sw service arg ChIdx: direction=IN
      sw service arg Level: direction=OUT
    IoHwAb_DigDirSetToInput: service-id=7, is-reentrant=true
      sw service arg ChIdx: direction=IN
    IoHwAb_DigDirSetToOutput: service-id=8, is-reentrant=true
      sw service arg ChIdx: direction=IN
    IoHwAb_DigDirWriteDirect: service-id=9, is-reentrant=true
      sw service arg ChIdx: direction=IN
      sw service arg Level: direction=IN
    IoHwAb_GptDisableNotification: service-id=10, is-reentrant=true
      sw service arg ChIdx: direction=IN
    IoHwAb_GptEnableNotification: service-id=11, is-reentrant=true
      sw service arg ChIdx: direction=IN
    IoHwAb_GptGetTimeElapsed: service-id=12, is-reentrant=true
      sw service arg ChIdx: direction=IN
      sw service arg Value: direction=OUT
    IoHwAb_GptGetTimeRemaining: service-id=13, is-reentrant=true
      sw service arg ChIdx: direction=IN
      sw service arg Value: direction=OUT
    IoHwAb_GptStartTimer: service-id=14, is-reentrant=true
      sw service arg ChIdx: direction=IN
      sw service arg Value: direction=IN
    IoHwAb_GptStopTimer: service-id=15, is-reentrant=true
      sw service arg ChIdx: direction=IN
    IoHwAb_IcuDisableEdgeCount: service-id=16, is-reentrant=true
      sw service arg ChIdx: direction=IN
    IoHwAb_IcuDisableEdgeDetection: service-id=17, is-reentrant=true
      sw service arg ChIdx: direction=IN
    IoHwAb_IcuDisableNotification: service-id=18, is-reentrant=true
      sw service arg ChIdx: direction=IN
    IoHwAb_IcuEnableEdgeCount: service-id=19, is-reentrant=true
      sw service arg ChIdx: direction=IN
    IoHwAb_IcuEnableEdgeDetection: service-id=20, is-reentrant=true
      sw service arg ChIdx: direction=IN
    IoHwAb_IcuEnableNotification: service-id=21, is-reentrant=true
      sw service arg ChIdx: direction=IN
    IoHwAb_IcuGetDutyCycleValues: service-id=22, is-reentrant=true
      sw service arg ChIdx: direction=IN
      sw service arg DutyCycle: direction=OUT
    IoHwAb_IcuGetEdgeNumbers: service-id=23, is-reentrant=true
      sw service arg ChIdx: direction=IN
      sw service arg Num: direction=OUT
    IoHwAb_IcuGetInputState: service-id=24, is-reentrant=true
      sw service arg ChIdx: direction=IN
      sw service arg State: direction=OUT
    IoHwAb_IcuGetTimeElapsed: service-id=25, is-reentrant=true
      sw service arg ChIdx: direction=IN
      sw service arg Time: direction=OUT
    IoHwAb_IcuGetTimestampIndex: service-id=26, is-reentrant=true
      sw service arg ChIdx: direction=IN
      sw service arg TimestampIdx: direction=OUT
    IoHwAb_IcuResetEdgeCount: service-id=27, is-reentrant=true
      sw service arg ChIdx: direction=IN
    IoHwAb_IcuSetActivationCondition: service-id=28, is-reentrant=true
      sw service arg ChIdx: direction=IN
      sw service arg Activation: direction=IN
    IoHwAb_IcuStartSignalMeasurement: service-id=29, is-reentrant=true
      sw service arg ChIdx: direction=IN
    IoHwAb_IcuStartTimestamp: service-id=30, is-reentrant=true
      4 x sw service arg:
        ChIdx: direction=IN
        BufPtr: direction=OUT
        BufSize: direction=IN
        NotiItv: direction=IN
    IoHwAb_IcuStopSignalMeasurement: service-id=31, is-reentrant=true
      sw service arg ChIdx: direction=IN
    IoHwAb_IcuStopTimestamp: service-id=32, is-reentrant=true
      sw service arg ChIdx: direction=IN
    IoHwAb_PwmDisableNotification: service-id=33, is-reentrant=true
      sw service arg ChIdx: direction=IN
    IoHwAb_PwmEnableNotification: service-id=34, is-reentrant=true
      sw service arg ChIdx: direction=IN
      sw service arg NotificationEdge: direction=IN
    IoHwAb_PwmGetOutputState: service-id=35, is-reentrant=true
      sw service arg ChIdx: direction=IN
      sw service arg Level: direction=OUT
    IoHwAb_PwmSetDutyCycle: service-id=36, is-reentrant=true
      sw service arg ChIdx: direction=IN
      sw service arg Duty: direction=IN
    IoHwAb_PwmSetOutputToIdle: service-id=37, is-reentrant=true
      sw service arg ChIdx: direction=IN
    IoHwAb_PwmSetPeriodAndDuty: service-id=38, is-reentrant=true
      sw service arg ChIdx: direction=IN
      sw service arg Period: direction=IN
      sw service arg Duty: direction=IN
    IoHwAb_VolMonGetStatus: service-id=39, is-reentrant=true
      sw service arg VolMonStatus: direction=OUT
    IoHwAb_VolMonIsThresholdOver: service-id=40, is-reentrant=true
      sw service arg Threshold: direction=IN
      sw service arg VolMonResult: direction=OUT
    IoHwAb_VolMonIsThresholdUnder: service-id=41, is-reentrant=true
      sw service arg Threshold: direction=IN
      sw service arg VolMonResult: direction=OUT
    IoHwAb_VolMonRead: service-id=42, is-reentrant=true
      sw service arg Value: direction=OUT
  swc bsw mapping SwcBswMapping_IoHwAb: bsw-behavior=BswInternalBehavior_IoHwAb, swc-behavior=IB_IoHwAb
    runnable-mappings:
      bsw-entity=IoHwAb_AnaInFreeze, swc-runnable=IoHwAb_Re_AnaIn_Freeze
      bsw-entity=IoHwAb_AnaInRead, swc-runnable=IoHwAb_Re_AnaIn_Read
      bsw-entity=IoHwAb_AnaInUnfreeze, swc-runnable=IoHwAb_Re_AnaIn_Unfreeze
      bsw-entity=IoHwAb_AnaInDirReadDirect, swc-runnable=IoHwAb_Re_AnaInDir_ReadDirect
      bsw-entity=IoHwAb_DigDirIsInput, swc-runnable=IoHwAb_Re_DigDir_IsInput
      bsw-entity=IoHwAb_DigDirIsOutput, swc-runnable=IoHwAb_Re_DigDir_IsOutput
      bsw-entity=IoHwAb_DigDirReadDirect, swc-runnable=IoHwAb_Re_DigDir_ReadDirect
      bsw-entity=IoHwAb_DigDirSetToInput, swc-runnable=IoHwAb_Re_DigDir_SetToInput
      bsw-entity=IoHwAb_DigDirSetToOutput, swc-runnable=IoHwAb_Re_DigDir_SetToOutput
      bsw-entity=IoHwAb_DigDirWriteDirect, swc-runnable=IoHwAb_Re_DigDir_WriteDirect
      bsw-entity=IoHwAb_GptDisableNotification, swc-runnable=IoHwAb_Re_Gpt_DisableNotification
      bsw-entity=IoHwAb_GptEnableNotification, swc-runnable=IoHwAb_Re_Gpt_EnableNotification
      bsw-entity=IoHwAb_GptGetTimeElapsed, swc-runnable=IoHwAb_Re_Gpt_GetTimeElapsed
      bsw-entity=IoHwAb_GptGetTimeRemaining, swc-runnable=IoHwAb_Re_Gpt_GetTimeRemaining
      bsw-entity=IoHwAb_GptStartTimer, swc-runnable=IoHwAb_Re_Gpt_StartTimer
      bsw-entity=IoHwAb_GptStopTimer, swc-runnable=IoHwAb_Re_Gpt_StopTimer
      bsw-entity=IoHwAb_IcuDisableEdgeCount, swc-runnable=IoHwAb_Re_Icu_DisableEdgeCount
      bsw-entity=IoHwAb_IcuDisableEdgeDetection, swc-runnable=IoHwAb_Re_Icu_DisableEdgeDetection
      bsw-entity=IoHwAb_IcuDisableNotification, swc-runnable=IoHwAb_Re_Icu_DisableNotification
      bsw-entity=IoHwAb_IcuEnableEdgeCount, swc-runnable=IoHwAb_Re_Icu_EnableEdgeCount
      bsw-entity=IoHwAb_IcuEnableEdgeDetection, swc-runnable=IoHwAb_Re_Icu_EnableEdgeDetection
      bsw-entity=IoHwAb_IcuEnableNotification, swc-runnable=IoHwAb_Re_Icu_EnableNotification
      bsw-entity=IoHwAb_IcuGetDutyCycleValues, swc-runnable=IoHwAb_Re_Icu_GetDutyCycleValues
      bsw-entity=IoHwAb_IcuGetEdgeNumbers, swc-runnable=IoHwAb_Re_Icu_GetEdgeNumbers
      bsw-entity=IoHwAb_IcuGetInputState, swc-runnable=IoHwAb_Re_Icu_GetInputState
      bsw-entity=IoHwAb_IcuGetTimeElapsed, swc-runnable=IoHwAb_Re_Icu_GetTimeElapsed
      bsw-entity=IoHwAb_IcuGetTimestampIndex, swc-runnable=IoHwAb_Re_Icu_GetTimestampIndex
      bsw-entity=IoHwAb_IcuResetEdgeCount, swc-runnable=IoHwAb_Re_Icu_ResetEdgeCount
      bsw-entity=IoHwAb_IcuSetActivationCondition, swc-runnable=IoHwAb_Re_Icu_SetActivationCondition
      bsw-entity=IoHwAb_IcuStartSignalMeasurement, swc-runnable=IoHwAb_Re_Icu_StartSignalMeasurement
      bsw-entity=IoHwAb_IcuStartTimestamp, swc-runnable=IoHwAb_Re_Icu_StartTimestamp
      bsw-entity=IoHwAb_IcuStopSignalMeasurement, swc-runnable=IoHwAb_Re_Icu_StopSignalMeasurement
      bsw-entity=IoHwAb_IcuStopTimestamp, swc-runnable=IoHwAb_Re_Icu_StopTimestamp
      bsw-entity=IoHwAb_PwmDisableNotification, swc-runnable=IoHwAb_Re_Pwm_DisableNotification
      bsw-entity=IoHwAb_PwmEnableNotification, swc-runnable=IoHwAb_Re_Pwm_EnableNotification
      bsw-entity=IoHwAb_PwmGetOutputState, swc-runnable=IoHwAb_Re_Pwm_GetOutputState
      bsw-entity=IoHwAb_PwmSetDutyCycle, swc-runnable=IoHwAb_Re_Pwm_SetDutyCycle
      bsw-entity=IoHwAb_PwmSetOutputToIdle, swc-runnable=IoHwAb_Re_Pwm_SetOutputToIdle
      bsw-entity=IoHwAb_PwmSetPeriodAndDuty, swc-runnable=IoHwAb_Re_Pwm_SetPeriodAndDuty
      bsw-entity=IoHwAb_VolMonGetStatus, swc-runnable=IoHwAb_Re_VolMon_GetStatus
      bsw-entity=IoHwAb_VolMonIsThresholdOver, swc-runnable=IoHwAb_Re_VolMon_IsThresholdOver
      bsw-entity=IoHwAb_VolMonIsThresholdUnder, swc-runnable=IoHwAb_Re_VolMon_IsThresholdUnder
      bsw-entity=IoHwAb_VolMonRead, swc-runnable=IoHwAb_Re_VolMon_Read
  bsw module entry IoHwAb_IOM_10ms: is-reentrant=false, is-synchronous=false, call-type=SCHEDULED, execution-context=TASK, sw-service-impl-policy=STANDARD
  bsw module entry IoHwAb_IOM_5ms: is-reentrant=false, is-synchronous=false, call-type=SCHEDULED, execution-context=TASK, sw-service-impl-policy=STANDARD

AUTOSAR XML (schema 4-0-3)
package /AUTOSAR_EcuM/BswImplementations
  bsw implementation BswImplementation_EcuM: sw-version=3.1.1, swc-bsw-mapping=SwcBswMapping_EcuM, vendor-id=76, ar-release-version=4.0.3, behavior=BswIB_EcuM
package /AUTOSAR_EcuM/BswModuleEntrys
  bsw module entry EcuM_LoopDetection: service-id=48, is-reentrant=false, is-synchronous=false, call-type=SCHEDULED, execution-context=TASK, sw-service-impl-policy=STANDARD
  bsw module entry EcuM_MainFunction: service-id=24, is-reentrant=false, is-synchronous=false, call-type=SCHEDULED, execution-context=TASK, sw-service-impl-policy=STANDARD
package /AUTOSAR_EcuM/BswModuleDescriptions
  bsw module description EcuM: module-id=10
    bsw internal behavior BswIB_EcuM: included-data-type-set=data-type=EcuM_RequestType
      7 x exclusive area:
        ALARM_TIME_PROTECTION
        BOOT_TARGET_PROTECTION
        SHUTDOWN_CAUSE
        SHUTDOWN_OR_SLEEP_FLAG_PROTECTION
        SHUTDOWN_TARGET_PROTECTION
        STATE_PROTECTION
        WAKEUP_STATUS_PROTECTION
      bsw schedulable entity BswSE_EcuM_LoopDetection: implemented-entry=EcuM_LoopDetection
      bsw schedulable entity BswSE_EcuM_MainFunction: can-enter-exclusive-area=[ALARM_TIME_PROTECTION, BOOT_TARGET_PROTECTION, SHUTDOWN_CAUSE, SHUTDOWN_OR_SLEEP_FLAG_PROTECTION, SHUTDOWN_TARGET_PROTECTION, STATE_PROTECTION, WAKEUP_STATUS_PROTECTION], implemented-entry=EcuM_MainFunction
      bsw timing event BswTE_EcuM_LoopDetection: starts-on-event=BswSE_EcuM_LoopDetection, period=0.01
      bsw timing event BswTE_EcuM_MainFunction: starts-on-event=BswSE_EcuM_MainFunction, period=0.01
      bsw distinguished partition BswDistinguishedPartition_EcuM_Main

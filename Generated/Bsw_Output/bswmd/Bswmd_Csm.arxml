AUTOSAR XML (schema 4-0-3)
package /Bsw_Csm
  bsw implementation BswImplementation_Csm: sw-version=2.6.4, swc-bsw-mapping=SwcBswMapping_Csm, vendor-id=76, ar-release-version=4.0.3, behavior=BswInternalBehavior_Csm
  bsw module description Csm: module-id=110
    provided-entrys:
      Csm_HashStart
      Csm_HashUpdate
      Csm_HashFinish
      Csm_MacGenerateStart
      Csm_MacGenerateUpdate
      Csm_MacGenerateFinish
      Csm_MacVerifyStart
      Csm_MacVerifyUpdate
      Csm_MacVerifyFinish
      Csm_RandomGenerate
      Csm_RandomSeedStart
      Csm_RandomSeedUpdate
      Csm_RandomSeedFinish
      Csm_SignatureGenerateStart
      Csm_SignatureGenerateUpdate
      Csm_SignatureGenerateFinish
      Csm_SymBlockDecryptStart
      Csm_SymBlockDecryptUpdate
      Csm_SymBlockDecryptFinish
      Csm_SymBlockEncryptStart
      Csm_SymBlockEncryptUpdate
      Csm_SymBlockEncryptFinish
      Csm_SymDecryptStart
      Csm_SymDecryptUpdate
      Csm_SymDecryptFinish
      Csm_SymEncryptStart
      Csm_SymEncryptUpdate
      Csm_SymEncryptFinish
    bsw internal behavior BswInternalBehavior_Csm
      exclusive area FUNCTION_PTR_PROTECTION
      bsw internal triggering point BswITP_Csm_TriggerPointWorker
      bsw schedulable entity BswSE_Csm_MainFunction: can-enter-exclusive-area=FUNCTION_PTR_PROTECTION, activation-points=BswITP_Csm_TriggerPointWorker, implemented-entry=Csm_MainFunction
      bsw schedulable entity BswSE_Csm_Worker: implemented-entry=Csm_Worker
      28 x bsw called entity:
        BswCE_Csm_HashStart: implemented-entry=Csm_HashStart
        BswCE_Csm_HashUpdate: implemented-entry=Csm_HashUpdate
        BswCE_Csm_HashFinish: implemented-entry=Csm_HashFinish
        BswCE_Csm_MacGenerateStart: implemented-entry=Csm_MacGenerateStart
        BswCE_Csm_MacGenerateUpdate: implemented-entry=Csm_MacGenerateUpdate
        BswCE_Csm_MacGenerateFinish: implemented-entry=Csm_MacGenerateFinish
        BswCE_Csm_MacVerifyStart: implemented-entry=Csm_MacVerifyStart
        BswCE_Csm_MacVerifyUpdate: implemented-entry=Csm_MacVerifyUpdate
        BswCE_Csm_MacVerifyFinish: implemented-entry=Csm_MacVerifyFinish
        BswCE_Csm_RandomGenerate: implemented-entry=Csm_RandomGenerate
        BswCE_Csm_RandomSeedStart: implemented-entry=Csm_RandomSeedStart
        BswCE_Csm_RandomSeedUpdate: implemented-entry=Csm_RandomSeedUpdate
        BswCE_Csm_RandomSeedFinish: implemented-entry=Csm_RandomSeedFinish
        BswCE_Csm_SignatureGenerateStart: implemented-entry=Csm_SignatureGenerateStart
        BswCE_Csm_SignatureGenerateUpdate: implemented-entry=Csm_SignatureGenerateUpdate
        BswCE_Csm_SignatureGenerateFinish: implemented-entry=Csm_SignatureGenerateFinish
        BswCE_Csm_SymBlockDecryptStart: implemented-entry=Csm_SymBlockDecryptStart
        BswCE_Csm_SymBlockDecryptUpdate: implemented-entry=Csm_SymBlockDecryptUpdate
        BswCE_Csm_SymBlockDecryptFinish: implemented-entry=Csm_SymBlockDecryptFinish
        BswCE_Csm_SymBlockEncryptStart: implemented-entry=Csm_SymBlockEncryptStart
        BswCE_Csm_SymBlockEncryptUpdate: implemented-entry=Csm_SymBlockEncryptUpdate
        BswCE_Csm_SymBlockEncryptFinish: implemented-entry=Csm_SymBlockEncryptFinish
        BswCE_Csm_SymDecryptStart: implemented-entry=Csm_SymDecryptStart
        BswCE_Csm_SymDecryptUpdate: implemented-entry=Csm_SymDecryptUpdate
        BswCE_Csm_SymDecryptFinish: implemented-entry=Csm_SymDecryptFinish
        BswCE_Csm_SymEncryptStart: implemented-entry=Csm_SymEncryptStart
        BswCE_Csm_SymEncryptUpdate: implemented-entry=Csm_SymEncryptUpdate
        BswCE_Csm_SymEncryptFinish: implemented-entry=Csm_SymEncryptFinish
      bsw timing event BswTE_Csm_MainFunction: starts-on-event=BswSE_Csm_MainFunction, period=0.01
      bsw internal trigger occurred event BswITOE_Csm_TriggerWorker: starts-on-event=BswSE_Csm_Worker, event-source=BswITP_Csm_TriggerPointWorker
  30 x bsw module entry, all with sw-service-impl-policy=STANDARD:
    Csm_HashStart: service-id=0x03, is-reentrant=true, is-synchronous=false, call-type=REGULAR, execution-context=UNSPECIFIED
      sw service arg cfgId: direction=IN
    Csm_HashUpdate: service-id=0x04, is-reentrant=true, is-synchronous=false, call-type=REGULAR, execution-context=UNSPECIFIED
      sw service arg cfgId: direction=IN
      sw service arg dataBuffer: direction=IN
      sw service arg dataLength: direction=IN
    Csm_HashFinish: service-id=0x05, is-reentrant=true, is-synchronous=false, call-type=REGULAR, execution-context=UNSPECIFIED
      4 x sw service arg:
        cfgId: direction=IN
        resultBuffer: direction=OUT
        resultLength: direction=INOUT
        TruncationIsAllowed: direction=IN
    Csm_MacGenerateStart: service-id=0x06, is-reentrant=true, is-synchronous=false, call-type=REGULAR, execution-context=UNSPECIFIED
      sw service arg cfgId: direction=IN
      sw service arg key: direction=IN
    Csm_MacGenerateUpdate: service-id=0x07, is-reentrant=true, is-synchronous=false, call-type=REGULAR, execution-context=UNSPECIFIED
      sw service arg cfgId: direction=IN
      sw service arg dataBuffer: direction=IN
      sw service arg dataLength: direction=IN
    Csm_MacGenerateFinish: service-id=0x08, is-reentrant=true, is-synchronous=false, call-type=REGULAR, execution-context=UNSPECIFIED
      4 x sw service arg:
        cfgId: direction=IN
        resultBuffer: direction=OUT
        resultLength: direction=INOUT
        TruncationIsAllowed: direction=IN
    Csm_MacVerifyStart: service-id=0x09, is-reentrant=true, is-synchronous=false, call-type=REGULAR, execution-context=UNSPECIFIED
      sw service arg cfgId: direction=IN
      sw service arg key: direction=IN
    Csm_MacVerifyUpdate: service-id=0x0a, is-reentrant=true, is-synchronous=false, call-type=REGULAR, execution-context=UNSPECIFIED
      sw service arg cfgId: direction=IN
      sw service arg dataBuffer: direction=IN
      sw service arg dataLength: direction=IN
    Csm_MacVerifyFinish: service-id=0x0b, is-reentrant=true, is-synchronous=false, call-type=REGULAR, execution-context=UNSPECIFIED
      4 x sw service arg:
        cfgId: direction=IN
        MacBuffer: direction=IN
        MacLength: direction=IN
        resultBuffer: direction=OUT
    Csm_RandomGenerate: service-id=0x0f, is-reentrant=true, is-synchronous=false, call-type=REGULAR, execution-context=UNSPECIFIED
      sw service arg cfgId: direction=IN
      sw service arg resultBuffer: direction=OUT
      sw service arg resultLength: direction=IN
    Csm_RandomSeedStart: service-id=0x0c, is-reentrant=true, is-synchronous=false, call-type=REGULAR, execution-context=UNSPECIFIED
      sw service arg cfgId: direction=IN
    Csm_RandomSeedUpdate: service-id=0x0d, is-reentrant=true, is-synchronous=false, call-type=REGULAR, execution-context=UNSPECIFIED
      sw service arg cfgId: direction=IN
      sw service arg seedBuffer: direction=IN
      sw service arg seedLength: direction=IN
    Csm_RandomSeedFinish: service-id=0x0e, is-reentrant=true, is-synchronous=false, call-type=REGULAR, execution-context=UNSPECIFIED
      sw service arg cfgId: direction=IN
    Csm_SignatureGenerateStart: service-id=0x22, is-reentrant=true, is-synchronous=false, call-type=REGULAR, execution-context=UNSPECIFIED
      sw service arg cfgId: direction=IN
      sw service arg key: direction=IN
    Csm_SignatureGenerateUpdate: service-id=0x23, is-reentrant=true, is-synchronous=false, call-type=REGULAR, execution-context=UNSPECIFIED
      sw service arg cfgId: direction=IN
      sw service arg dataBuffer: direction=IN
      sw service arg dataLength: direction=IN
    Csm_SignatureGenerateFinish: service-id=0x24, is-reentrant=true, is-synchronous=false, call-type=REGULAR, execution-context=UNSPECIFIED
      sw service arg cfgId: direction=IN
      sw service arg resultBuffer: direction=OUT
      sw service arg resultLength: direction=INOUT
    Csm_SymBlockDecryptStart: service-id=0x13, is-reentrant=true, is-synchronous=false, call-type=REGULAR, execution-context=UNSPECIFIED
      sw service arg cfgId: direction=IN
      sw service arg key: direction=IN
    Csm_SymBlockDecryptUpdate: service-id=0x14, is-reentrant=true, is-synchronous=false, call-type=REGULAR, execution-context=UNSPECIFIED
      5 x sw service arg:
        cfgId: direction=IN
        cipherTextBuffer: direction=IN
        cipherTextLength: direction=IN
        plainTextBuffer: direction=OUT
        plainTextLength: direction=INOUT
    Csm_SymBlockDecryptFinish: service-id=0x15, is-reentrant=true, is-synchronous=false, call-type=REGULAR, execution-context=UNSPECIFIED
      sw service arg cfgId: direction=IN
    Csm_SymBlockEncryptStart: service-id=0x10, is-reentrant=true, is-synchronous=false, call-type=REGULAR, execution-context=UNSPECIFIED
      sw service arg cfgId: direction=IN
      sw service arg key: direction=IN
    Csm_SymBlockEncryptUpdate: service-id=0x11, is-reentrant=true, is-synchronous=false, call-type=REGULAR, execution-context=UNSPECIFIED
      5 x sw service arg:
        cfgId: direction=IN
        plainTextBuffer: direction=IN
        plainTextLength: direction=IN
        cipherTextBuffer: direction=OUT
        cipherTextLength: direction=INOUT
    Csm_SymBlockEncryptFinish: service-id=0x12, is-reentrant=true, is-synchronous=false, call-type=REGULAR, execution-context=UNSPECIFIED
      sw service arg cfgId: direction=IN
    Csm_SymDecryptStart: service-id=0x19, is-reentrant=true, is-synchronous=false, call-type=REGULAR, execution-context=UNSPECIFIED
      4 x sw service arg, all with direction=IN:
        cfgId
        key
        InitVectorBuffer
        InitVectorLength
    Csm_SymDecryptUpdate: service-id=0x1a, is-reentrant=true, is-synchronous=false, call-type=REGULAR, execution-context=UNSPECIFIED
      5 x sw service arg:
        cfgId: direction=IN
        cipherTextBuffer: direction=IN
        cipherTextLength: direction=IN
        plainTextBuffer: direction=OUT
        plainTextLength: direction=INOUT
    Csm_SymDecryptFinish: service-id=0x1b, is-reentrant=true, is-synchronous=false, call-type=REGULAR, execution-context=UNSPECIFIED
      sw service arg cfgId: direction=IN
      sw service arg plainTextBuffer: direction=OUT
      sw service arg plainTextLength: direction=INOUT
    Csm_SymEncryptStart: service-id=0x16, is-reentrant=true, is-synchronous=false, call-type=REGULAR, execution-context=UNSPECIFIED
      4 x sw service arg, all with direction=IN:
        cfgId
        key
        InitVectorBuffer
        InitVectorLength
    Csm_SymEncryptUpdate: service-id=0x17, is-reentrant=true, is-synchronous=false, call-type=REGULAR, execution-context=UNSPECIFIED
      5 x sw service arg:
        cfgId: direction=IN
        plainTextBuffer: direction=IN
        plainTextLength: direction=IN
        cipherTextBuffer: direction=OUT
        cipherTextLength: direction=INOUT
    Csm_SymEncryptFinish: service-id=0x18, is-reentrant=true, is-synchronous=false, call-type=REGULAR, execution-context=UNSPECIFIED
      sw service arg cfgId: direction=IN
      sw service arg cipherTextBuffer: direction=OUT
      sw service arg cipherTextLength: direction=INOUT
    Csm_MainFunction: service-id=0x01, is-reentrant=false, is-synchronous=true, call-type=SCHEDULED, execution-context=TASK
    Csm_Worker: service-id=0x60, is-reentrant=false, is-synchronous=true, call-type=SCHEDULED, execution-context=TASK

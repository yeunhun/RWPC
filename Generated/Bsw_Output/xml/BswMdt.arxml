AUTOSAR XML (schema 4-0-3)
standard types defined: Std_ReturnType, uint8, uint16
package /Autosar_Rte
  bsw implementation BswImplementation_0: programming-language=C, sw-version=4.10.6, used-code-generator=RteCodeGenerator, vendor-id=76, ar-release-version=4.0.3, behavior=BswInternalBehavior_0
    resource consumption ResourceConsumption_0
      6 x memory section, all with prefix=SectionNamePrefix_0:
        RTE_START_SEC_CODE: alignment=CODE, symbol=START
        RTE_STOP_SEC_CODE: alignment=CODE, symbol=STOP
        RTE_START_SEC_VAR_8: alignment=8, symbol=START
        RTE_STOP_SEC_VAR_8: alignment=8, symbol=STOP
        RTE_START_SEC_VAR_NO_INIT_8: alignment=8, symbol=START
        RTE_STOP_SEC_VAR_NO_INIT_8: alignment=8, symbol=STOP
      section name prefix SectionNamePrefix_0: symbol=RTE
  54 x bsw module entry, all with is-reentrant=true, is-synchronous=true, sw-service-impl-policy=STANDARD:
    Rte_Start: service-id=0x70, role=Rte_Start, call-type=REGULAR, execution-context=UNSPECIFIED
      return type Std_ReturnType: direction=OUT, implementation-data-type=Std_ReturnType
    Rte_Stop: service-id=0x71, role=Rte_Stop, call-type=REGULAR, execution-context=UNSPECIFIED
      return type Std_ReturnType: direction=OUT, implementation-data-type=Std_ReturnType
    SchM_Init: service-id=0x00, role=SchM_Init, call-type=REGULAR, execution-context=UNSPECIFIED
    SchM_Deinit: service-id=0x01, role=SchM_Deinit, call-type=REGULAR, execution-context=UNSPECIFIED
    SchM_GetVersionInfo: service-id=0x02, role=SchM_GetVersionInfo, call-type=REGULAR, execution-context=UNSPECIFIED
      sw service arg LpVersionInfo: direction=IN, implementation-data-type=Std_VersionInfoType
    Rte_COMCbkRxTOut_ComISignal_BCAN_BCM_07_200ms_Lamp_IntTailLmpOnReq: service-id=0x93, role=Rte_COMCbkRxTOut_ComISignal_BCAN_BCM_07_200ms_Lamp_IntTailLmpOnReq, call-type=CALLBACK, execution-context=TASK
    Rte_COMCbkRxTOut_ComISignal_BCAN_BCM_12_200ms_BCM_SmkOptTyp: service-id=0x93, role=Rte_COMCbkRxTOut_ComISignal_BCAN_BCM_12_200ms_BCM_SmkOptTyp, call-type=CALLBACK, execution-context=TASK
    Rte_COMCbkRxTOut_ComISignal_BCAN_CLU_01_20ms_1_CLU_DtntOutSta: service-id=0x93, role=Rte_COMCbkRxTOut_ComISignal_BCAN_CLU_01_20ms_1_CLU_DtntOutSta, call-type=CALLBACK, execution-context=TASK
    Rte_COMCbkRxTOut_ComISignal_BCAN_CLU_01_20ms_2_CLU_AutoBrightSta: service-id=0x93, role=Rte_COMCbkRxTOut_ComISignal_BCAN_CLU_01_20ms_2_CLU_AutoBrightSta, call-type=CALLBACK, execution-context=TASK
    Rte_COMCbkRxTOut_ComISignal_BCAN_EMS_02_10ms_1_ENG_EngSta: service-id=0x93, role=Rte_COMCbkRxTOut_ComISignal_BCAN_EMS_02_10ms_1_ENG_EngSta, call-type=CALLBACK, execution-context=TASK
    Rte_COMCbkRxTOut_ComISignal_BCAN_EMS_07_10ms_2_HEV_EngOpSta: service-id=0x93, role=Rte_COMCbkRxTOut_ComISignal_BCAN_EMS_07_10ms_2_HEV_EngOpSta, call-type=CALLBACK, execution-context=TASK
    Rte_COMCbkRxTOut_ComISignal_BCAN_HCU_03_10ms_2_HCU_HevRdySta: service-id=0x93, role=Rte_COMCbkRxTOut_ComISignal_BCAN_HCU_03_10ms_2_HCU_HevRdySta, call-type=CALLBACK, execution-context=TASK
    Rte_COMCbkRxTOut_ComISignal_BCAN_HU_GW_PE_01_CF_AVN_ProfileIDRValue: service-id=0x93, role=Rte_COMCbkRxTOut_ComISignal_BCAN_HU_GW_PE_01_CF_AVN_ProfileIDRValue, call-type=CALLBACK, execution-context=TASK
    Rte_COMCbkRxTOut_ComISignal_BCAN_IAU_16_200ms_IAU_ProfileIDRVal: service-id=0x93, role=Rte_COMCbkRxTOut_ComISignal_BCAN_IAU_16_200ms_IAU_ProfileIDRVal, call-type=CALLBACK, execution-context=TASK
    Rte_COMCbkRxTOut_ComISignal_BCAN_ICU_02_200ms_Warn_AsstDrSwSta: service-id=0x93, role=Rte_COMCbkRxTOut_ComISignal_BCAN_ICU_02_200ms_Warn_AsstDrSwSta, call-type=CALLBACK, execution-context=TASK
    Rte_COMCbkRxTOut_ComISignal_BCAN_ICU_02_200ms_Warn_RrLftDrSwSta: service-id=0x93, role=Rte_COMCbkRxTOut_ComISignal_BCAN_ICU_02_200ms_Warn_RrLftDrSwSta, call-type=CALLBACK, execution-context=TASK
    Rte_COMCbkRxTOut_ComISignal_BCAN_SBCM_AST_02_200ms_Warn_AsstDrSwSta_SBCM: service-id=0x93, role=Rte_COMCbkRxTOut_ComISignal_BCAN_SBCM_AST_02_200ms_Warn_AsstDrSwSta_SBCM, call-type=CALLBACK, execution-context=TASK
    Rte_COMCbkRxTOut_ComISignal_BCAN_SBCM_DRV_01_200ms_Warn_DrvDrSwSta_SBCM: service-id=0x93, role=Rte_COMCbkRxTOut_ComISignal_BCAN_SBCM_DRV_01_200ms_Warn_DrvDrSwSta_SBCM, call-type=CALLBACK, execution-context=TASK
    Rte_COMCbkRxTOut_ComISignal_BCAN_SBCM_RL_01_200ms_Warn_RrLftDrSwSta_SBCM: service-id=0x93, role=Rte_COMCbkRxTOut_ComISignal_BCAN_SBCM_RL_01_200ms_Warn_RrLftDrSwSta_SBCM, call-type=CALLBACK, execution-context=TASK
    Rte_COMCbkRxTOut_ComISignal_BCAN_SBCM_RR_01_200ms_Warn_RrRtDrSwSta_SBCM: service-id=0x93, role=Rte_COMCbkRxTOut_ComISignal_BCAN_SBCM_RR_01_200ms_Warn_RrRtDrSwSta_SBCM, call-type=CALLBACK, execution-context=TASK
    Rte_COMCbkRxTOut_ComISignal_BCAN_SMK_06_200ms_LFAnt_SrchSta: service-id=0x93, role=Rte_COMCbkRxTOut_ComISignal_BCAN_SMK_06_200ms_LFAnt_SrchSta, call-type=CALLBACK, execution-context=TASK
    Rte_COMCbkRxTOut_ComISignal_BCAN_VCU_01_10ms_1_VCU_EvDrvRdySta: service-id=0x93, role=Rte_COMCbkRxTOut_ComISignal_BCAN_VCU_01_10ms_1_VCU_EvDrvRdySta, call-type=CALLBACK, execution-context=TASK
    Rte_COMCbkRxTOut_ComISignal_BCAN_WPC2_01_200ms_WPC2_IndSyncVal: service-id=0x93, role=Rte_COMCbkRxTOut_ComISignal_BCAN_WPC2_01_200ms_WPC2_IndSyncVal, call-type=CALLBACK, execution-context=TASK
    Rte_COMCbkRxTOut_ComISignal_BCAN_WPC_01_200ms_USM_CmdWPCIndSta: service-id=0x93, role=Rte_COMCbkRxTOut_ComISignal_BCAN_WPC_01_200ms_USM_CmdWPCIndSta, call-type=CALLBACK, execution-context=TASK
    Rte_COMCbkRxTOut_ComISignal_BCAN_WPC_01_200ms_WPC_IndSyncVal: service-id=0x93, role=Rte_COMCbkRxTOut_ComISignal_BCAN_WPC_01_200ms_WPC_IndSyncVal, call-type=CALLBACK, execution-context=TASK
    Rte_COMCbk_ComISignal_BCAN_ATS_00_00ms_ATS_RWPC_RWPCNValueSet: service-id=0x95, role=Rte_COMCbk_ComISignal_BCAN_ATS_00_00ms_ATS_RWPC_RWPCNValueSet, call-type=CALLBACK, execution-context=TASK
    Rte_COMCbk_ComISignal_BCAN_BCM_07_200ms_Lamp_IntTailLmpOnReq: service-id=0x95, role=Rte_COMCbk_ComISignal_BCAN_BCM_07_200ms_Lamp_IntTailLmpOnReq, call-type=CALLBACK, execution-context=TASK
    Rte_COMCbk_ComISignal_BCAN_BCM_12_200ms_BCM_SmkOptTyp: service-id=0x95, role=Rte_COMCbk_ComISignal_BCAN_BCM_12_200ms_BCM_SmkOptTyp, call-type=CALLBACK, execution-context=TASK
    Rte_COMCbk_ComISignal_BCAN_CLU_01_20ms_1_CLU_DtntOutSta: service-id=0x95, role=Rte_COMCbk_ComISignal_BCAN_CLU_01_20ms_1_CLU_DtntOutSta, call-type=CALLBACK, execution-context=TASK
    Rte_COMCbk_ComISignal_BCAN_CLU_01_20ms_1_CLU_RhstaLvlSta: service-id=0x95, role=Rte_COMCbk_ComISignal_BCAN_CLU_01_20ms_1_CLU_RhstaLvlSta, call-type=CALLBACK, execution-context=TASK
    Rte_COMCbk_ComISignal_BCAN_CLU_01_20ms_2_CLU_AutoBrightSta: service-id=0x95, role=Rte_COMCbk_ComISignal_BCAN_CLU_01_20ms_2_CLU_AutoBrightSta, call-type=CALLBACK, execution-context=TASK
    Rte_COMCbk_ComISignal_BCAN_CLU_01_20ms_2_CLU_DisSpdVal_KPH: service-id=0x95, role=Rte_COMCbk_ComISignal_BCAN_CLU_01_20ms_2_CLU_DisSpdVal_KPH, call-type=CALLBACK, execution-context=TASK
    Rte_COMCbk_ComISignal_BCAN_EMS_02_10ms_1_ENG_EngSta: service-id=0x95, role=Rte_COMCbk_ComISignal_BCAN_EMS_02_10ms_1_ENG_EngSta, call-type=CALLBACK, execution-context=TASK
    Rte_COMCbk_ComISignal_BCAN_EMS_07_10ms_2_HEV_EngOpSta: service-id=0x95, role=Rte_COMCbk_ComISignal_BCAN_EMS_07_10ms_2_HEV_EngOpSta, call-type=CALLBACK, execution-context=TASK
    Rte_COMCbk_ComISignal_BCAN_HCU_03_10ms_2_HCU_HevRdySta: service-id=0x95, role=Rte_COMCbk_ComISignal_BCAN_HCU_03_10ms_2_HCU_HevRdySta, call-type=CALLBACK, execution-context=TASK
    Rte_COMCbk_ComISignal_BCAN_HU_GW_PE_01_CF_AVN_ProfileIDRValue: service-id=0x95, role=Rte_COMCbk_ComISignal_BCAN_HU_GW_PE_01_CF_AVN_ProfileIDRValue, call-type=CALLBACK, execution-context=TASK
    Rte_COMCbk_ComISignal_BCAN_HU_USM_E_02_CF_Gway_RWPCNValueSet: service-id=0x95, role=Rte_COMCbk_ComISignal_BCAN_HU_USM_E_02_CF_Gway_RWPCNValueSet, call-type=CALLBACK, execution-context=TASK
    Rte_COMCbk_ComISignal_BCAN_HU_USM_E_04_CF_AVN_CluUSMReset: service-id=0x95, role=Rte_COMCbk_ComISignal_BCAN_HU_USM_E_04_CF_AVN_CluUSMReset, call-type=CALLBACK, execution-context=TASK
    Rte_COMCbk_ComISignal_BCAN_HU_USM_E_14_CF_Gway_WPCAnimationNvalueSet: service-id=0x95, role=Rte_COMCbk_ComISignal_BCAN_HU_USM_E_14_CF_Gway_WPCAnimationNvalueSet, call-type=CALLBACK, execution-context=TASK
    Rte_COMCbk_ComISignal_BCAN_IAU_16_200ms_IAU_ProfileIDRVal: service-id=0x95, role=Rte_COMCbk_ComISignal_BCAN_IAU_16_200ms_IAU_ProfileIDRVal, call-type=CALLBACK, execution-context=TASK
    Rte_COMCbk_ComISignal_BCAN_ICU_02_200ms_Warn_AsstDrSwSta: service-id=0x95, role=Rte_COMCbk_ComISignal_BCAN_ICU_02_200ms_Warn_AsstDrSwSta, call-type=CALLBACK, execution-context=TASK
    Rte_COMCbk_ComISignal_BCAN_ICU_02_200ms_Warn_DrvDrSwSta: service-id=0x95, role=Rte_COMCbk_ComISignal_BCAN_ICU_02_200ms_Warn_DrvDrSwSta, call-type=CALLBACK, execution-context=TASK
    Rte_COMCbk_ComISignal_BCAN_ICU_02_200ms_Warn_RrLftDrSwSta: service-id=0x95, role=Rte_COMCbk_ComISignal_BCAN_ICU_02_200ms_Warn_RrLftDrSwSta, call-type=CALLBACK, execution-context=TASK
    Rte_COMCbk_ComISignal_BCAN_ICU_02_200ms_Warn_RrRtDrSwSta: service-id=0x95, role=Rte_COMCbk_ComISignal_BCAN_ICU_02_200ms_Warn_RrRtDrSwSta, call-type=CALLBACK, execution-context=TASK
    Rte_COMCbk_ComISignal_BCAN_SBCM_AST_02_200ms_Warn_AsstDrSwSta_SBCM: service-id=0x95, role=Rte_COMCbk_ComISignal_BCAN_SBCM_AST_02_200ms_Warn_AsstDrSwSta_SBCM, call-type=CALLBACK, execution-context=TASK
    Rte_COMCbk_ComISignal_BCAN_SBCM_DRV_01_200ms_Latch_TypeOption_DRV: service-id=0x95, role=Rte_COMCbk_ComISignal_BCAN_SBCM_DRV_01_200ms_Latch_TypeOption_DRV, call-type=CALLBACK, execution-context=TASK
    Rte_COMCbk_ComISignal_BCAN_SBCM_DRV_01_200ms_Warn_DrvDrSwSta_SBCM: service-id=0x95, role=Rte_COMCbk_ComISignal_BCAN_SBCM_DRV_01_200ms_Warn_DrvDrSwSta_SBCM, call-type=CALLBACK, execution-context=TASK
    Rte_COMCbk_ComISignal_BCAN_SBCM_RL_01_200ms_Warn_RrLftDrSwSta_SBCM: service-id=0x95, role=Rte_COMCbk_ComISignal_BCAN_SBCM_RL_01_200ms_Warn_RrLftDrSwSta_SBCM, call-type=CALLBACK, execution-context=TASK
    Rte_COMCbk_ComISignal_BCAN_SBCM_RR_01_200ms_Warn_RrRtDrSwSta_SBCM: service-id=0x95, role=Rte_COMCbk_ComISignal_BCAN_SBCM_RR_01_200ms_Warn_RrRtDrSwSta_SBCM, call-type=CALLBACK, execution-context=TASK
    Rte_COMCbk_ComISignal_BCAN_SMK_06_200ms_LFAnt_SrchSta: service-id=0x95, role=Rte_COMCbk_ComISignal_BCAN_SMK_06_200ms_LFAnt_SrchSta, call-type=CALLBACK, execution-context=TASK
    Rte_COMCbk_ComISignal_BCAN_VCU_01_10ms_1_VCU_EvDrvRdySta: service-id=0x95, role=Rte_COMCbk_ComISignal_BCAN_VCU_01_10ms_1_VCU_EvDrvRdySta, call-type=CALLBACK, execution-context=TASK
    Rte_COMCbk_ComISignal_BCAN_WPC2_01_200ms_WPC2_IndSyncVal: service-id=0x95, role=Rte_COMCbk_ComISignal_BCAN_WPC2_01_200ms_WPC2_IndSyncVal, call-type=CALLBACK, execution-context=TASK
    Rte_COMCbk_ComISignal_BCAN_WPC_01_200ms_USM_CmdWPCIndSta: service-id=0x95, role=Rte_COMCbk_ComISignal_BCAN_WPC_01_200ms_USM_CmdWPCIndSta, call-type=CALLBACK, execution-context=TASK
    Rte_COMCbk_ComISignal_BCAN_WPC_01_200ms_WPC_IndSyncVal: service-id=0x95, role=Rte_COMCbk_ComISignal_BCAN_WPC_01_200ms_WPC_IndSyncVal, call-type=CALLBACK, execution-context=TASK
  bsw module description BswModuleDescription_0: provided-entrys=[Rte_Start, Rte_Stop, SchM_Init, SchM_Deinit, SchM_GetVersionInfo]
    bsw module dependency BswModuleDependency_0: target-module-id=2, required-entrys=[Rte_Start, Rte_Stop, SchM_Init, SchM_Deinit, SchM_GetVersionInfo]
    bsw module dependency BswModuleDependency_1: target-module-id=50
      expected-callbacks:
        Rte_COMCbkRxTOut_ComISignal_BCAN_BCM_07_200ms_Lamp_IntTailLmpOnReq
        Rte_COMCbkRxTOut_ComISignal_BCAN_BCM_12_200ms_BCM_SmkOptTyp
        Rte_COMCbkRxTOut_ComISignal_BCAN_CLU_01_20ms_1_CLU_DtntOutSta
        Rte_COMCbkRxTOut_ComISignal_BCAN_CLU_01_20ms_2_CLU_AutoBrightSta
        Rte_COMCbkRxTOut_ComISignal_BCAN_EMS_02_10ms_1_ENG_EngSta
        Rte_COMCbkRxTOut_ComISignal_BCAN_EMS_07_10ms_2_HEV_EngOpSta
        Rte_COMCbkRxTOut_ComISignal_BCAN_HCU_03_10ms_2_HCU_HevRdySta
        Rte_COMCbkRxTOut_ComISignal_BCAN_HU_GW_PE_01_CF_AVN_ProfileIDRValue
        Rte_COMCbkRxTOut_ComISignal_BCAN_IAU_16_200ms_IAU_ProfileIDRVal
        Rte_COMCbkRxTOut_ComISignal_BCAN_ICU_02_200ms_Warn_AsstDrSwSta
        Rte_COMCbkRxTOut_ComISignal_BCAN_ICU_02_200ms_Warn_RrLftDrSwSta
        Rte_COMCbkRxTOut_ComISignal_BCAN_SBCM_AST_02_200ms_Warn_AsstDrSwSta_SBCM
        Rte_COMCbkRxTOut_ComISignal_BCAN_SBCM_DRV_01_200ms_Warn_DrvDrSwSta_SBCM
        Rte_COMCbkRxTOut_ComISignal_BCAN_SBCM_RL_01_200ms_Warn_RrLftDrSwSta_SBCM
        Rte_COMCbkRxTOut_ComISignal_BCAN_SBCM_RR_01_200ms_Warn_RrRtDrSwSta_SBCM
        Rte_COMCbkRxTOut_ComISignal_BCAN_SMK_06_200ms_LFAnt_SrchSta
        Rte_COMCbkRxTOut_ComISignal_BCAN_VCU_01_10ms_1_VCU_EvDrvRdySta
        Rte_COMCbkRxTOut_ComISignal_BCAN_WPC2_01_200ms_WPC2_IndSyncVal
        Rte_COMCbkRxTOut_ComISignal_BCAN_WPC_01_200ms_USM_CmdWPCIndSta
        Rte_COMCbkRxTOut_ComISignal_BCAN_WPC_01_200ms_WPC_IndSyncVal
        Rte_COMCbk_ComISignal_BCAN_ATS_00_00ms_ATS_RWPC_RWPCNValueSet
        Rte_COMCbk_ComISignal_BCAN_BCM_07_200ms_Lamp_IntTailLmpOnReq
        Rte_COMCbk_ComISignal_BCAN_BCM_12_200ms_BCM_SmkOptTyp
        Rte_COMCbk_ComISignal_BCAN_CLU_01_20ms_1_CLU_DtntOutSta
        Rte_COMCbk_ComISignal_BCAN_CLU_01_20ms_1_CLU_RhstaLvlSta
        Rte_COMCbk_ComISignal_BCAN_CLU_01_20ms_2_CLU_AutoBrightSta
        Rte_COMCbk_ComISignal_BCAN_CLU_01_20ms_2_CLU_DisSpdVal_KPH
        Rte_COMCbk_ComISignal_BCAN_EMS_02_10ms_1_ENG_EngSta
        Rte_COMCbk_ComISignal_BCAN_EMS_07_10ms_2_HEV_EngOpSta
        Rte_COMCbk_ComISignal_BCAN_HCU_03_10ms_2_HCU_HevRdySta
        Rte_COMCbk_ComISignal_BCAN_HU_GW_PE_01_CF_AVN_ProfileIDRValue
        Rte_COMCbk_ComISignal_BCAN_HU_USM_E_02_CF_Gway_RWPCNValueSet
        Rte_COMCbk_ComISignal_BCAN_HU_USM_E_04_CF_AVN_CluUSMReset
        Rte_COMCbk_ComISignal_BCAN_HU_USM_E_14_CF_Gway_WPCAnimationNvalueSet
        Rte_COMCbk_ComISignal_BCAN_IAU_16_200ms_IAU_ProfileIDRVal
        Rte_COMCbk_ComISignal_BCAN_ICU_02_200ms_Warn_AsstDrSwSta
        Rte_COMCbk_ComISignal_BCAN_ICU_02_200ms_Warn_DrvDrSwSta
        Rte_COMCbk_ComISignal_BCAN_ICU_02_200ms_Warn_RrLftDrSwSta
        Rte_COMCbk_ComISignal_BCAN_ICU_02_200ms_Warn_RrRtDrSwSta
        Rte_COMCbk_ComISignal_BCAN_SBCM_AST_02_200ms_Warn_AsstDrSwSta_SBCM
        Rte_COMCbk_ComISignal_BCAN_SBCM_DRV_01_200ms_Latch_TypeOption_DRV
        Rte_COMCbk_ComISignal_BCAN_SBCM_DRV_01_200ms_Warn_DrvDrSwSta_SBCM
        Rte_COMCbk_ComISignal_BCAN_SBCM_RL_01_200ms_Warn_RrLftDrSwSta_SBCM
        Rte_COMCbk_ComISignal_BCAN_SBCM_RR_01_200ms_Warn_RrRtDrSwSta_SBCM
        Rte_COMCbk_ComISignal_BCAN_SMK_06_200ms_LFAnt_SrchSta
        Rte_COMCbk_ComISignal_BCAN_VCU_01_10ms_1_VCU_EvDrvRdySta
        Rte_COMCbk_ComISignal_BCAN_WPC2_01_200ms_WPC2_IndSyncVal
        Rte_COMCbk_ComISignal_BCAN_WPC_01_200ms_USM_CmdWPCIndSta
        Rte_COMCbk_ComISignal_BCAN_WPC_01_200ms_WPC_IndSyncVal
    bsw internal behavior BswInternalBehavior_0
      static-memorys:
        52 x data:
          Rte_GucDcmApplicationUpdated_CurrentMode_modeSwitchPort_DcmApplicationUpdatedBswM: type=uint8
          Rte_GucCanSMState_BCAN_OldMode_modeSwitchPort_CanSMState_BCANBswM: type=uint8
          Rte_GucInitState_NewMode_modeSwitchPort_InitStateBswM: type=uint8
          Rte_GucDcmCommunicationControl_0_CurrentMode_modeSwitchPort_DcmCommunicationControl_0BswM: type=uint8
          Rte_GucPduGroupTx_BCAN_OldMode_modeSwitchPort_PduGroupTx_BCANBswM: type=uint8
          Rte_GuccurrentMode_CurrentMode_mode_SE_WdgMELS_02WdgM: type=uint8
          Rte_GucEcuMode_OldMode_modeSwitchPort_EcuModeBswM: type=EcuM_StateType
          Rte_GucComMMode_BCAN_CurrentMode_modeSwitchPort_ComMMode_BCANBswM: type=uint8
          Rte_GucWakeupEvent_CurrentMode_modeSwitchPort_WakeupEventBswM: type=uint8
          Rte_GucCanSMBORState_LOCALCAN_CurrentMode_modeSwitchPort_CanSMBORState_LOCALCANBswM: type=uint8
          Rte_GucPduGroupRx_BCAN_CurrentMode_modeSwitchPort_PduGroupRx_BCANBswM: type=uint8
          Rte_GucDcmDiagnosticSessionControl_CurrentMode_modeSwitchPort_DcmDiagnosticSessionControlBswM: type=uint8
          Rte_GucPduGroupRx_LOCALCAN_CurrentMode_modeSwitchPort_PduGroupRx_LOCALCANBswM: type=uint8
          Rte_GucCanSMState_BCAN_NewMode_modeSwitchPort_CanSMState_BCANBswM: type=uint8
          Rte_GucPduGroupRx_BCAN_NewMode_modeSwitchPort_PduGroupRx_BCANBswM: type=uint8
          Rte_GucDcmDiagnosticSessionControl_OldMode_modeSwitchPort_DcmDiagnosticSessionControlBswM: type=uint8
          Rte_GucCanSMState_LOCALCAN_CurrentMode_modeSwitchPort_CanSMState_LOCALCANBswM: type=uint8
          Rte_GucPduGroupTx_BCAN_CurrentMode_modeSwitchPort_PduGroupTx_BCANBswM: type=uint8
          Rte_GuccurrentMode_CurrentMode_globalModeWdgM: type=uint8
          Rte_GuccurrentMode_CurrentMode_UM000_PComM: type=ComM_ModeType
          Rte_GucPduGroupRx_BCAN_OldMode_modeSwitchPort_PduGroupRx_BCANBswM: type=uint8
          Rte_GuccurrentMode_OldMode_globalModeWdgM: type=uint8
          Rte_GucCanSMBORState_BCAN_NewMode_modeSwitchPort_CanSMBORState_BCANBswM: type=uint8
          Rte_GucComMMode_BCAN_NewMode_modeSwitchPort_ComMMode_BCANBswM: type=uint8
          Rte_GuccurrentMode_NewMode_globalModeWdgM: type=uint8
          Rte_GucPduGroupTx_LOCALCAN_CurrentMode_modeSwitchPort_PduGroupTx_LOCALCANBswM: type=uint8
          Rte_GucDcmModeRapidPowerShutDown_CurrentMode_modeSwitchPort_DcmModeRapidPowerShutDownBswM: type=uint8
          Rte_GucCanSMState_BCAN_CurrentMode_modeSwitchPort_CanSMState_BCANBswM: type=uint8
          Rte_GuccurrentMode_CurrentMode_mode_SE_InitWdgM: type=uint8
          Rte_GucDcmApplicationUpdated_CurrentMode_modeNotificationPort_ApplicationUpdatedSWC_DiagnosticService: type=uint8
          Rte_GucDcmDiagnosticSessionControl_NewMode_modeSwitchPort_DcmDiagnosticSessionControlBswM: type=uint8
          Rte_GucCanSMBORState_LOCALCAN_CurrentMode_modeNotificationPort_CanSMBORState_LOCALCANSWC_AppMode: type=uint8
          Rte_GucComMMode_BCAN_OldMode_modeSwitchPort_ComMMode_BCANBswM: type=uint8
          Rte_GucDcmControlDTCSetting_CurrentMode_modeSwitchPort_DcmControlDTCSettingBswM: type=uint8
          Rte_GuccurrentMode_CurrentMode_mode_SE_WdgMELS_01WdgM: type=uint8
          Rte_GucCanSMBORState_BCAN_CurrentMode_modeSwitchPort_CanSMBORState_BCANBswM: type=uint8
          Rte_GucDcmCommunicationControl_1_CurrentMode_modeSwitchPort_DcmCommunicationControl_1BswM: type=uint8
          Rte_GucEcuMode_CurrentMode_modeSwitchPort_EcuModeBswM: type=EcuM_StateType
          Rte_GucComMMode_LOCALCAN_CurrentMode_modeNotificationPort_ComMMode_LOCALCANSWC_AppMode: type=uint8
          Rte_GucComMMode_LOCALCAN_CurrentMode_modeSwitchPort_ComMMode_LOCALCANBswM: type=uint8
          Rte_GuccurrentMode_CurrentMode_UM002_PComM: type=ComM_ModeType
          Rte_GucPduGroupRx_LOCALCAN_CurrentMode_modeNotificationPort_PduGroupRx_LOCALCANSWC_AppMode: type=uint8
          Rte_GucWakeupEvent_NewMode_modeSwitchPort_WakeupEventBswM: type=uint8
          Rte_GucInitState_OldMode_modeSwitchPort_InitStateBswM: type=uint8
          Rte_GucCanSMBORState_BCAN_OldMode_modeSwitchPort_CanSMBORState_BCANBswM: type=uint8
          Rte_GuccurrentMode_CurrentMode_mode_SE_WdgMTestWdgM: type=uint8
          Rte_GucInitState_CurrentMode_modeSwitchPort_InitStateBswM: type=uint8
          Rte_GucWakeupEvent_OldMode_modeSwitchPort_WakeupEventBswM: type=uint8
          Rte_GucPduGroupTx_BCAN_NewMode_modeSwitchPort_PduGroupTx_BCANBswM: type=uint8
          Rte_GucEcuMode_NewMode_modeSwitchPort_EcuModeBswM: type=EcuM_StateType
          Rte_GuccurrentMode_CurrentMode_UM001_PComM: type=ComM_ModeType
          Rte_GucPduGroupTx_LOCALCAN_CurrentMode_modeNotificationPort_PduGroupTx_LOCALCANSWC_AppMode: type=uint8
      5 x bsw called entity:
        BswCalledEntity_0: implemented-entry=Rte_Start
        BswCalledEntity_1: implemented-entry=Rte_Stop
        BswCalledEntity_3: implemented-entry=SchM_Init
        BswCalledEntity_4: implemented-entry=SchM_Deinit
        BswCalledEntity_5: implemented-entry=SchM_GetVersionInfo
  impl type Std_VersionInfoType: category=DATA_REFERENCE
    5 x element:
      vendorID: base-type=uint16
      moduleID: base-type=uint16
      sw_major_version: base-type=uint8
      sw_minor_version: base-type=uint8
      sw_patch_version: base-type=uint8

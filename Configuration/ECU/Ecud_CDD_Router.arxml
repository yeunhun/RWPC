AUTOSAR XML (schema 4-1-2)
package /CDD
  module config CDD_RouterIF: definition=Cdd, module-description=BswImplementation_CDD_RouterIF
    CddComStackContribution
      CddComIfUpperLayerContribution: category=TOOL_CONFIGURED
      CddSoAdUpperLayerContribution: category=TOOL_CONFIGURED
      CddPduRLowerLayerContribution: category=TOOL_CONFIGURED
  module config CDD_RouterTP: definition=Cdd, module-description=BswImplementation_CDD_RouterTP
    CddComStackContribution
      CddPduRLowerLayerContribution: category=TOOL_CONFIGURED

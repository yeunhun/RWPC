AUTOSAR XML (schema 4-1-2)
package /AUTOSAR
  module config RomTst: implementation-config-variant=VARIANT-PRE-COMPILE, module-description=BswImplementation_RomTst
    RomTstGeneral: RomTstTestCompletedNotificationSupported=1, RomTstDevErrorDetect=1
    RomTstConfigSet: RomTstTestCompletedNotification=RomTst_TestCompletedNotification
      RomTstBlockFgnd_RomTst (RomTstBlockFgnd): RomTstTestAlgorithm=FLSTST_16BIT_CRC, RomTstFgndBlockIndex=0, RomTstCrcAreaAddressFirst=0x10048d0c
      RomTstBlockBgnd_FBL (RomTstBlockBgnd): RomTstTestAlgorithm=FLSTST_16BIT_CRC, RomTstBgndBlockIndex=0, RomTstCrcAreaAddressFirst=0x10028210
      RomTstBlockBgnd_ASW (RomTstBlockBgnd): RomTstTestAlgorithm=FLSTST_16BIT_CRC, RomTstCrcAreaAddressFirst=0x10048810, RomTstBgndBlockIndex=1

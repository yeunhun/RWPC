AUTOSAR XML (schema 4-0-3)
package /AUTOSAR
  module config Rte: implementation-config-variant=VARIANT-PRE-COMPILE
    CommonPublishedInformation0 (CommonPublishedInformation): ArReleaseVersion=4.0.3, ModuleId=2, SwVersion=4.10.6, VendorId=76
    RteBswGeneral0 (RteBswGeneral): RteSchMVersionInfoApi=0, RteUseComShadowSignalApi=1
    RteGeneration0 (RteGeneration):
      RteCalibrationSupport = INITIALIZED_RAM
      RteDevErrorDetectUninit = 0
      RteGenerationMode = COMPATIBILITY_MODE
      RteMeasurementSupport = 0
      RteOptimizationMode = RUNTIME
      RteToolChainSignificantCharacters = 100
      RteValueRangeCheckEnabled = 0
      RteVfbTraceEnabled = 0
      RteIocInteractionReturnValue = RTE_IOC
      RteDevErrorDetect = 0
    RteInitializationBehavior0 (RteInitializationBehavior): RteSectionInitializationPolicy=INIT
    RtePostBuildVariantConfiguration
    RteOsInteraction0 (RteOsInteraction): SynchronizedActivateOffset=1, RteSynchronizedOsCounterRef=OsCounter_0
      4 x RteUsedOsActivation, all with AlarmSetMethodIsRelative=1:
        RteUsedOsActivation_BSW_5ms_Com: RteExpectedActivationOffset=0.0025, RteExpectedActivationPosition=1, RteActivationOsAlarmRef=OsAlarm_BSW_5ms_Com
        RteUsedOsActivation_BSW_10ms: RteExpectedActivationOffset=0.005, RteExpectedActivationPosition=2, RteActivationOsAlarmRef=OsAlarm_BSW_10ms
        RteUsedOsActivation_ASW_10ms: RteExpectedActivationOffset=0.00375, RteExpectedActivationPosition=3, RteActivationOsAlarmRef=OsAlarm_ASW_10ms
        RteUsedOsActivation_ASW_100ms: RteExpectedActivationOffset=0.01875, RteExpectedActivationPosition=5, RteActivationOsAlarmRef=OsAlarm_ASW_100ms
    37 x RteBswModuleInstance, all with category=TOOL_CONFIGURED:
      BswInstance_Wdg_76_Acw: RteBswModuleConfigurationRef=Wdg_76_Acw, RteBswImplementationRef=BswImplementation_Wdg_76_Acw
        WDG_EXCLUSIVE_AREA (RteBswExclusiveAreaImpl): category=TOOL_CONFIGURED, RteExclusiveAreaImplMechanism=ALL_INTERRUPT_BLOCKING, RteBswExclusiveAreaRef=WDG_EXCLUSIVE_AREA
      BswInstance_Mcu: RteBswModuleConfigurationRef=Mcu, RteBswImplementationRef=McuImplementation
        MCU_EXCLUSIVE_AREA_0 (RteBswExclusiveAreaImpl): category=TOOL_CONFIGURED, RteExclusiveAreaImplMechanism=ALL_INTERRUPT_BLOCKING, RteBswExclusiveAreaRef=MCU_EXCLUSIVE_AREA_0
      BswInstance_CanIf: RteBswModuleConfigurationRef=CanIf, RteBswImplementationRef=BswImplementation_CanIf
        7 x RteBswExclusiveAreaImpl, all with category=TOOL_CONFIGURED, RteExclusiveAreaImplMechanism=ALL_INTERRUPT_BLOCKING:
          MODE_STATUS_PROTECTION: RteBswExclusiveAreaRef=MODE_STATUS_PROTECTION
          TX_QUEUE_PROTECTION: RteBswExclusiveAreaRef=TX_QUEUE_PROTECTION
          ExclusiveArea_0: RteBswExclusiveAreaRef=ExclusiveArea_0
          RX_NOTIFSTATUS_PROTECTION: RteBswExclusiveAreaRef=RX_NOTIFSTATUS_PROTECTION
          RX_DATA_PROTECTION: RteBswExclusiveAreaRef=RX_DATA_PROTECTION
          TX_DYNCANID_PROTECTION: RteBswExclusiveAreaRef=TX_DYNCANID_PROTECTION
          TX_NOTIFSTATUS_PROTECTION: RteBswExclusiveAreaRef=TX_NOTIFSTATUS_PROTECTION
      BswInstance_Det: RteBswModuleConfigurationRef=Det, RteBswImplementationRef=BswImplementation_Det
        RAM_DATA_PROTECTION (RteBswExclusiveAreaImpl): category=TOOL_CONFIGURED, RteExclusiveAreaImplMechanism=ALL_INTERRUPT_BLOCKING, RteBswExclusiveAreaRef=RAM_DATA_PROTECTION
      BswInstance_Nm: RteBswModuleConfigurationRef=Nm, RteBswImplementationRef=BswImplementation_Nm
        UPDATE_NETWORK_STATUS_NW0 (RteBswExclusiveAreaImpl): category=TOOL_CONFIGURED, RteExclusiveAreaImplMechanism=ALL_INTERRUPT_BLOCKING, RteBswExclusiveAreaRef=UPDATE_NETWORK_STATUS_NW0
        UPDATE_NETWORK_STATUS_NW1 (RteBswExclusiveAreaImpl): category=TOOL_CONFIGURED, RteExclusiveAreaImplMechanism=ALL_INTERRUPT_BLOCKING, RteBswExclusiveAreaRef=UPDATE_NETWORK_STATUS_NW1
      BswInstance_Com: RteBswModuleConfigurationRef=Com, RteBswImplementationRef=BswImplementation_Com
        21 x RteBswExclusiveAreaImpl, all with category=TOOL_CONFIGURED, RteExclusiveAreaImplMechanism=ALL_INTERRUPT_BLOCKING:
          RX_DM_STS_PROTECTION_AREA: RteBswExclusiveAreaRef=RX_DM_STS_PROTECTION_AREA
          RX_IPDU_STS_PROTECTION_AREA: RteBswExclusiveAreaRef=RX_IPDU_STS_PROTECTION_AREA
          TX_IPDU_STATUS_PROTECTION_AREA: RteBswExclusiveAreaRef=TX_IPDU_STATUS_PROTECTION_AREA
          TX_IPDU_DATA_PROTECTION: RteBswExclusiveAreaRef=TX_IPDU_DATA_PROTECTION
          TX_MDT_PROTECTION_AREA: RteBswExclusiveAreaRef=TX_MDT_PROTECTION_AREA
          RX_IPDU_STATUS_PROTECTION_AREA: RteBswExclusiveAreaRef=RX_IPDU_STATUS_PROTECTION_AREA
          RX_GW_STS_PROTECTION_AREA: RteBswExclusiveAreaRef=RX_GW_STS_PROTECTION_AREA
          SIG_DATA_PROTECTION_AREA: RteBswExclusiveAreaRef=SIG_DATA_PROTECTION_AREA
          RX_SIG_DATA_PROTECTION_AREA: RteBswExclusiveAreaRef=RX_SIG_DATA_PROTECTION_AREA
          RX_IPDU_DATA_PROTECTION_AREA: RteBswExclusiveAreaRef=RX_IPDU_DATA_PROTECTION_AREA
          IPDU_GRP_STS_PROTECTION: RteBswExclusiveAreaRef=IPDU_GRP_STS_PROTECTION
          IPDU_STS_PROTECTION: RteBswExclusiveAreaRef=IPDU_STS_PROTECTION
          RX_EXT_SIG_DATA_PROTECTION_AREA: RteBswExclusiveAreaRef=RX_EXT_SIG_DATA_PROTECTION_AREA
          TX_EXT_SIG_DATA_PROTECTION_AREA: RteBswExclusiveAreaRef=TX_EXT_SIG_DATA_PROTECTION_AREA
          TX_IPDU_BUFFER_PROTECTION_AREA: RteBswExclusiveAreaRef=TX_IPDU_BUFFER_PROTECTION_AREA
          RX_FIFO_PROTECTION_AREA: RteBswExclusiveAreaRef=RX_FIFO_PROTECTION_AREA
          IPDU_GROUP_STATUS_PROTECTION: RteBswExclusiveAreaRef=IPDU_GROUP_STATUS_PROTECTION
          IPDU_COUNTER_PROTECTION: RteBswExclusiveAreaRef=IPDU_COUNTER_PROTECTION
          TX_TMS_STATUS_PROTECTION_AREA: RteBswExclusiveAreaRef=TX_TMS_STATUS_PROTECTION_AREA
          TX_MDT_STS_PROTECTION_AREA: RteBswExclusiveAreaRef=TX_MDT_STS_PROTECTION_AREA
          TX_DM_STS_PROTECTION_AREA: RteBswExclusiveAreaRef=TX_DM_STS_PROTECTION_AREA
        3 x RteBswEventToTaskMapping, all with category=TOOL_CONFIGURED, RteBswImmediateRestart=0, RteBswMappedToTaskRef=OsTask_BSW_FG1_5ms_Com, RteBswUsedOsAlarmRef=OsAlarm_BSW_5ms_Com:
          BswTE_Com_MainFunctionRx: RteBswPositionInTask=35, RteBswEventRef=BswTE_Com_MainFunctionRx
          BswTE_Com_MainFunctionRouteSignals: RteBswPositionInTask=36, RteBswEventRef=BswTE_Com_MainFunctionRouteSignals
          BswTE_Com_MainFunctionTx: RteBswPositionInTask=37, RteBswEventRef=BswTE_Com_MainFunctionTx
      BswInstance_Crc: RteBswModuleConfigurationRef=Crc, RteBswImplementationRef=BswImplementation_Crc
        CriticalSection (RteBswExclusiveAreaImpl): category=TOOL_CONFIGURED, RteExclusiveAreaImplMechanism=ALL_INTERRUPT_BLOCKING, RteBswExclusiveAreaRef=CriticalSection
      BswInstance_WdgM: RteBswModuleConfigurationRef=WdgM, RteBswImplementationRef=BswImplementation_WdgM
        GLOBALSUPVSNSTATUS_PROTECTION (RteBswExclusiveAreaImpl): category=TOOL_CONFIGURED, RteExclusiveAreaImplMechanism=ALL_INTERRUPT_BLOCKING, RteBswExclusiveAreaRef=GLOBALSUPVSNSTATUS_PROTECTION
        BswTE_WdgM_MainFunction (RteBswEventToTaskMapping):
          category = TOOL_CONFIGURED
          RteBswImmediateRestart = 0
          RteBswPositionInTask = 1
          RteBswEventRef = BswTE_WdgM_MainFunction
          RteBswMappedToTaskRef = OsTask_BSW_FG1_10ms
          RteBswUsedOsAlarmRef = OsAlarm_BSW_10ms
        modeNotificationPort_EcuMode (RteBswRequiredModeGroupConnection):
          category = TOOL_CONFIGURED
          RteBswRequiredModeGroupRef = modeNotificationPort_EcuMode
          RteBswProvidedModeGroupRef = modeSwitchPort_EcuMode
          RteBswProvidedModeGrpModInstRef = BswInstance_BswM
      BswInstance_Wdg: RteBswModuleConfigurationRef=Wdg, RteBswImplementationRef=WdgImplementation
        WDG_EXCLUSIVE_AREA_0 (RteBswExclusiveAreaImpl): category=TOOL_CONFIGURED, RteExclusiveAreaImplMechanism=ALL_INTERRUPT_BLOCKING, RteBswExclusiveAreaRef=WDG_EXCLUSIVE_AREA_0
      BswInstance_Dem: RteBswModuleConfigurationRef=Dem, RteBswImplementationRef=BswImplementation_Dem
        10 x RteBswExclusiveAreaImpl, all with category=TOOL_CONFIGURED, RteExclusiveAreaImplMechanism=ALL_INTERRUPT_BLOCKING:
          REQUEST_BUFFER_PROTECTION: RteBswExclusiveAreaRef=REQUEST_BUFFER_PROTECTION
          REQUEST_RECORD_PROTECTION: RteBswExclusiveAreaRef=REQUEST_RECORD_PROTECTION
          REQUEST_STATUS_PROTECTION: RteBswExclusiveAreaRef=REQUEST_STATUS_PROTECTION
          REQUEST_OCC_PROTECTION: RteBswExclusiveAreaRef=REQUEST_OCC_PROTECTION
          REQUEST_OCCTIME_PROTECTION: RteBswExclusiveAreaRef=REQUEST_OCCTIME_PROTECTION
          REQUEST_NVDATA_PROTECTION: RteBswExclusiveAreaRef=REQUEST_NVDATA_PROTECTION
          CAPTURE_OBD_DATA: RteBswExclusiveAreaRef=CAPTURE_OBD_DATA
          REQUEST_DATA_PROTECTION: RteBswExclusiveAreaRef=REQUEST_DATA_PROTECTION
          REQUEST_DEBOUNCETIMEBASED: RteBswExclusiveAreaRef=REQUEST_DEBOUNCETIMEBASED
          REQUEST_BEFOREOS_PROTECTION: RteBswExclusiveAreaRef=REQUEST_BEFOREOS_PROTECTION
        BswTE_Dem_MainFunction (RteBswEventToTaskMapping):
          category = TOOL_CONFIGURED
          RteBswImmediateRestart = 0
          RteBswPositionInTask = 5
          RteBswEventRef = BswTE_Dem_MainFunction
          RteBswMappedToTaskRef = OsTask_BSW_FG1_10ms
          RteBswUsedOsAlarmRef = OsAlarm_BSW_10ms
      BswInstance_NvM: RteBswModuleConfigurationRef=NvM, RteBswImplementationRef=BswImplementation_NvM
        RAM_INDEX (RteBswExclusiveAreaImpl): category=TOOL_CONFIGURED, RteExclusiveAreaImplMechanism=ALL_INTERRUPT_BLOCKING, RteBswExclusiveAreaRef=RAM_INDEX
        RAM_STATUS_PROTECTION (RteBswExclusiveAreaImpl): category=TOOL_CONFIGURED, RteExclusiveAreaImplMechanism=ALL_INTERRUPT_BLOCKING, RteBswExclusiveAreaRef=RAM_STATUS_PROTECTION
      BswInstance_Can: RteBswModuleConfigurationRef=Can, RteBswImplementationRef=CanImplementation
        CAN_EXCLUSIVE_AREA_0 (RteBswExclusiveAreaImpl): category=TOOL_CONFIGURED, RteExclusiveAreaImplMechanism=ALL_INTERRUPT_BLOCKING, RteBswExclusiveAreaRef=CAN_EXCLUSIVE_AREA_0
      BswInstance_CanSM: RteBswModuleConfigurationRef=CanSM, RteBswImplementationRef=BswImplementation_CanSM
        MODE_STATUS_PROTECTION (RteBswExclusiveAreaImpl): category=TOOL_CONFIGURED, RteExclusiveAreaImplMechanism=ALL_INTERRUPT_BLOCKING, RteBswExclusiveAreaRef=MODE_STATUS_PROTECTION
        BUSOFF_STATUS_PROTECTION (RteBswExclusiveAreaImpl): category=TOOL_CONFIGURED, RteExclusiveAreaImplMechanism=ALL_INTERRUPT_BLOCKING, RteBswExclusiveAreaRef=BUSOFF_STATUS_PROTECTION
        BswTE_CanSM_MainFunction (RteBswEventToTaskMapping):
          category = TOOL_CONFIGURED
          RteBswImmediateRestart = 0
          RteBswPositionInTask = 40
          RteBswEventRef = BswTE_CanSM_MainFunction
          RteBswMappedToTaskRef = OsTask_BSW_FG1_5ms_Com
          RteBswUsedOsAlarmRef = OsAlarm_BSW_5ms_Com
      BswInstance_EcuM: RteBswModuleConfigurationRef=EcuM, RteBswImplementationRef=BswImplementation_EcuM
        7 x RteBswExclusiveAreaImpl, all with category=TOOL_CONFIGURED, RteExclusiveAreaImplMechanism=ALL_INTERRUPT_BLOCKING:
          ALARM_TIME_PROTECTION: RteBswExclusiveAreaRef=ALARM_TIME_PROTECTION
          BOOT_TARGET_PROTECTION: RteBswExclusiveAreaRef=BOOT_TARGET_PROTECTION
          SHUTDOWN_CAUSE: RteBswExclusiveAreaRef=SHUTDOWN_CAUSE
          SHUTDOWN_OR_SLEEP_FLAG_PROTECTION: RteBswExclusiveAreaRef=SHUTDOWN_OR_SLEEP_FLAG_PROTECTION
          SHUTDOWN_TARGET_PROTECTION: RteBswExclusiveAreaRef=SHUTDOWN_TARGET_PROTECTION
          STATE_PROTECTION: RteBswExclusiveAreaRef=STATE_PROTECTION
          WAKEUP_STATUS_PROTECTION: RteBswExclusiveAreaRef=WAKEUP_STATUS_PROTECTION
        BswTE_EcuM_LoopDetection (RteBswEventToTaskMapping):
          category = TOOL_CONFIGURED
          RteBswImmediateRestart = 0
          RteBswPositionInTask = 3
          RteBswEventRef = BswTE_EcuM_LoopDetection
          RteBswMappedToTaskRef = OsTask_BSW_FG1_10ms
          RteBswUsedOsAlarmRef = OsAlarm_BSW_10ms
        BswTE_EcuM_MainFunction (RteBswEventToTaskMapping):
          category = TOOL_CONFIGURED
          RteBswImmediateRestart = 0
          RteBswPositionInTask = 2
          RteBswEventRef = BswTE_EcuM_MainFunction
          RteBswMappedToTaskRef = OsTask_BSW_FG1_10ms
          RteBswUsedOsAlarmRef = OsAlarm_BSW_10ms
      BswInstance_BswM: RteBswModuleConfigurationRef=BswM, RteBswImplementationRef=BswImplementation_BswM
        3 x RteBswExclusiveAreaImpl, all with category=TOOL_CONFIGURED, RteExclusiveAreaImplMechanism=ALL_INTERRUPT_BLOCKING:
          DATA_PROTECTION: RteBswExclusiveAreaRef=DATA_PROTECTION
          RULEPREVRESULT_PROTECTION: RteBswExclusiveAreaRef=RULEPREVRESULT_PROTECTION
          RULESTATUS_PROTECTION: RteBswExclusiveAreaRef=RULESTATUS_PROTECTION
        22 x RteBswEventToTaskMapping, all with category=TOOL_CONFIGURED, RteBswImmediateRestart=0:
          BMSE_Entry_BswM_Immediate_DcmApplicationUpdated_modeNotificationPort_DcmApplicationUpdated_APP_NOT_UPDATED: RteBswPositionInTask=0, RteBswEventRef=BMSE_Entry_BswM_Immediate_DcmApplicationUpdated_modeNotificationPort_DcmApplicationUpdated_APP_NOT_UPDATED
          BMSE_Entry_BswM_Immediate_DcmApplicationUpdated_modeNotificationPort_DcmApplicationUpdated_APP_UPDATED: RteBswPositionInTask=0, RteBswEventRef=BMSE_Entry_BswM_Immediate_DcmApplicationUpdated_modeNotificationPort_DcmApplicationUpdated_APP_UPDATED
          BMSE_Entry_BswM_Immediate_DcmControlDTCSetting_modeNotificationPort_DcmControlDTCSetting_DISABLEDTCSETTING: RteBswPositionInTask=1, RteBswEventRef=BMSE_Entry_BswM_Immediate_DcmControlDTCSetting_modeNotificationPort_DcmControlDTCSetting_DISABLEDTCSETTING
          BMSE_Entry_BswM_Immediate_DcmControlDTCSetting_modeNotificationPort_DcmControlDTCSetting_ENABLEDTCSETTING: RteBswPositionInTask=2, RteBswEventRef=BMSE_Entry_BswM_Immediate_DcmControlDTCSetting_modeNotificationPort_DcmControlDTCSetting_ENABLEDTCSETTING
          BMSE_Entry_BswM_Immediate_DcmDiagnosticSessionControl_modeNotificationPort_DcmDiagnosticSessionControl_DCM_DEFAULT_SESSION: RteBswPositionInTask=3, RteBswEventRef=BMSE_Entry_BswM_Immediate_DcmDiagnosticSessionControl_modeNotificationPort_DcmDiagnosticSessionControl_DCM_DEFAULT_SESSION
          BMSE_Entry_BswM_Immediate_DcmDiagnosticSessionControl_modeNotificationPort_DcmDiagnosticSessionControl_DCM_ECU_PROGRAMMING_MODE: RteBswPositionInTask=4, RteBswEventRef=BMSE_Entry_BswM_Immediate_DcmDiagnosticSessionControl_modeNotificationPort_DcmDiagnosticSessionControl_DCM_ECU_PROGRAMMING_MODE
          BMSE_Entry_BswM_Immediate_DcmDiagnosticSessionControl_modeNotificationPort_DcmDiagnosticSessionControl_DCM_EXTENDED_DIAGNOSTIC_MODE: RteBswPositionInTask=5, RteBswEventRef=BMSE_Entry_BswM_Immediate_DcmDiagnosticSessionControl_modeNotificationPort_DcmDiagnosticSessionControl_DCM_EXTENDED_DIAGNOSTIC_MODE
          BMSE_Entry_BswM_Immediate_DcmDiagnosticSessionControl_modeNotificationPort_DcmDiagnosticSessionControl_DCM_EXTENDED_DIAGNOSTIC_SESSION: RteBswPositionInTask=6, RteBswEventRef=BMSE_Entry_BswM_Immediate_DcmDiagnosticSessionControl_modeNotificationPort_DcmDiagnosticSessionControl_DCM_EXTENDED_DIAGNOSTIC_SESSION
          BMSE_Entry_BswM_Immediate_DcmDiagnosticSessionControl_modeNotificationPort_DcmDiagnosticSessionControl_DCM_PROGRAMMING_SESSION: RteBswPositionInTask=7, RteBswEventRef=BMSE_Entry_BswM_Immediate_DcmDiagnosticSessionControl_modeNotificationPort_DcmDiagnosticSessionControl_DCM_PROGRAMMING_SESSION
          BMSE_Entry_BswM_Immediate_DcmDiagnosticSessionControl_modeNotificationPort_DcmDiagnosticSessionControl_DCM_QUIESCENT_CURRENT_DIAGNOSTIC_MODE_START: RteBswPositionInTask=8, RteBswEventRef=BMSE_Entry_BswM_Immediate_DcmDiagnosticSessionControl_modeNotificationPort_DcmDiagnosticSessionControl_DCM_QUIESCENT_CURRENT_DIAGNOSTIC_MODE_START
          BMSE_Entry_BswM_Immediate_DcmDiagnosticSessionControl_modeNotificationPort_DcmDiagnosticSessionControl_DCM_SAFETY_SYSTEM_DIAGNOSTIC_SESSION: RteBswPositionInTask=9, RteBswEventRef=BMSE_Entry_BswM_Immediate_DcmDiagnosticSessionControl_modeNotificationPort_DcmDiagnosticSessionControl_DCM_SAFETY_SYSTEM_DIAGNOSTIC_SESSION
          BMSE_Entry_BswM_Immediate_DcmDiagnosticSessionControl_modeNotificationPort_DcmDiagnosticSessionControl_DCM_SLEEP_MODE_START_REQUEST: RteBswPositionInTask=10, RteBswEventRef=BMSE_Entry_BswM_Immediate_DcmDiagnosticSessionControl_modeNotificationPort_DcmDiagnosticSessionControl_DCM_SLEEP_MODE_START_REQUEST
          BMSE_Entry_BswM_Immediate_DcmEcuReset_modeNotificationPort_DcmEcuReset_EXECUTE: RteBswPositionInTask=11, RteBswEventRef=BMSE_Entry_BswM_Immediate_DcmEcuReset_modeNotificationPort_DcmEcuReset_EXECUTE
          BMSE_Entry_BswM_Immediate_DcmEcuReset_modeNotificationPort_DcmEcuReset_HARD: RteBswPositionInTask=12, RteBswEventRef=BMSE_Entry_BswM_Immediate_DcmEcuReset_modeNotificationPort_DcmEcuReset_HARD
          BMSE_Entry_BswM_Immediate_DcmEcuReset_modeNotificationPort_DcmEcuReset_JUMPTOBOOTLOADER: RteBswPositionInTask=13, RteBswEventRef=BMSE_Entry_BswM_Immediate_DcmEcuReset_modeNotificationPort_DcmEcuReset_JUMPTOBOOTLOADER
          BMSE_Entry_BswM_Immediate_DcmEcuReset_modeNotificationPort_DcmEcuReset_JUMPTOSYSSUPPLIERBOOTLOADER: RteBswPositionInTask=14, RteBswEventRef=BMSE_Entry_BswM_Immediate_DcmEcuReset_modeNotificationPort_DcmEcuReset_JUMPTOSYSSUPPLIERBOOTLOADER
          BMSE_Entry_BswM_Immediate_DcmEcuReset_modeNotificationPort_DcmEcuReset_KEYONOFF: RteBswPositionInTask=15, RteBswEventRef=BMSE_Entry_BswM_Immediate_DcmEcuReset_modeNotificationPort_DcmEcuReset_KEYONOFF
          BMSE_Entry_BswM_Immediate_DcmEcuReset_modeNotificationPort_DcmEcuReset_NONE: RteBswPositionInTask=16, RteBswEventRef=BMSE_Entry_BswM_Immediate_DcmEcuReset_modeNotificationPort_DcmEcuReset_NONE
          BMSE_Entry_BswM_Immediate_DcmEcuReset_modeNotificationPort_DcmEcuReset_SOFT: RteBswPositionInTask=17, RteBswEventRef=BMSE_Entry_BswM_Immediate_DcmEcuReset_modeNotificationPort_DcmEcuReset_SOFT
          BMSE_Entry_BswM_Immediate_DcmModeRapidPowerShutDown_modeNotificationPort_DcmModeRapidPowerShutDown_DISABLE_RAPIDPOWERSHUTDOWN: RteBswPositionInTask=18, RteBswEventRef=BMSE_Entry_BswM_Immediate_DcmModeRapidPowerShutDown_modeNotificationPort_DcmModeRapidPowerShutDown_DISABLE_RAPIDPOWERSHUTDOWN
          BMSE_Entry_BswM_Immediate_DcmModeRapidPowerShutDown_modeNotificationPort_DcmModeRapidPowerShutDown_ENABLE_RAPIDPOWERSHUTDOWN: RteBswPositionInTask=19, RteBswEventRef=BMSE_Entry_BswM_Immediate_DcmModeRapidPowerShutDown_modeNotificationPort_DcmModeRapidPowerShutDown_ENABLE_RAPIDPOWERSHUTDOWN
          BswTE_BswM_MainFunction: RteBswPositionInTask=4, RteBswEventRef=BswTE_BswM_MainFunction, RteBswMappedToTaskRef=OsTask_BSW_FG1_10ms, RteBswUsedOsAlarmRef=OsAlarm_BSW_10ms
        4 x RteBswRequiredModeGroupConnection, all with category=TOOL_CONFIGURED, RteBswProvidedModeGrpModInstRef=BswInstance_Dcm:
          modeNotificationPort_DcmControlDTCSetting: RteBswRequiredModeGroupRef=modeNotificationPort_DcmControlDTCSetting, RteBswProvidedModeGroupRef=DcmControlDTCSetting
          modeNotificationPort_DcmDiagnosticSessionControl: RteBswRequiredModeGroupRef=modeNotificationPort_DcmDiagnosticSessionControl, RteBswProvidedModeGroupRef=DcmDiagnosticSessionControl
          modeNotificationPort_DcmEcuReset: RteBswRequiredModeGroupRef=modeNotificationPort_DcmEcuReset, RteBswProvidedModeGroupRef=DcmEcuReset
          modeNotificationPort_DcmModeRapidPowerShutDown: RteBswRequiredModeGroupRef=modeNotificationPort_DcmModeRapidPowerShutDown, RteBswProvidedModeGroupRef=DcmModeRapidPowerShutDown
      BswInstance_CanCM: RteBswModuleConfigurationRef=CanCM, RteBswImplementationRef=BswImplementation_CanCM
        MAIN_PROTECTION (RteBswExclusiveAreaImpl): category=TOOL_CONFIGURED, RteExclusiveAreaImplMechanism=ALL_INTERRUPT_BLOCKING, RteBswExclusiveAreaRef=MAIN_PROTECTION
        BswTE_CanCM_MainFunction (RteBswEventToTaskMapping):
          category = TOOL_CONFIGURED
          RteBswImmediateRestart = 0
          RteBswPositionInTask = 21
          RteBswEventRef = BswTE_CanCM_MainFunction
          RteBswMappedToTaskRef = OsTask_BSW_FG1_5ms_Com
          RteBswUsedOsAlarmRef = OsAlarm_BSW_5ms_Com
        CanCM_EM_R (RteBswRequiredModeGroupConnection):
          category = TOOL_CONFIGURED
          RteBswRequiredModeGroupRef = CanCM_EM_R
          RteBswProvidedModeGroupRef = modeSwitchPort_EcuMode
          RteBswProvidedModeGrpModInstRef = BswInstance_BswM
      BswInstance_CanTp: RteBswModuleConfigurationRef=CanTp, RteBswImplementationRef=BswImplementation_CanTp
        TIMER_PROTECTION (RteBswExclusiveAreaImpl): category=TOOL_CONFIGURED, RteExclusiveAreaImplMechanism=ALL_INTERRUPT_BLOCKING, RteBswExclusiveAreaRef=TIMER_PROTECTION
        BswTE_CanTp_MainFunction (RteBswEventToTaskMapping):
          category = TOOL_CONFIGURED
          RteBswImmediateRestart = 0
          RteBswPositionInTask = 55
          RteBswEventRef = BswTE_CanTp_MainFunction
          RteBswMappedToTaskRef = OsTask_BSW_FG1_5ms_Com
          RteBswUsedOsAlarmRef = OsAlarm_BSW_5ms_Com
      BswInstance_ComM: RteBswModuleConfigurationRef=ComM, RteBswImplementationRef=BswImplementation_ComM
        8 x RteBswExclusiveAreaImpl, all with category=TOOL_CONFIGURED, RteExclusiveAreaImplMechanism=ALL_INTERRUPT_BLOCKING:
          INHIBIT_CNT_PROTECTION: RteBswExclusiveAreaRef=INHIBIT_CNT_PROTECTION
          REQ_MODECNT_PROTECTION: RteBswExclusiveAreaRef=REQ_MODECNT_PROTECTION
          CURRENT_MODE_PROTECTION: RteBswExclusiveAreaRef=CURRENT_MODE_PROTECTION
          DCM_DIAGNOSTIC_PROTECTION: RteBswExclusiveAreaRef=DCM_DIAGNOSTIC_PROTECTION
          ECUM_WAKEUP_IND: RteBswExclusiveAreaRef=ECUM_WAKEUP_IND
          NM_INDICATION_PROTECTION: RteBswExclusiveAreaRef=NM_INDICATION_PROTECTION
          PNC_PREPARE_TIMER: RteBswExclusiveAreaRef=PNC_PREPARE_TIMER
          PNC_WAKEUP_IND: RteBswExclusiveAreaRef=PNC_WAKEUP_IND
        BswTE_ComM_MainFunction0 (RteBswEventToTaskMapping):
          category = TOOL_CONFIGURED
          RteBswImmediateRestart = 0
          RteBswPositionInTask = 1
          RteBswEventRef = BswTE_ComM_MainFunction0
          RteBswMappedToTaskRef = OsTask_BSW_FG1_5ms_Com
          RteBswUsedOsAlarmRef = OsAlarm_BSW_5ms_Com
        BswTE_ComM_MainFunction1 (RteBswEventToTaskMapping):
          category = TOOL_CONFIGURED
          RteBswImmediateRestart = 0
          RteBswPositionInTask = 2
          RteBswEventRef = BswTE_ComM_MainFunction1
          RteBswMappedToTaskRef = OsTask_BSW_FG1_5ms_Com
          RteBswUsedOsAlarmRef = OsAlarm_BSW_5ms_Com
      BswInstance_Dio: RteBswModuleConfigurationRef=Dio, RteBswImplementationRef=DioImplementation
        DIO_EXCLUSIVE_AREA_0 (RteBswExclusiveAreaImpl): category=TOOL_CONFIGURED, RteExclusiveAreaImplMechanism=ALL_INTERRUPT_BLOCKING, RteBswExclusiveAreaRef=DIO_EXCLUSIVE_AREA_0
      BswInstance_Dcm: RteBswModuleConfigurationRef=Dcm, RteBswImplementationRef=BswImplementation_Dcm
        5 x RteBswExclusiveAreaImpl, all with category=TOOL_CONFIGURED, RteExclusiveAreaImplMechanism=ALL_INTERRUPT_BLOCKING:
          SIGNAL_DATA_PROTECTION_AREA: RteBswExclusiveAreaRef=SIGNAL_DATA_PROTECTION_AREA
          ProtclProtection: RteBswExclusiveAreaRef=ProtclProtection
          RxPduIdProtection: RteBswExclusiveAreaRef=RxPduIdProtection
          RxLengthProtection: RteBswExclusiveAreaRef=RxLengthProtection
          TimerProtection: RteBswExclusiveAreaRef=TimerProtection
        BswTE_Dcm_MainFunction (RteBswEventToTaskMapping):
          category = TOOL_CONFIGURED
          RteBswImmediateRestart = 0
          RteBswPositionInTask = 50
          RteBswEventRef = BswTE_Dcm_MainFunction
          RteBswMappedToTaskRef = OsTask_BSW_FG1_10ms
          RteBswUsedOsAlarmRef = OsAlarm_BSW_10ms
      BswInstance_Fee: RteBswModuleConfigurationRef=Fee, RteBswImplementationRef=FeeImplementation
        FEE_EXCLUSIVE_AREA_0 (RteBswExclusiveAreaImpl): category=TOOL_CONFIGURED, RteExclusiveAreaImplMechanism=ALL_INTERRUPT_BLOCKING, RteBswExclusiveAreaRef=FEE_EXCLUSIVE_AREA_0
      BswInstance_RomTst: RteBswModuleConfigurationRef=RomTst, RteBswImplementationRef=BswImplementation_RomTst
        BITP_RomTst (RteBswInternalTriggerConfig): category=TOOL_CONFIGURED, RteBswTriggerSourceQueueLength=1, RteBswTriggerSourceRef=BITP_RomTst
        BITOE_RomTst (RteBswEventToTaskMapping): category=TOOL_CONFIGURED, RteBswImmediateRestart=0, RteBswPositionInTask=10, RteBswEventRef=BITOE_RomTst, RteBswMappedToTaskRef=OsTask_BSW_BG_RomTst
      BswInstance_Ocu: RteBswModuleConfigurationRef=Ocu, RteBswImplementationRef=OcuImplementation
        OCU_EXCLUSIVE_AREA_0 (RteBswExclusiveAreaImpl): category=TOOL_CONFIGURED, RteExclusiveAreaImplMechanism=ALL_INTERRUPT_BLOCKING, RteBswExclusiveAreaRef=OCU_EXCLUSIVE_AREA_0
      BswInstance_OsekNm: RteBswModuleConfigurationRef=OsekNm, RteBswImplementationRef=BswImplementation_OsekNm
        OSEKNM_BLOCK_ALL_INTERRUPT (RteBswExclusiveAreaImpl): category=TOOL_CONFIGURED, RteExclusiveAreaImplMechanism=ALL_INTERRUPT_BLOCKING, RteBswExclusiveAreaRef=OSEKNM_BLOCK_ALL_INTERRUPT
        BswTE_OsekNm_MainFunction (RteBswEventToTaskMapping):
          category = TOOL_CONFIGURED
          RteBswImmediateRestart = 0
          RteBswPositionInTask = 45
          RteBswEventRef = BswTE_OsekNm_MainFunction
          RteBswMappedToTaskRef = OsTask_BSW_FG1_5ms_Com
          RteBswUsedOsAlarmRef = OsAlarm_BSW_5ms_Com
      BswInstance_FiM: RteBswModuleConfigurationRef=FiM, RteBswImplementationRef=BswImplementation_FiM
        REQUEST_EVENTID_PROTECTION (RteBswExclusiveAreaImpl): category=TOOL_CONFIGURED, RteExclusiveAreaImplMechanism=ALL_INTERRUPT_BLOCKING, RteBswExclusiveAreaRef=REQUEST_EVENTID_PROTECTION
        REQUEST_FID_PROTECTION (RteBswExclusiveAreaImpl): category=TOOL_CONFIGURED, RteExclusiveAreaImplMechanism=ALL_INTERRUPT_BLOCKING, RteBswExclusiveAreaRef=REQUEST_FID_PROTECTION
      BswInstance_Csm: RteBswModuleConfigurationRef=Csm, RteBswImplementationRef=BswImplementation_Csm
        FUNCTION_PTR_PROTECTION (RteBswExclusiveAreaImpl): category=TOOL_CONFIGURED, RteExclusiveAreaImplMechanism=ALL_INTERRUPT_BLOCKING, RteBswExclusiveAreaRef=FUNCTION_PTR_PROTECTION
        BswTE_Csm_MainFunction (RteBswEventToTaskMapping):
          category = TOOL_CONFIGURED
          RteBswImmediateRestart = 0
          RteBswPositionInTask = 6
          RteBswEventRef = BswTE_Csm_MainFunction
          RteBswMappedToTaskRef = OsTask_BSW_FG1_10ms
          RteBswUsedOsAlarmRef = OsAlarm_BSW_10ms
        BswITP_Csm_TriggerPointWorker (RteBswInternalTriggerConfig): category=TOOL_CONFIGURED, RteBswTriggerSourceQueueLength=0, RteBswTriggerSourceRef=BswITP_Csm_TriggerPointWorker
        BswITOE_Csm_TriggerWorker (RteBswEventToTaskMapping):
          category = TOOL_CONFIGURED
          RteBswImmediateRestart = 0
          RteBswPositionInTask = 0
          RteBswEventRef = BswITOE_Csm_TriggerWorker
          RteBswMappedToTaskRef = OsTask_BSW_BG_Csm
      BswInstance_CanTrcv_255_Autron: RteBswModuleConfigurationRef=CanTrcv_255_Autron, RteBswImplementationRef=BswImplementation_CanTrcv_255_Autron
        INTERRUPT_PROTECTION_AREA (RteBswExclusiveAreaImpl): category=TOOL_CONFIGURED, RteExclusiveAreaImplMechanism=ALL_INTERRUPT_BLOCKING, RteBswExclusiveAreaRef=INTERRUPT_PROTECTION_AREA
      BswInstance_IoHwAb: RteBswModuleConfigurationRef=IoHwAb, RteBswImplementationRef=BswImplementation_IoHwAb
        IoHwAbProtection (RteBswExclusiveAreaImpl): category=TOOL_CONFIGURED, RteExclusiveAreaImplMechanism=ALL_INTERRUPT_BLOCKING, RteBswExclusiveAreaRef=IoHwAbProtection
        BswTE_IoHwAb_IOM_10ms (RteBswEventToTaskMapping):
          category = TOOL_CONFIGURED
          RteBswImmediateRestart = 0
          RteBswPositionInTask = 0
          RteBswEventRef = BswTE_IoHwAb_IOM_10ms
          RteBswMappedToTaskRef = OsTask_BSW_FG1_10ms
          RteBswUsedOsAlarmRef = OsAlarm_BSW_10ms
        BswTE_IoHwAb_IOM_5ms (RteBswEventToTaskMapping):
          category = TOOL_CONFIGURED
          RteBswImmediateRestart = 0
          RteBswPositionInTask = 0
          RteBswEventRef = BswTE_IoHwAb_IOM_5ms
          RteBswMappedToTaskRef = OsTask_BSW_FG1_5ms_Com
          RteBswUsedOsAlarmRef = OsAlarm_BSW_5ms_Com
      BswInstance_Pwm: RteBswModuleConfigurationRef=Pwm, RteBswImplementationRef=PwmImplementation
        PWM_EXCLUSIVE_AREA_0 (RteBswExclusiveAreaImpl): category=TOOL_CONFIGURED, RteExclusiveAreaImplMechanism=ALL_INTERRUPT_BLOCKING, RteBswExclusiveAreaRef=PWM_EXCLUSIVE_AREA_0
      BswInstance_Icu: RteBswModuleConfigurationRef=Icu, RteBswImplementationRef=IcuImplementation
        ICU_EXCLUSIVE_AREA_0 (RteBswExclusiveAreaImpl): category=TOOL_CONFIGURED, RteExclusiveAreaImplMechanism=ALL_INTERRUPT_BLOCKING, RteBswExclusiveAreaRef=ICU_EXCLUSIVE_AREA_0
      BswInstance_Gpt: RteBswModuleConfigurationRef=Gpt, RteBswImplementationRef=GptImplementation
        GPT_EXCLUSIVE_AREA_0 (RteBswExclusiveAreaImpl): category=TOOL_CONFIGURED, RteExclusiveAreaImplMechanism=ALL_INTERRUPT_BLOCKING, RteBswExclusiveAreaRef=GPT_EXCLUSIVE_AREA_0
      BswInstance_Port: RteBswModuleConfigurationRef=Port, RteBswImplementationRef=PortImplementation
        PORT_EXCLUSIVE_AREA_0 (RteBswExclusiveAreaImpl): category=TOOL_CONFIGURED, RteExclusiveAreaImplMechanism=ALL_INTERRUPT_BLOCKING, RteBswExclusiveAreaRef=PORT_EXCLUSIVE_AREA_0
      BswInstance_RamTst: RteBswModuleConfigurationRef=RamTst, RteBswImplementationRef=BswImplementation_RamTst
        RAM_PROTECTION (RteBswExclusiveAreaImpl): category=TOOL_CONFIGURED, RteExclusiveAreaImplMechanism=ALL_INTERRUPT_BLOCKING, RteBswExclusiveAreaRef=RAM_PROTECTION
        PATTERN_CHECK_PROTECT (RteBswExclusiveAreaImpl): category=TOOL_CONFIGURED, RteExclusiveAreaImplMechanism=ALL_INTERRUPT_BLOCKING, RteBswExclusiveAreaRef=PATTERN_CHECK_PROTECT
      BswInstance_Fls: RteBswModuleConfigurationRef=Fls, RteBswImplementationRef=FlsImplementation
        FLS_EXCLUSIVE_AREA_0 (RteBswExclusiveAreaImpl): category=TOOL_CONFIGURED, RteExclusiveAreaImplMechanism=ALL_INTERRUPT_BLOCKING, RteBswExclusiveAreaRef=FLS_EXCLUSIVE_AREA_0
      BswInstance_PduR: RteBswModuleConfigurationRef=PduR, RteBswImplementationRef=BswImplementation_PduR
        6 x RteBswExclusiveAreaImpl, all with category=TOOL_CONFIGURED, RteExclusiveAreaImplMechanism=ALL_INTERRUPT_BLOCKING:
          TP_TX_PROTECTION_AREA: RteBswExclusiveAreaRef=TP_TX_PROTECTION_AREA
          GROUP_STATUS_PROTECTION_AREA: RteBswExclusiveAreaRef=GROUP_STATUS_PROTECTION_AREA
          FIFO_STATUS_PROTECTION_AREA: RteBswExclusiveAreaRef=FIFO_STATUS_PROTECTION_AREA
          DATA_BUFFER_PROTECTION_AREA: RteBswExclusiveAreaRef=DATA_BUFFER_PROTECTION_AREA
          MULTICAST_PROTECTION_AREA: RteBswExclusiveAreaRef=MULTICAST_PROTECTION_AREA
          TP_GATEWAY_PROTECTION_AREA: RteBswExclusiveAreaRef=TP_GATEWAY_PROTECTION_AREA
      BswInstance_Spi: RteBswModuleConfigurationRef=Spi, RteBswImplementationRef=SpiImplementation
        SPI_EXCLUSIVE_AREA_0 (RteBswExclusiveAreaImpl): category=TOOL_CONFIGURED, RteExclusiveAreaImplMechanism=ALL_INTERRUPT_BLOCKING, RteBswExclusiveAreaRef=SPI_EXCLUSIVE_AREA_0
      BswInstance_Adc: RteBswModuleConfigurationRef=Adc, RteBswImplementationRef=AdcImplementation
        ADC_EXCLUSIVE_AREA_0 (RteBswExclusiveAreaImpl): category=TOOL_CONFIGURED, RteExclusiveAreaImplMechanism=ALL_INTERRUPT_BLOCKING, RteBswExclusiveAreaRef=ADC_EXCLUSIVE_AREA_0
    SwcInstance_SWC_DiagnosticService (RteSwComponentInstance): category=TOOL_CONFIGURED, RteSoftwareComponentInstanceRef=SWC_DiagnosticService
      18 x RteEventToTaskMapping, all with category=TOOL_CONFIGURED, RteImmediateRestart=0:
        RteEventToTaskMapping_OIE_CallbackDCMRequestServices_StopProtocol: RteEventRef=OIE_CallbackDCMRequestServices_StopProtocol
        RteEventToTaskMapping_OIE_CallbackDCMRequestServices_StartProtocol: RteEventRef=OIE_CallbackDCMRequestServices_StartProtocol
        RteEventToTaskMapping_OIE_ServiceRequestSupplierNotification_Indication: RteEventRef=OIE_ServiceRequestSupplierNotification_Indication
        RteEventToTaskMapping_OIE_ServiceRequestSupplierNotification_Confirmation: RteEventRef=OIE_ServiceRequestSupplierNotification_Confirmation
        RteEventToTaskMapping_SMSE_Entry_DiagnosticSessionControlNotification_modeNotificationPort_SessionControl_DcmDiagnosticSessionControl_DCM_DEFAULT_SESSION: RteEventRef=SMSE_Entry_DiagnosticSessionControlNotification_modeNotificationPort_SessionControl_DcmDiagnosticSessionControl_DCM_DEFAULT_SESSION
        RteEventToTaskMapping_SMSE_Entry_DiagnosticSessionControlNotification_modeNotificationPort_SessionControl_DcmDiagnosticSessionControl_DCM_EXTENDED_DIAGNOSTIC_SESSION: RteEventRef=SMSE_Entry_DiagnosticSessionControlNotification_modeNotificationPort_SessionControl_DcmDiagnosticSessionControl_DCM_EXTENDED_DIAGNOSTIC_SESSION
        RteEventToTaskMapping_SMSE_ApplicationUpdatedIndication_modeNotificationPort_ApplicationUpdated_DcmApplicationUpdated_APP_UPDATED: RteEventRef=SMSE_ApplicationUpdatedIndication_modeNotificationPort_ApplicationUpdated_DcmApplicationUpdated_APP_UPDATED
        RteEventToTaskMapping_SMSE_ApplicationUpdatedIndication_modeNotificationPort_ApplicationUpdated_DcmApplicationUpdated_APP_NOT_UPDATED: RteEventRef=SMSE_ApplicationUpdatedIndication_modeNotificationPort_ApplicationUpdated_DcmApplicationUpdated_APP_NOT_UPDATED
        RteEventToTaskMapping_OIE_L9_CompareKey: RteEventRef=OIE_L9_CompareKey
        RteEventToTaskMapping_OIE_L9_GetSeed: RteEventRef=OIE_L9_GetSeed
        RteEventToTaskMapping_OIE_CallbackDCMPresentDate_GetPresentDate: RteEventRef=OIE_CallbackDCMPresentDate_GetPresentDate
        RteEventToTaskMapping_OIE_RE_RID_B194h_HSMConfigLockSecureDebug_Start_RoutineServices_RID_B194h_HSMConfigLockSecureDebug_Start: RteEventRef=OIE_RE_RID_B194h_HSMConfigLockSecureDebug_Start_RoutineServices_RID_B194h_HSMConfigLockSecureDebug_Start
        RteEventToTaskMapping_OIE_RE_RID_B199h_HSMSecureBootEnable_Start_RoutineServices_RID_B199h_HSMSecureBootEnable_Start: RteEventRef=OIE_RE_RID_B199h_HSMSecureBootEnable_Start_RoutineServices_RID_B199h_HSMSecureBootEnable_Start
        RteEventToTaskMapping_OIE_RE_RID_B19Ah_HSMFTDDisable_Start_RoutineServices_RID_B19Ah_HSMFTDDisable_Start: RteEventRef=OIE_RE_RID_B19Ah_HSMFTDDisable_Start_RoutineServices_RID_B19Ah_HSMFTDDisable_Start
        RteEventToTaskMapping_OIE_RE_RID_B19Bh_HSMSecureDebugEnable_Start_RoutineServices_RID_B19Bh_HSMSecureDebugEnable_Start: RteEventRef=OIE_RE_RID_B19Bh_HSMSecureDebugEnable_Start_RoutineServices_RID_B19Bh_HSMSecureDebugEnable_Start
        RteEventToTaskMapping_OIE_RE_RID_B19Ch_HSMConfigurationLockEnable_Start_RoutineServices_RID_B19Ch_HSMConfigurationLockEnable_Start: RteEventRef=OIE_RE_RID_B19Ch_HSMConfigurationLockEnable_Start_RoutineServices_RID_B19Ch_HSMConfigurationLockEnable_Start
        RteEventToTaskMapping_OIE_RE_RID_B19Dh_HSMChallengeRequest_Start_RoutineServices_RID_B19Dh_HSMChallengeRequest_Start: RteEventRef=OIE_RE_RID_B19Dh_HSMChallengeRequest_Start_RoutineServices_RID_B19Dh_HSMChallengeRequest_Start
        RteEventToTaskMapping_OIE_RE_RID_B19Eh_HSMResponseData_Start_RoutineServices_RID_B19Eh_HSMResponseData_Start: RteEventRef=OIE_RE_RID_B19Eh_HSMResponseData_Start_RoutineServices_RID_B19Eh_HSMResponseData_Start
    RteSwComponentType_SWC_DiagnosticService (RteSwComponentType): RteComponentTypeRef=SWC_DiagnosticService
      RteComponentTypeCalibration: category=TOOL_CONFIGURED, RteCalibrationSupportEnabled=0
    SwcInstance_FiM (RteSwComponentInstance): category=TOOL_CONFIGURED, RteSoftwareComponentInstanceRef=FiM
      RteEventToTaskMapping_OIE_GetFunctionPermission_FiMFID_0 (RteEventToTaskMapping): category=TOOL_CONFIGURED, RteImmediateRestart=0, RteEventRef=OIE_GetFunctionPermission_FiMFID_0
      RteEventToTaskMapping_OIE_GetFunctionPermission_FiMFID_1 (RteEventToTaskMapping): category=TOOL_CONFIGURED, RteImmediateRestart=0, RteEventRef=OIE_GetFunctionPermission_FiMFID_1
      REQUEST_EVENTID_PROTECTION (RteExclusiveAreaImplementation): category=TOOL_CONFIGURED, RteExclusiveAreaImplMechanism=ALL_INTERRUPT_BLOCKING, RteExclusiveAreaRef=REQUEST_EVENTID_PROTECTION
      REQUEST_FID_PROTECTION (RteExclusiveAreaImplementation): category=TOOL_CONFIGURED, RteExclusiveAreaImplMechanism=ALL_INTERRUPT_BLOCKING, RteExclusiveAreaRef=REQUEST_FID_PROTECTION
    RteSwComponentType_FiM (RteSwComponentType): RteComponentTypeRef=FiM
      RteComponentTypeCalibration: category=TOOL_CONFIGURED, RteCalibrationSupportEnabled=0
    SwcInstance_SWC_WdgMTest (RteSwComponentInstance): category=TOOL_CONFIGURED, RteSoftwareComponentInstanceRef=SWC_WdgMTest
      5 x RteEventToTaskMapping, all with category=TOOL_CONFIGURED, RteImmediateRestart=0:
        RteEventToTaskMapping_TE_WdgMTest: RtePositionInTask=1, RteMappedToTaskRef=OsTask_ASW_FG1_10ms, RteUsedOsAlarmRef=OsAlarm_ASW_10ms, RteEventRef=TE_WdgMTest
        RteEventToTaskMapping_SwcModeSwitchEvent_globalMode_OK: RtePositionInTask=0, RteMappedToTaskRef=OsTask_ASW_FG2_WdgMTestMode, RteEventRef=SwcModeSwitchEvent_globalMode_OK
        RteEventToTaskMapping_SwcModeSwitchEvent_globalMode_FAILED: RtePositionInTask=1, RteMappedToTaskRef=OsTask_ASW_FG2_WdgMTestMode, RteEventRef=SwcModeSwitchEvent_globalMode_FAILED
        RteEventToTaskMapping_SwcModeSwitchEvent_globalMode_EXPIRED: RtePositionInTask=2, RteMappedToTaskRef=OsTask_ASW_FG2_WdgMTestMode, RteEventRef=SwcModeSwitchEvent_globalMode_EXPIRED
        RteEventToTaskMapping_SwcModeSwitchEvent_globalMode_STOPPED: RtePositionInTask=3, RteMappedToTaskRef=OsTask_ASW_FG2_WdgMTestMode, RteEventRef=SwcModeSwitchEvent_globalMode_STOPPED
    RteSwComponentType_SWC_WdgMTest (RteSwComponentType): RteComponentTypeRef=SWC_WdgMTest
      RteComponentTypeCalibration: category=TOOL_CONFIGURED, RteCalibrationSupportEnabled=0
    SwcInstance_Os_Master (RteSwComponentInstance): category=TOOL_CONFIGURED, RteSoftwareComponentInstanceRef=Os_Master
      RteEventToTaskMapping_Os_TE_100ms_Master (RteEventToTaskMapping):
        category = TOOL_CONFIGURED
        RteImmediateRestart = 0
        RtePositionInTask = 3
        RteMappedToTaskRef = OsTask_ASW_FG1_100ms
        RteUsedOsAlarmRef = OsAlarm_ASW_100ms
        RteEventRef = Os_TE_100ms_Master
    SwcInstance_SWC_DiagnosticMonitor (RteSwComponentInstance): category=TOOL_CONFIGURED, RteSoftwareComponentInstanceRef=SWC_DiagnosticMonitor
      7 x RteEventToTaskMapping, all with category=TOOL_CONFIGURED, RteImmediateRestart=0:
        RteEventToTaskMapping_TimingEvent_DiagnosticMonitor: RtePositionInTask=0, RteMappedToTaskRef=OsTask_ASW_FG1_10ms, RteUsedOsAlarmRef=OsAlarm_ASW_10ms, RteEventRef=TimingEvent_DiagnosticMonitor
        RteEventToTaskMapping_OIE_InitMonitorForEvent: RteEventRef=OIE_InitMonitorForEvent
        RteEventToTaskMapping_OIE_CBStatusEvt_DEM_E_TEST_EVENT: RteEventRef=OIE_CBStatusEvt_DEM_E_TEST_EVENT
        RteEventToTaskMapping_OIE_CBStatusEvt_E_MODE_CHANGE_LOCALCAN_CBStatusEvt_E_MODE_CHANGE_LOCALCAN_EventStatusChanged: RteEventRef=OIE_CBStatusEvt_E_MODE_CHANGE_LOCALCAN_CBStatusEvt_E_MODE_CHANGE_LOCALCAN_EventStatusChanged
        RteEventToTaskMapping_OIE_CBStatusEvt_E_MODE_CHANGE_BCAN_CBStatusEvt_E_MODE_CHANGE_BCAN_EventStatusChanged: RteEventRef=OIE_CBStatusEvt_E_MODE_CHANGE_BCAN_CBStatusEvt_E_MODE_CHANGE_BCAN_EventStatusChanged
        RteEventToTaskMapping_OIE_CBReadData_DE_0001: RteEventRef=OIE_CBReadData_DE_0001
        RteEventToTaskMapping_OIE_CBReadData_DE_0002: RteEventRef=OIE_CBReadData_DE_0002
    RteSwComponentType_SWC_DiagnosticMonitor (RteSwComponentType): RteComponentTypeRef=SWC_DiagnosticMonitor
      RteComponentTypeCalibration: category=TOOL_CONFIGURED, RteCalibrationSupportEnabled=0
    SwcInstance_SWC_AppMode (RteSwComponentInstance): category=TOOL_CONFIGURED, RteSoftwareComponentInstanceRef=SWC_AppMode
      32 x RteEventToTaskMapping, all with category=TOOL_CONFIGURED, RteImmediateRestart=0:
        RteEventToTaskMapping_TE_AppMode_Test: RtePositionInTask=0, RteMappedToTaskRef=OsTask_ASW_FG1_100ms, RteUsedOsAlarmRef=OsAlarm_ASW_100ms, RteEventRef=TE_AppMode_Test
        RteEventToTaskMapping_SMSE_Entry_EcuModeSwitched_modeNotificationPort_EcuMode_EcuMode_ECUM_STATE_RUN: RteEventRef=SMSE_Entry_EcuModeSwitched_modeNotificationPort_EcuMode_EcuMode_ECUM_STATE_RUN
        RteEventToTaskMapping_SMSE_Entry_EcuModeSwitched_modeNotificationPort_EcuMode_EcuMode_ECUM_STATE_SHUTDOWN: RteEventRef=SMSE_Entry_EcuModeSwitched_modeNotificationPort_EcuMode_EcuMode_ECUM_STATE_SHUTDOWN
        RteEventToTaskMapping_SMSE_Entry_EcuModeSwitched_modeNotificationPort_EcuMode_EcuMode_ECUM_STATE_PREP_SHUTDOWN: RteEventRef=SMSE_Entry_EcuModeSwitched_modeNotificationPort_EcuMode_EcuMode_ECUM_STATE_PREP_SHUTDOWN
        RteEventToTaskMapping_SMSE_Entry_EcuModeSwitched_modeNotificationPort_EcuMode_EcuMode_ECUM_STATE_SLEEP: RteEventRef=SMSE_Entry_EcuModeSwitched_modeNotificationPort_EcuMode_EcuMode_ECUM_STATE_SLEEP
        RteEventToTaskMapping_SMSE_Entry_BusOffStateSwitched_modeNotificationPort_CanSMBORState_LOCALCAN_CanSMBORState_LOCALCAN_COMPLETE: RteEventRef=SMSE_Entry_BusOffStateSwitched_modeNotificationPort_CanSMBORState_LOCALCAN_CanSMBORState_LOCALCAN_COMPLETE
        RteEventToTaskMapping_SMSE_Entry_BusOffStateSwitched_modeNotificationPort_CanSMBORState_LOCALCAN_CanSMBORState_LOCALCAN_START: RteEventRef=SMSE_Entry_BusOffStateSwitched_modeNotificationPort_CanSMBORState_LOCALCAN_CanSMBORState_LOCALCAN_START
        RteEventToTaskMapping_SMSE_Entry_BusOffStateSwitched_modeNotificationPort_CanSMBORState_BCAN_CanSMBORState_BCAN_COMPLETE: RteEventRef=SMSE_Entry_BusOffStateSwitched_modeNotificationPort_CanSMBORState_BCAN_CanSMBORState_BCAN_COMPLETE
        RteEventToTaskMapping_SMSE_Entry_BusOffStateSwitched_modeNotificationPort_CanSMBORState_BCAN_CanSMBORState_BCAN_START: RteEventRef=SMSE_Entry_BusOffStateSwitched_modeNotificationPort_CanSMBORState_BCAN_CanSMBORState_BCAN_START
        RteEventToTaskMapping_SMSE_Entry_ComMModeSwitched_LOCALCAN_modeNotificationPort_ComMMode_LOCALCAN_ComMMode_LOCALCAN_NO_COM: RteEventRef=SMSE_Entry_ComMModeSwitched_LOCALCAN_modeNotificationPort_ComMMode_LOCALCAN_ComMMode_LOCALCAN_NO_COM
        RteEventToTaskMapping_SMSE_Entry_ComMModeSwitched_LOCALCAN_modeNotificationPort_ComMMode_LOCALCAN_ComMMode_LOCALCAN_SILENT_COM: RteEventRef=SMSE_Entry_ComMModeSwitched_LOCALCAN_modeNotificationPort_ComMMode_LOCALCAN_ComMMode_LOCALCAN_SILENT_COM
        RteEventToTaskMapping_SMSE_Entry_ComMModeSwitched_LOCALCAN_modeNotificationPort_ComMMode_LOCALCAN_ComMMode_LOCALCAN_FULL_COM: RteEventRef=SMSE_Entry_ComMModeSwitched_LOCALCAN_modeNotificationPort_ComMMode_LOCALCAN_ComMMode_LOCALCAN_FULL_COM
        RteEventToTaskMapping_SMSE_Entry_ComMModeSwitched_BCAN_modeNotificationPort_ComMMode_BCAN_ComMMode_BCAN_NO_COM: RteEventRef=SMSE_Entry_ComMModeSwitched_BCAN_modeNotificationPort_ComMMode_BCAN_ComMMode_BCAN_NO_COM
        RteEventToTaskMapping_SMSE_Entry_ComMModeSwitched_BCAN_modeNotificationPort_ComMMode_BCAN_ComMMode_BCAN_SILENT_COM: RteEventRef=SMSE_Entry_ComMModeSwitched_BCAN_modeNotificationPort_ComMMode_BCAN_ComMMode_BCAN_SILENT_COM
        RteEventToTaskMapping_SMSE_Entry_ComMModeSwitched_BCAN_modeNotificationPort_ComMMode_BCAN_ComMMode_BCAN_FULL_COM: RteEventRef=SMSE_Entry_ComMModeSwitched_BCAN_modeNotificationPort_ComMMode_BCAN_ComMMode_BCAN_FULL_COM
        RteEventToTaskMapping_SMSE_Entry_InitCompleted_modeNotificationPort_InitState_InitState_COMPLETE: RteEventRef=SMSE_Entry_InitCompleted_modeNotificationPort_InitState_InitState_COMPLETE
        RteEventToTaskMapping_SMSE_Entry_PduGroupSwitched_LOCALCAN_Tx_modeNotificationPort_PduGroupTx_LOCALCAN_PduGroupTx_LOCALCAN_STOP: RteEventRef=SMSE_Entry_PduGroupSwitched_LOCALCAN_Tx_modeNotificationPort_PduGroupTx_LOCALCAN_PduGroupTx_LOCALCAN_STOP
        RteEventToTaskMapping_SMSE_Entry_PduGroupSwitched_LOCALCAN_Tx_modeNotificationPort_PduGroupTx_LOCALCAN_PduGroupTx_LOCALCAN_START: RteEventRef=SMSE_Entry_PduGroupSwitched_LOCALCAN_Tx_modeNotificationPort_PduGroupTx_LOCALCAN_PduGroupTx_LOCALCAN_START
        RteEventToTaskMapping_SMSE_Entry_PduGroupSwitched_LOCALCAN_Rx_modeNotificationPort_PduGroupRx_LOCALCAN_PduGroupRx_LOCALCAN_STOP: RteEventRef=SMSE_Entry_PduGroupSwitched_LOCALCAN_Rx_modeNotificationPort_PduGroupRx_LOCALCAN_PduGroupRx_LOCALCAN_STOP
        RteEventToTaskMapping_SMSE_Entry_PduGroupSwitched_LOCALCAN_Rx_modeNotificationPort_PduGroupRx_LOCALCAN_PduGroupRx_LOCALCAN_START: RteEventRef=SMSE_Entry_PduGroupSwitched_LOCALCAN_Rx_modeNotificationPort_PduGroupRx_LOCALCAN_PduGroupRx_LOCALCAN_START
        RteEventToTaskMapping_SMSE_Entry_PduGroupSwitched_BCAN_Tx_modeNotificationPort_PduGroupTx_BCAN_PduGroupTx_BCAN_STOP: RteEventRef=SMSE_Entry_PduGroupSwitched_BCAN_Tx_modeNotificationPort_PduGroupTx_BCAN_PduGroupTx_BCAN_STOP
        RteEventToTaskMapping_SMSE_Entry_PduGroupSwitched_BCAN_Tx_modeNotificationPort_PduGroupTx_BCAN_PduGroupTx_BCAN_START: RteEventRef=SMSE_Entry_PduGroupSwitched_BCAN_Tx_modeNotificationPort_PduGroupTx_BCAN_PduGroupTx_BCAN_START
        RteEventToTaskMapping_SMSE_Entry_PduGroupSwitched_BCAN_Rx_modeNotificationPort_PduGroupRx_BCAN_PduGroupRx_BCAN_STOP: RteEventRef=SMSE_Entry_PduGroupSwitched_BCAN_Rx_modeNotificationPort_PduGroupRx_BCAN_PduGroupRx_BCAN_STOP
        RteEventToTaskMapping_SMSE_Entry_PduGroupSwitched_BCAN_Rx_modeNotificationPort_PduGroupRx_BCAN_PduGroupRx_BCAN_START: RteEventRef=SMSE_Entry_PduGroupSwitched_BCAN_Rx_modeNotificationPort_PduGroupRx_BCAN_PduGroupRx_BCAN_START
        RteEventToTaskMapping_SMSE_Entry_WakeupEventValidated_modeNotificationPort_WakeupEvent_WakeupEvent_LOCALCAN_RX_POLL: RteEventRef=SMSE_Entry_WakeupEventValidated_modeNotificationPort_WakeupEvent_WakeupEvent_LOCALCAN_RX_POLL
        RteEventToTaskMapping_SMSE_Entry_WakeupEventValidated_modeNotificationPort_WakeupEvent_WakeupEvent_BCAN_RX_POLL: RteEventRef=SMSE_Entry_WakeupEventValidated_modeNotificationPort_WakeupEvent_WakeupEvent_BCAN_RX_POLL
        RteEventToTaskMapping_OIE_RE_Slpwup_RequestMode_BCAN_P_RequestMode_BCAN_RequestComMode: RteEventRef=OIE_RE_Slpwup_RequestMode_BCAN_P_RequestMode_BCAN_RequestComMode
        RteEventToTaskMapping_OIE_RE_Slpwup_RequestMode_LCAN_P_RequestMode_LCAN_RequestComMode: RteEventRef=OIE_RE_Slpwup_RequestMode_LCAN_P_RequestMode_LCAN_RequestComMode
        RteEventToTaskMapping_OIE_RE_Slpwup_EcuM_StateRequest_P_Slpwup_EcuM_StateRequest_RequestState: RteEventRef=OIE_RE_Slpwup_EcuM_StateRequest_P_Slpwup_EcuM_StateRequest_RequestState
        RteEventToTaskMapping_SMSE_Entry_WakeupEventValidated_modeNotificationPort_WakeupEvent_WakeupEvent_BCAN_RX: RteEventRef=SMSE_Entry_WakeupEventValidated_modeNotificationPort_WakeupEvent_WakeupEvent_BCAN_RX
        RteEventToTaskMapping_SMSE_Entry_WakeupEventValidated_modeNotificationPort_WakeupEvent_WakeupEvent_IGN_WakeUP: RteEventRef=SMSE_Entry_WakeupEventValidated_modeNotificationPort_WakeupEvent_WakeupEvent_IGN_WakeUP
        RteEventToTaskMapping_SMSE_Entry_WakeupEventValidated_modeNotificationPort_WakeupEvent_WakeupEvent_LOCALCAN_RX: RteEventRef=SMSE_Entry_WakeupEventValidated_modeNotificationPort_WakeupEvent_WakeupEvent_LOCALCAN_RX
    RteSwComponentType_SWC_AppMode (RteSwComponentType): RteComponentTypeRef=SWC_AppMode
      RteComponentTypeCalibration: category=TOOL_CONFIGURED, RteCalibrationSupportEnabled=0
    SwcInstance_CanTp (RteSwComponentInstance): category=TOOL_CONFIGURED, RteSoftwareComponentInstanceRef=CanTp
      RteEventToTaskMapping_OIE_ChangeParameter (RteEventToTaskMapping): category=TOOL_CONFIGURED, RteImmediateRestart=0, RteEventRef=OIE_ChangeParameter
      RteEventToTaskMapping_OIE_ReadParameter (RteEventToTaskMapping): category=TOOL_CONFIGURED, RteImmediateRestart=0, RteEventRef=OIE_ReadParameter
    RteSwComponentType_CanTp (RteSwComponentType): RteComponentTypeRef=CanTp
      RteComponentTypeCalibration: category=TOOL_CONFIGURED, RteCalibrationSupportEnabled=0
    SwcInstance_Det (RteSwComponentInstance): category=TOOL_CONFIGURED, RteSoftwareComponentInstanceRef=Det
      RteEventToTaskMapping_OperationInvokedEvent_Det (RteEventToTaskMapping): category=TOOL_CONFIGURED, RteImmediateRestart=0, RteEventRef=OperationInvokedEvent_Det
    RteSwComponentType_Det (RteSwComponentType): RteComponentTypeRef=Det
      RteComponentTypeCalibration: category=TOOL_CONFIGURED, RteCalibrationSupportEnabled=0
    SwcInstance_BswM (RteSwComponentInstance): category=TOOL_CONFIGURED, RteSoftwareComponentInstanceRef=BswM
      RteEventToTaskMapping_DRE_BswM_Immediate_SwcModeRequest_ComMMode_BCAN_modeRequestPort_ComMMode_BCAN_ComMMode_BCAN (RteEventToTaskMapping):
        category = TOOL_CONFIGURED
        RteImmediateRestart = 0
        RtePositionInTask = 0
        RteMappedToTaskRef = OsTask_BSW_ComMModeRequest
        RteEventRef = DRE_BswM_Immediate_SwcModeRequest_ComMMode_BCAN_modeRequestPort_ComMMode_BCAN_ComMMode_BCAN
      RteEventToTaskMapping_DRE_BswM_Immediate_SwcModeRequest_ComMMode_LOCALCAN_modeRequestPort_ComMMode_LOCALCAN_ComMMode_LOCALCAN (RteEventToTaskMapping):
        category = TOOL_CONFIGURED
        RteImmediateRestart = 0
        RtePositionInTask = 1
        RteMappedToTaskRef = OsTask_BSW_ComMModeRequest
        RteEventRef = DRE_BswM_Immediate_SwcModeRequest_ComMMode_LOCALCAN_modeRequestPort_ComMMode_LOCALCAN_ComMMode_LOCALCAN
    RteSwComponentType_BswM (RteSwComponentType): RteComponentTypeRef=BswM
      RteComponentTypeCalibration: category=TOOL_CONFIGURED, RteCalibrationSupportEnabled=0
    SwcInstance_ComM (RteSwComponentInstance): category=TOOL_CONFIGURED, RteSoftwareComponentInstanceRef=ComM
      33 x RteEventToTaskMapping, all with category=TOOL_CONFIGURED, RteImmediateRestart=0:
        RteEventToTaskMapping_OIE_GetStatus_ML: RteEventRef=OIE_GetStatus_ML
        RteEventToTaskMapping_OIE_LimitECUToNoComMode_ML: RteEventRef=OIE_LimitECUToNoComMode_ML
        RteEventToTaskMapping_OIE_ReadInhibitCounter_ML: RteEventRef=OIE_ReadInhibitCounter_ML
        RteEventToTaskMapping_OIE_ResetInhibitCounter_ML: RteEventRef=OIE_ResetInhibitCounter_ML
        RteEventToTaskMapping_OIE_SetECUGroupClassification_ML: RteEventRef=OIE_SetECUGroupClassification_ML
        RteEventToTaskMapping_OIE_LimitChannelToNoComMode_CL000: RteEventRef=OIE_LimitChannelToNoComMode_CL000
        RteEventToTaskMapping_OIE_PreventWakeUp_CL000: RteEventRef=OIE_PreventWakeUp_CL000
        RteEventToTaskMapping_OIE_GetState_CL000: RteEventRef=OIE_GetState_CL000
        RteEventToTaskMapping_OIE_GetInhibitionStatus_CL000: RteEventRef=OIE_GetInhibitionStatus_CL000
        RteEventToTaskMapping_OIE_LimitChannelToNoComMode_CL001: RteEventRef=OIE_LimitChannelToNoComMode_CL001
        RteEventToTaskMapping_OIE_PreventWakeUp_CL001: RteEventRef=OIE_PreventWakeUp_CL001
        RteEventToTaskMapping_OIE_GetState_CL001: RteEventRef=OIE_GetState_CL001
        RteEventToTaskMapping_OIE_GetInhibitionStatus_CL001: RteEventRef=OIE_GetInhibitionStatus_CL001
        RteEventToTaskMapping_OIE_LimitChannelToNoComMode_CL002: RteEventRef=OIE_LimitChannelToNoComMode_CL002
        RteEventToTaskMapping_OIE_PreventWakeUp_CL002: RteEventRef=OIE_PreventWakeUp_CL002
        RteEventToTaskMapping_OIE_GetState_CL002: RteEventRef=OIE_GetState_CL002
        RteEventToTaskMapping_OIE_GetInhibitionStatus_CL002: RteEventRef=OIE_GetInhibitionStatus_CL002
        RteEventToTaskMapping_OIE_RequestComMode_UR000: RteEventRef=OIE_RequestComMode_UR000
        RteEventToTaskMapping_OIE_GetCurrentComMode_UR000: RteEventRef=OIE_GetCurrentComMode_UR000
        RteEventToTaskMapping_OIE_GetRequestedComMode_UR000: RteEventRef=OIE_GetRequestedComMode_UR000
        RteEventToTaskMapping_OIE_RequestComMode_UR001: RteEventRef=OIE_RequestComMode_UR001
        RteEventToTaskMapping_OIE_GetCurrentComMode_UR001: RteEventRef=OIE_GetCurrentComMode_UR001
        RteEventToTaskMapping_OIE_GetRequestedComMode_UR001: RteEventRef=OIE_GetRequestedComMode_UR001
        RteEventToTaskMapping_OIE_RequestComMode_UR002: RteEventRef=OIE_RequestComMode_UR002
        RteEventToTaskMapping_OIE_GetCurrentComMode_UR002: RteEventRef=OIE_GetCurrentComMode_UR002
        RteEventToTaskMapping_OIE_GetRequestedComMode_UR002: RteEventRef=OIE_GetRequestedComMode_UR002
        RteEventToTaskMapping_OIE_ComM_GetChannelBusLoad_ComM_GetChannelBusLoad_GetChannelBusLoad: RteEventRef=OIE_ComM_GetChannelBusLoad_ComM_GetChannelBusLoad_GetChannelBusLoad
        RteEventToTaskMapping_OperationInvokedEvent_RequestComMode_ComMUser_BCAN: RteEventRef=OperationInvokedEvent_RequestComMode_ComMUser_BCAN
        RteEventToTaskMapping_OperationInvokedEvent_GetCurrentComMode_ComMUser_BCAN: RteEventRef=OperationInvokedEvent_GetCurrentComMode_ComMUser_BCAN
        RteEventToTaskMapping_OperationInvokedEvent_GetRequestedComMode_ComMUser_BCAN: RteEventRef=OperationInvokedEvent_GetRequestedComMode_ComMUser_BCAN
        RteEventToTaskMapping_OperationInvokedEvent_RequestComMode_ComMUser_LOCALCAN: RteEventRef=OperationInvokedEvent_RequestComMode_ComMUser_LOCALCAN
        RteEventToTaskMapping_OperationInvokedEvent_GetCurrentComMode_ComMUser_LOCALCAN: RteEventRef=OperationInvokedEvent_GetCurrentComMode_ComMUser_LOCALCAN
        RteEventToTaskMapping_OperationInvokedEvent_GetRequestedComMode_ComMUser_LOCALCAN: RteEventRef=OperationInvokedEvent_GetRequestedComMode_ComMUser_LOCALCAN
    RteSwComponentType_ComM (RteSwComponentType): RteComponentTypeRef=ComM
      RteComponentTypeCalibration: category=TOOL_CONFIGURED, RteCalibrationSupportEnabled=0
    SwcInstance_DataLog (RteSwComponentInstance): category=TOOL_CONFIGURED, RteSoftwareComponentInstanceRef=DataLog
      RteEventToTaskMapping_OIE_CBReadData_DE_DataLog_CSDataServices_DE_DataLog_ReadData (RteEventToTaskMapping): category=TOOL_CONFIGURED, RteImmediateRestart=0, RteEventRef=OIE_CBReadData_DE_DataLog_CSDataServices_DE_DataLog_ReadData
    RteSwComponentType_DataLog (RteSwComponentType): RteComponentTypeRef=DataLog
      RteComponentTypeCalibration: category=TOOL_CONFIGURED, RteCalibrationSupportEnabled=0
    SwcInstance_WdgM (RteSwComponentInstance): category=TOOL_CONFIGURED, RteSoftwareComponentInstanceRef=WdgM
      14 x RteEventToTaskMapping, all with category=TOOL_CONFIGURED, RteImmediateRestart=0:
        RteEventToTaskMapping_OperationInvokedEvent_alive_SE_Init_CheckpointReached: RteEventRef=OperationInvokedEvent_alive_SE_Init_CheckpointReached
        RteEventToTaskMapping_OperationInvokedEvent_alive_SE_Init_UpdateAliveCounter: RteEventRef=OperationInvokedEvent_alive_SE_Init_UpdateAliveCounter
        RteEventToTaskMapping_OperationInvokedEvent_alive_SE_WdgMTest_CheckpointReached: RteEventRef=OperationInvokedEvent_alive_SE_WdgMTest_CheckpointReached
        RteEventToTaskMapping_OperationInvokedEvent_alive_SE_WdgMTest_UpdateAliveCounter: RteEventRef=OperationInvokedEvent_alive_SE_WdgMTest_UpdateAliveCounter
        RteEventToTaskMapping_OperationInvokedEvent_alive_SE_WdgMELS_01_CheckpointReached: RteEventRef=OperationInvokedEvent_alive_SE_WdgMELS_01_CheckpointReached
        RteEventToTaskMapping_OperationInvokedEvent_alive_SE_WdgMELS_01_UpdateAliveCounter: RteEventRef=OperationInvokedEvent_alive_SE_WdgMELS_01_UpdateAliveCounter
        RteEventToTaskMapping_OperationInvokedEvent_alive_SE_WdgMELS_02_CheckpointReached: RteEventRef=OperationInvokedEvent_alive_SE_WdgMELS_02_CheckpointReached
        RteEventToTaskMapping_OperationInvokedEvent_alive_SE_WdgMELS_02_UpdateAliveCounter: RteEventRef=OperationInvokedEvent_alive_SE_WdgMELS_02_UpdateAliveCounter
        RteEventToTaskMapping_OperationInvokedEvent_SetMode: RtePositionInTask=0, RteMappedToTaskRef=OsTask_BSW_FG2_WdgMAPI, RteEventRef=OperationInvokedEvent_SetMode
        RteEventToTaskMapping_OperationInvokedEvent_GetMode: RteEventRef=OperationInvokedEvent_GetMode
        RteEventToTaskMapping_OperationInvokedEvent_GetLocalStatus: RteEventRef=OperationInvokedEvent_GetLocalStatus
        RteEventToTaskMapping_OperationInvokedEvent_GetGlobalStatus: RteEventRef=OperationInvokedEvent_GetGlobalStatus
        RteEventToTaskMapping_OperationInvokedEvent_PerformReset: RtePositionInTask=1, RteMappedToTaskRef=OsTask_BSW_FG2_WdgMAPI, RteEventRef=OperationInvokedEvent_PerformReset
        RteEventToTaskMapping_OperationInvokedEvent_GetFirstExpiredSEID: RteEventRef=OperationInvokedEvent_GetFirstExpiredSEID
    RteSwComponentType_WdgM (RteSwComponentType): RteComponentTypeRef=WdgM
      RteComponentTypeCalibration: category=TOOL_CONFIGURED, RteCalibrationSupportEnabled=0
    SwcInstance_Dcm (RteSwComponentInstance): category=TOOL_CONFIGURED, RteSoftwareComponentInstanceRef=Dcm
      5 x RteEventToTaskMapping, all with category=TOOL_CONFIGURED, RteImmediateRestart=0:
        RteEventToTaskMapping_OIE_DCMServices_GetCertificationInfo: RteEventRef=OIE_DCMServices_GetCertificationInfo
        RteEventToTaskMapping_OIE_DCMServices_GetSecurityLevel: RteEventRef=OIE_DCMServices_GetSecurityLevel
        RteEventToTaskMapping_OIE_DCMServices_GetActiveProtocol: RteEventRef=OIE_DCMServices_GetActiveProtocol
        RteEventToTaskMapping_OIE_DCMServices_ResetToDefaultSession: RteEventRef=OIE_DCMServices_ResetToDefaultSession
        RteEventToTaskMapping_OIE_DCMServices_GetSesCtrlType: RteEventRef=OIE_DCMServices_GetSesCtrlType
    RteSwComponentType_Dcm (RteSwComponentType): RteComponentTypeRef=Dcm
      RteComponentTypeCalibration: category=TOOL_CONFIGURED, RteCalibrationSupportEnabled=0
    SwcInstance_Csm (RteSwComponentInstance): category=TOOL_CONFIGURED, RteSoftwareComponentInstanceRef=Csm
      45 x RteEventToTaskMapping, all with category=TOOL_CONFIGURED, RteImmediateRestart=0:
        RteEventToTaskMapping_OperationInvokedEvent_HaeAdvSeedKey_L9_Hash_HashStart: RteEventRef=OperationInvokedEvent_HaeAdvSeedKey_L9_Hash_HashStart
        RteEventToTaskMapping_OperationInvokedEvent_HaeAdvSeedKey_L9_Hash_HashUpdate: RteEventRef=OperationInvokedEvent_HaeAdvSeedKey_L9_Hash_HashUpdate
        RteEventToTaskMapping_OperationInvokedEvent_HaeAdvSeedKey_L9_Hash_HashFinish: RteEventRef=OperationInvokedEvent_HaeAdvSeedKey_L9_Hash_HashFinish
        RteEventToTaskMapping_OperationInvokedEvent_HaeSha1_Hash_HashStart: RteEventRef=OperationInvokedEvent_HaeSha1_Hash_HashStart
        RteEventToTaskMapping_OperationInvokedEvent_HaeSha1_Hash_HashUpdate: RteEventRef=OperationInvokedEvent_HaeSha1_Hash_HashUpdate
        RteEventToTaskMapping_OperationInvokedEvent_HaeSha1_Hash_HashFinish: RteEventRef=OperationInvokedEvent_HaeSha1_Hash_HashFinish
        RteEventToTaskMapping_OperationInvokedEvent_HaeSha256_Hash_HashStart: RteEventRef=OperationInvokedEvent_HaeSha256_Hash_HashStart
        RteEventToTaskMapping_OperationInvokedEvent_HaeSha256_Hash_HashUpdate: RteEventRef=OperationInvokedEvent_HaeSha256_Hash_HashUpdate
        RteEventToTaskMapping_OperationInvokedEvent_HaeSha256_Hash_HashFinish: RteEventRef=OperationInvokedEvent_HaeSha256_Hash_HashFinish
        RteEventToTaskMapping_OperationInvokedEvent_HaeHmacSha256Generate_MacGenerate_MacGenerateStart: RteEventRef=OperationInvokedEvent_HaeHmacSha256Generate_MacGenerate_MacGenerateStart
        RteEventToTaskMapping_OperationInvokedEvent_HaeHmacSha256Generate_MacGenerate_MacGenerateUpdate: RteEventRef=OperationInvokedEvent_HaeHmacSha256Generate_MacGenerate_MacGenerateUpdate
        RteEventToTaskMapping_OperationInvokedEvent_HaeHmacSha256Generate_MacGenerate_MacGenerateFinish: RteEventRef=OperationInvokedEvent_HaeHmacSha256Generate_MacGenerate_MacGenerateFinish
        RteEventToTaskMapping_OperationInvokedEvent_HaeHmacSha256Verify_MacVerify_MacVerifyStart: RteEventRef=OperationInvokedEvent_HaeHmacSha256Verify_MacVerify_MacVerifyStart
        RteEventToTaskMapping_OperationInvokedEvent_HaeHmacSha256Verify_MacVerify_MacVerifyUpdate: RteEventRef=OperationInvokedEvent_HaeHmacSha256Verify_MacVerify_MacVerifyUpdate
        RteEventToTaskMapping_OperationInvokedEvent_HaeHmacSha256Verify_MacVerify_MacVerifyFinish: RteEventRef=OperationInvokedEvent_HaeHmacSha256Verify_MacVerify_MacVerifyFinish
        RteEventToTaskMapping_OperationInvokedEvent_HaePseudoRandomGenerate_RandomGenerate_RandomGenerate: RteEventRef=OperationInvokedEvent_HaePseudoRandomGenerate_RandomGenerate_RandomGenerate
        RteEventToTaskMapping_OperationInvokedEvent_HaePseudoRandomGenerate_L9_RandomGenerate_RandomGenerate: RteEventRef=OperationInvokedEvent_HaePseudoRandomGenerate_L9_RandomGenerate_RandomGenerate
        RteEventToTaskMapping_OperationInvokedEvent_HaePseudoRandomSeed_RandomSeed_RandomSeedStart: RteEventRef=OperationInvokedEvent_HaePseudoRandomSeed_RandomSeed_RandomSeedStart
        RteEventToTaskMapping_OperationInvokedEvent_HaePseudoRandomSeed_RandomSeed_RandomSeedUpdate: RteEventRef=OperationInvokedEvent_HaePseudoRandomSeed_RandomSeed_RandomSeedUpdate
        RteEventToTaskMapping_OperationInvokedEvent_HaePseudoRandomSeed_RandomSeed_RandomSeedFinish: RteEventRef=OperationInvokedEvent_HaePseudoRandomSeed_RandomSeed_RandomSeedFinish
        RteEventToTaskMapping_OperationInvokedEvent_HaePseudoRandomSeed_L9_RandomSeed_RandomSeedStart: RteEventRef=OperationInvokedEvent_HaePseudoRandomSeed_L9_RandomSeed_RandomSeedStart
        RteEventToTaskMapping_OperationInvokedEvent_HaePseudoRandomSeed_L9_RandomSeed_RandomSeedUpdate: RteEventRef=OperationInvokedEvent_HaePseudoRandomSeed_L9_RandomSeed_RandomSeedUpdate
        RteEventToTaskMapping_OperationInvokedEvent_HaePseudoRandomSeed_L9_RandomSeed_RandomSeedFinish: RteEventRef=OperationInvokedEvent_HaePseudoRandomSeed_L9_RandomSeed_RandomSeedFinish
        RteEventToTaskMapping_OperationInvokedEvent_HaeAesEcbDecrypt_SymBlockDecrypt_SymBlockDecryptStart: RteEventRef=OperationInvokedEvent_HaeAesEcbDecrypt_SymBlockDecrypt_SymBlockDecryptStart
        RteEventToTaskMapping_OperationInvokedEvent_HaeAesEcbDecrypt_SymBlockDecrypt_SymBlockDecryptUpdate: RteEventRef=OperationInvokedEvent_HaeAesEcbDecrypt_SymBlockDecrypt_SymBlockDecryptUpdate
        RteEventToTaskMapping_OperationInvokedEvent_HaeAesEcbDecrypt_SymBlockDecrypt_SymBlockDecryptFinish: RteEventRef=OperationInvokedEvent_HaeAesEcbDecrypt_SymBlockDecrypt_SymBlockDecryptFinish
        RteEventToTaskMapping_OperationInvokedEvent_HaeAesEcbEncrypt_SymBlockEncrypt_SymBlockEncryptStart: RteEventRef=OperationInvokedEvent_HaeAesEcbEncrypt_SymBlockEncrypt_SymBlockEncryptStart
        RteEventToTaskMapping_OperationInvokedEvent_HaeAesEcbEncrypt_SymBlockEncrypt_SymBlockEncryptUpdate: RteEventRef=OperationInvokedEvent_HaeAesEcbEncrypt_SymBlockEncrypt_SymBlockEncryptUpdate
        RteEventToTaskMapping_OperationInvokedEvent_HaeAesEcbEncrypt_SymBlockEncrypt_SymBlockEncryptFinish: RteEventRef=OperationInvokedEvent_HaeAesEcbEncrypt_SymBlockEncrypt_SymBlockEncryptFinish
        RteEventToTaskMapping_OperationInvokedEvent_HaeAesCbcDecrypt_SymDecrypt_SymDecryptStart: RteEventRef=OperationInvokedEvent_HaeAesCbcDecrypt_SymDecrypt_SymDecryptStart
        RteEventToTaskMapping_OperationInvokedEvent_HaeAesCbcDecrypt_SymDecrypt_SymDecryptUpdate: RteEventRef=OperationInvokedEvent_HaeAesCbcDecrypt_SymDecrypt_SymDecryptUpdate
        RteEventToTaskMapping_OperationInvokedEvent_HaeAesCbcDecrypt_SymDecrypt_SymDecryptFinish: RteEventRef=OperationInvokedEvent_HaeAesCbcDecrypt_SymDecrypt_SymDecryptFinish
        RteEventToTaskMapping_OperationInvokedEvent_HaeAesCtrDecrypt_SymDecrypt_SymDecryptStart: RteEventRef=OperationInvokedEvent_HaeAesCtrDecrypt_SymDecrypt_SymDecryptStart
        RteEventToTaskMapping_OperationInvokedEvent_HaeAesCtrDecrypt_SymDecrypt_SymDecryptUpdate: RteEventRef=OperationInvokedEvent_HaeAesCtrDecrypt_SymDecrypt_SymDecryptUpdate
        RteEventToTaskMapping_OperationInvokedEvent_HaeAesCtrDecrypt_SymDecrypt_SymDecryptFinish: RteEventRef=OperationInvokedEvent_HaeAesCtrDecrypt_SymDecrypt_SymDecryptFinish
        RteEventToTaskMapping_OperationInvokedEvent_HaeAesCbcEncrypt_SymEncrypt_SymEncryptStart: RteEventRef=OperationInvokedEvent_HaeAesCbcEncrypt_SymEncrypt_SymEncryptStart
        RteEventToTaskMapping_OperationInvokedEvent_HaeAesCbcEncrypt_SymEncrypt_SymEncryptUpdate: RteEventRef=OperationInvokedEvent_HaeAesCbcEncrypt_SymEncrypt_SymEncryptUpdate
        RteEventToTaskMapping_OperationInvokedEvent_HaeAesCbcEncrypt_SymEncrypt_SymEncryptFinish: RteEventRef=OperationInvokedEvent_HaeAesCbcEncrypt_SymEncrypt_SymEncryptFinish
        RteEventToTaskMapping_OperationInvokedEvent_HaeAesCtrEncrypt_SymEncrypt_SymEncryptStart: RteEventRef=OperationInvokedEvent_HaeAesCtrEncrypt_SymEncrypt_SymEncryptStart
        RteEventToTaskMapping_OperationInvokedEvent_HaeAesCtrEncrypt_SymEncrypt_SymEncryptUpdate: RteEventRef=OperationInvokedEvent_HaeAesCtrEncrypt_SymEncrypt_SymEncryptUpdate
        RteEventToTaskMapping_OperationInvokedEvent_HaeAesCtrEncrypt_SymEncrypt_SymEncryptFinish: RteEventRef=OperationInvokedEvent_HaeAesCtrEncrypt_SymEncrypt_SymEncryptFinish
        RteEventToTaskMapping_OperationInvokedEvent_HaeHsmPseudoRandomGenerate_L9_RandomGenerate_RandomGenerate: RteEventRef=OperationInvokedEvent_HaeHsmPseudoRandomGenerate_L9_RandomGenerate_RandomGenerate
        RteEventToTaskMapping_OperationInvokedEvent_HaePkcs1V15Sha256Generate_SignatureGenerate_SignatureGenerateStart: RteEventRef=OperationInvokedEvent_HaePkcs1V15Sha256Generate_SignatureGenerate_SignatureGenerateStart
        RteEventToTaskMapping_OperationInvokedEvent_HaePkcs1V15Sha256Generate_SignatureGenerate_SignatureGenerateUpdate: RteEventRef=OperationInvokedEvent_HaePkcs1V15Sha256Generate_SignatureGenerate_SignatureGenerateUpdate
        RteEventToTaskMapping_OperationInvokedEvent_HaePkcs1V15Sha256Generate_SignatureGenerate_SignatureGenerateFinish: RteEventRef=OperationInvokedEvent_HaePkcs1V15Sha256Generate_SignatureGenerate_SignatureGenerateFinish
    RteSwComponentType_Csm (RteSwComponentType): RteComponentTypeRef=Csm
      RteComponentTypeCalibration: category=TOOL_CONFIGURED, RteCalibrationSupportEnabled=0
    SwcInstance_NvM (RteSwComponentInstance): category=TOOL_CONFIGURED, RteSoftwareComponentInstanceRef=NvM
      56 x RteEventToTaskMapping, all with category=TOOL_CONFIGURED, RteImmediateRestart=0:
        RteEventToTaskMapping_OperationInvokedEvent_PS_NvMBlock_ConfigID_CancelJobs: RteEventRef=OperationInvokedEvent_PS_NvMBlock_ConfigID_CancelJobs
        RteEventToTaskMapping_OperationInvokedEvent_PS_NvMBlock_ConfigID_EraseNvBlock: RteEventRef=OperationInvokedEvent_PS_NvMBlock_ConfigID_EraseNvBlock
        RteEventToTaskMapping_OperationInvokedEvent_PS_NvMBlock_ConfigID_GetErrorStatus: RteEventRef=OperationInvokedEvent_PS_NvMBlock_ConfigID_GetErrorStatus
        RteEventToTaskMapping_OperationInvokedEvent_PS_NvMBlock_ConfigID_InvalidateNvBlock: RteEventRef=OperationInvokedEvent_PS_NvMBlock_ConfigID_InvalidateNvBlock
        RteEventToTaskMapping_OperationInvokedEvent_PS_NvMBlock_ConfigID_ReadBlock: RteEventRef=OperationInvokedEvent_PS_NvMBlock_ConfigID_ReadBlock
        RteEventToTaskMapping_OperationInvokedEvent_PS_NvMBlock_ConfigID_RestoreBlockDefaults: RteEventRef=OperationInvokedEvent_PS_NvMBlock_ConfigID_RestoreBlockDefaults
        RteEventToTaskMapping_OperationInvokedEvent_PS_NvMBlock_ConfigID_WriteBlock: RteEventRef=OperationInvokedEvent_PS_NvMBlock_ConfigID_WriteBlock
        RteEventToTaskMapping_OperationInvokedEvent_PS_NvMBlock_Option_CancelJobs: RteEventRef=OperationInvokedEvent_PS_NvMBlock_Option_CancelJobs
        RteEventToTaskMapping_OperationInvokedEvent_PS_NvMBlock_Option_EraseNvBlock: RteEventRef=OperationInvokedEvent_PS_NvMBlock_Option_EraseNvBlock
        RteEventToTaskMapping_OperationInvokedEvent_PS_NvMBlock_Option_GetErrorStatus: RteEventRef=OperationInvokedEvent_PS_NvMBlock_Option_GetErrorStatus
        RteEventToTaskMapping_OperationInvokedEvent_PS_NvMBlock_Option_InvalidateNvBlock: RteEventRef=OperationInvokedEvent_PS_NvMBlock_Option_InvalidateNvBlock
        RteEventToTaskMapping_OperationInvokedEvent_PS_NvMBlock_Option_ReadBlock: RteEventRef=OperationInvokedEvent_PS_NvMBlock_Option_ReadBlock
        RteEventToTaskMapping_OperationInvokedEvent_PS_NvMBlock_Option_RestoreBlockDefaults: RteEventRef=OperationInvokedEvent_PS_NvMBlock_Option_RestoreBlockDefaults
        RteEventToTaskMapping_OperationInvokedEvent_PS_NvMBlock_Option_WriteBlock: RteEventRef=OperationInvokedEvent_PS_NvMBlock_Option_WriteBlock
        RteEventToTaskMapping_OperationInvokedEvent_PS_NvMBlock_Function_CancelJobs: RteEventRef=OperationInvokedEvent_PS_NvMBlock_Function_CancelJobs
        RteEventToTaskMapping_OperationInvokedEvent_PS_NvMBlock_Function_EraseNvBlock: RteEventRef=OperationInvokedEvent_PS_NvMBlock_Function_EraseNvBlock
        RteEventToTaskMapping_OperationInvokedEvent_PS_NvMBlock_Function_GetErrorStatus: RteEventRef=OperationInvokedEvent_PS_NvMBlock_Function_GetErrorStatus
        RteEventToTaskMapping_OperationInvokedEvent_PS_NvMBlock_Function_InvalidateNvBlock: RteEventRef=OperationInvokedEvent_PS_NvMBlock_Function_InvalidateNvBlock
        RteEventToTaskMapping_OperationInvokedEvent_PS_NvMBlock_Function_ReadBlock: RteEventRef=OperationInvokedEvent_PS_NvMBlock_Function_ReadBlock
        RteEventToTaskMapping_OperationInvokedEvent_PS_NvMBlock_Function_RestoreBlockDefaults: RteEventRef=OperationInvokedEvent_PS_NvMBlock_Function_RestoreBlockDefaults
        RteEventToTaskMapping_OperationInvokedEvent_PS_NvMBlock_Function_WriteBlock: RteEventRef=OperationInvokedEvent_PS_NvMBlock_Function_WriteBlock
        RteEventToTaskMapping_OperationInvokedEvent_PS_NvMBlock_DTCInfo_CancelJobs: RteEventRef=OperationInvokedEvent_PS_NvMBlock_DTCInfo_CancelJobs
        RteEventToTaskMapping_OperationInvokedEvent_PS_NvMBlock_DTCInfo_EraseNvBlock: RteEventRef=OperationInvokedEvent_PS_NvMBlock_DTCInfo_EraseNvBlock
        RteEventToTaskMapping_OperationInvokedEvent_PS_NvMBlock_DTCInfo_GetErrorStatus: RteEventRef=OperationInvokedEvent_PS_NvMBlock_DTCInfo_GetErrorStatus
        RteEventToTaskMapping_OperationInvokedEvent_PS_NvMBlock_DTCInfo_InvalidateNvBlock: RteEventRef=OperationInvokedEvent_PS_NvMBlock_DTCInfo_InvalidateNvBlock
        RteEventToTaskMapping_OperationInvokedEvent_PS_NvMBlock_DTCInfo_ReadBlock: RteEventRef=OperationInvokedEvent_PS_NvMBlock_DTCInfo_ReadBlock
        RteEventToTaskMapping_OperationInvokedEvent_PS_NvMBlock_DTCInfo_RestoreBlockDefaults: RteEventRef=OperationInvokedEvent_PS_NvMBlock_DTCInfo_RestoreBlockDefaults
        RteEventToTaskMapping_OperationInvokedEvent_PS_NvMBlock_DTCInfo_WriteBlock: RteEventRef=OperationInvokedEvent_PS_NvMBlock_DTCInfo_WriteBlock
        RteEventToTaskMapping_OperationInvokedEvent_PS_NvMBlock_SerialNO_CancelJobs: RteEventRef=OperationInvokedEvent_PS_NvMBlock_SerialNO_CancelJobs
        RteEventToTaskMapping_OperationInvokedEvent_PS_NvMBlock_SerialNO_EraseNvBlock: RteEventRef=OperationInvokedEvent_PS_NvMBlock_SerialNO_EraseNvBlock
        RteEventToTaskMapping_OperationInvokedEvent_PS_NvMBlock_SerialNO_GetErrorStatus: RteEventRef=OperationInvokedEvent_PS_NvMBlock_SerialNO_GetErrorStatus
        RteEventToTaskMapping_OperationInvokedEvent_PS_NvMBlock_SerialNO_InvalidateNvBlock: RteEventRef=OperationInvokedEvent_PS_NvMBlock_SerialNO_InvalidateNvBlock
        RteEventToTaskMapping_OperationInvokedEvent_PS_NvMBlock_SerialNO_ReadBlock: RteEventRef=OperationInvokedEvent_PS_NvMBlock_SerialNO_ReadBlock
        RteEventToTaskMapping_OperationInvokedEvent_PS_NvMBlock_SerialNO_RestoreBlockDefaults: RteEventRef=OperationInvokedEvent_PS_NvMBlock_SerialNO_RestoreBlockDefaults
        RteEventToTaskMapping_OperationInvokedEvent_PS_NvMBlock_SerialNO_WriteBlock: RteEventRef=OperationInvokedEvent_PS_NvMBlock_SerialNO_WriteBlock
        RteEventToTaskMapping_OperationInvokedEvent_PS_NvMBlock_MDate_CancelJobs: RteEventRef=OperationInvokedEvent_PS_NvMBlock_MDate_CancelJobs
        RteEventToTaskMapping_OperationInvokedEvent_PS_NvMBlock_MDate_EraseNvBlock: RteEventRef=OperationInvokedEvent_PS_NvMBlock_MDate_EraseNvBlock
        RteEventToTaskMapping_OperationInvokedEvent_PS_NvMBlock_MDate_GetErrorStatus: RteEventRef=OperationInvokedEvent_PS_NvMBlock_MDate_GetErrorStatus
        RteEventToTaskMapping_OperationInvokedEvent_PS_NvMBlock_MDate_InvalidateNvBlock: RteEventRef=OperationInvokedEvent_PS_NvMBlock_MDate_InvalidateNvBlock
        RteEventToTaskMapping_OperationInvokedEvent_PS_NvMBlock_MDate_ReadBlock: RteEventRef=OperationInvokedEvent_PS_NvMBlock_MDate_ReadBlock
        RteEventToTaskMapping_OperationInvokedEvent_PS_NvMBlock_MDate_RestoreBlockDefaults: RteEventRef=OperationInvokedEvent_PS_NvMBlock_MDate_RestoreBlockDefaults
        RteEventToTaskMapping_OperationInvokedEvent_PS_NvMBlock_MDate_WriteBlock: RteEventRef=OperationInvokedEvent_PS_NvMBlock_MDate_WriteBlock
        RteEventToTaskMapping_OperationInvokedEvent_PS_NvMBlock_PartNO_CancelJobs: RteEventRef=OperationInvokedEvent_PS_NvMBlock_PartNO_CancelJobs
        RteEventToTaskMapping_OperationInvokedEvent_PS_NvMBlock_PartNO_EraseNvBlock: RteEventRef=OperationInvokedEvent_PS_NvMBlock_PartNO_EraseNvBlock
        RteEventToTaskMapping_OperationInvokedEvent_PS_NvMBlock_PartNO_GetErrorStatus: RteEventRef=OperationInvokedEvent_PS_NvMBlock_PartNO_GetErrorStatus
        RteEventToTaskMapping_OperationInvokedEvent_PS_NvMBlock_PartNO_InvalidateNvBlock: RteEventRef=OperationInvokedEvent_PS_NvMBlock_PartNO_InvalidateNvBlock
        RteEventToTaskMapping_OperationInvokedEvent_PS_NvMBlock_PartNO_ReadBlock: RteEventRef=OperationInvokedEvent_PS_NvMBlock_PartNO_ReadBlock
        RteEventToTaskMapping_OperationInvokedEvent_PS_NvMBlock_PartNO_RestoreBlockDefaults: RteEventRef=OperationInvokedEvent_PS_NvMBlock_PartNO_RestoreBlockDefaults
        RteEventToTaskMapping_OperationInvokedEvent_PS_NvMBlock_PartNO_WriteBlock: RteEventRef=OperationInvokedEvent_PS_NvMBlock_PartNO_WriteBlock
        RteEventToTaskMapping_OperationInvokedEvent_PS_NvMBlock_Dummy_CancelJobs: RteEventRef=OperationInvokedEvent_PS_NvMBlock_Dummy_CancelJobs
        RteEventToTaskMapping_OperationInvokedEvent_PS_NvMBlock_Dummy_EraseNvBlock: RteEventRef=OperationInvokedEvent_PS_NvMBlock_Dummy_EraseNvBlock
        RteEventToTaskMapping_OperationInvokedEvent_PS_NvMBlock_Dummy_GetErrorStatus: RteEventRef=OperationInvokedEvent_PS_NvMBlock_Dummy_GetErrorStatus
        RteEventToTaskMapping_OperationInvokedEvent_PS_NvMBlock_Dummy_InvalidateNvBlock: RteEventRef=OperationInvokedEvent_PS_NvMBlock_Dummy_InvalidateNvBlock
        RteEventToTaskMapping_OperationInvokedEvent_PS_NvMBlock_Dummy_ReadBlock: RteEventRef=OperationInvokedEvent_PS_NvMBlock_Dummy_ReadBlock
        RteEventToTaskMapping_OperationInvokedEvent_PS_NvMBlock_Dummy_RestoreBlockDefaults: RteEventRef=OperationInvokedEvent_PS_NvMBlock_Dummy_RestoreBlockDefaults
        RteEventToTaskMapping_OperationInvokedEvent_PS_NvMBlock_Dummy_WriteBlock: RteEventRef=OperationInvokedEvent_PS_NvMBlock_Dummy_WriteBlock
    RteSwComponentType_NvM (RteSwComponentType): RteComponentTypeRef=NvM
      RteComponentTypeCalibration: category=TOOL_CONFIGURED, RteCalibrationSupportEnabled=0
    SwcInstance_Dem (RteSwComponentInstance): category=TOOL_CONFIGURED, RteSoftwareComponentInstanceRef=Dem
      389 x RteEventToTaskMapping, all with category=TOOL_CONFIGURED, RteImmediateRestart=0:
        RteEventToTaskMapping_OIE_Cdd_ClearDTC: RteEventRef=OIE_Cdd_ClearDTC
        RteEventToTaskMapping_OIE_ControlDTCSuppression_SetDTCSuppression: RteEventRef=OIE_ControlDTCSuppression_SetDTCSuppression
        RteEventToTaskMapping_OIE_EnableCond_DemEnableCondition_SetEnableCondition: RteEventRef=OIE_EnableCond_DemEnableCondition_SetEnableCondition
        RteEventToTaskMapping_OIE_EventInfo_ADC_E_HARDWARE_ERROR_GetDTCOfEvent: RteEventRef=OIE_EventInfo_ADC_E_HARDWARE_ERROR_GetDTCOfEvent
        RteEventToTaskMapping_OIE_EventInfo_ADC_E_HARDWARE_ERROR_GetEventExtendedDataRecord: RteEventRef=OIE_EventInfo_ADC_E_HARDWARE_ERROR_GetEventExtendedDataRecord
        RteEventToTaskMapping_OIE_EventInfo_ADC_E_HARDWARE_ERROR_GetEventFailed: RteEventRef=OIE_EventInfo_ADC_E_HARDWARE_ERROR_GetEventFailed
        RteEventToTaskMapping_OIE_EventInfo_ADC_E_HARDWARE_ERROR_GetEventFreezeFrameData: RteEventRef=OIE_EventInfo_ADC_E_HARDWARE_ERROR_GetEventFreezeFrameData
        RteEventToTaskMapping_OIE_EventInfo_ADC_E_HARDWARE_ERROR_GetEventStatus: RteEventRef=OIE_EventInfo_ADC_E_HARDWARE_ERROR_GetEventStatus
        RteEventToTaskMapping_OIE_EventInfo_ADC_E_HARDWARE_ERROR_GetEventTested: RteEventRef=OIE_EventInfo_ADC_E_HARDWARE_ERROR_GetEventTested
        RteEventToTaskMapping_OIE_EventInfo_ADC_E_HARDWARE_ERROR_GetFaultDetectionCounter: RteEventRef=OIE_EventInfo_ADC_E_HARDWARE_ERROR_GetFaultDetectionCounter
        RteEventToTaskMapping_OIE_EventInfo_CANCM_E_BAT_FAIL_GetDTCOfEvent: RteEventRef=OIE_EventInfo_CANCM_E_BAT_FAIL_GetDTCOfEvent
        RteEventToTaskMapping_OIE_EventInfo_CANCM_E_BAT_FAIL_GetEventExtendedDataRecord: RteEventRef=OIE_EventInfo_CANCM_E_BAT_FAIL_GetEventExtendedDataRecord
        RteEventToTaskMapping_OIE_EventInfo_CANCM_E_BAT_FAIL_GetEventFailed: RteEventRef=OIE_EventInfo_CANCM_E_BAT_FAIL_GetEventFailed
        RteEventToTaskMapping_OIE_EventInfo_CANCM_E_BAT_FAIL_GetEventFreezeFrameData: RteEventRef=OIE_EventInfo_CANCM_E_BAT_FAIL_GetEventFreezeFrameData
        RteEventToTaskMapping_OIE_EventInfo_CANCM_E_BAT_FAIL_GetEventStatus: RteEventRef=OIE_EventInfo_CANCM_E_BAT_FAIL_GetEventStatus
        RteEventToTaskMapping_OIE_EventInfo_CANCM_E_BAT_FAIL_GetEventTested: RteEventRef=OIE_EventInfo_CANCM_E_BAT_FAIL_GetEventTested
        RteEventToTaskMapping_OIE_EventInfo_CANCM_E_BAT_FAIL_GetFaultDetectionCounter: RteEventRef=OIE_EventInfo_CANCM_E_BAT_FAIL_GetFaultDetectionCounter
        RteEventToTaskMapping_OIE_EventInfo_CANSM_E_BUS_OFF_BCAN_GetDTCOfEvent: RteEventRef=OIE_EventInfo_CANSM_E_BUS_OFF_BCAN_GetDTCOfEvent
        RteEventToTaskMapping_OIE_EventInfo_CANSM_E_BUS_OFF_BCAN_GetEventExtendedDataRecord: RteEventRef=OIE_EventInfo_CANSM_E_BUS_OFF_BCAN_GetEventExtendedDataRecord
        RteEventToTaskMapping_OIE_EventInfo_CANSM_E_BUS_OFF_BCAN_GetEventFailed: RteEventRef=OIE_EventInfo_CANSM_E_BUS_OFF_BCAN_GetEventFailed
        RteEventToTaskMapping_OIE_EventInfo_CANSM_E_BUS_OFF_BCAN_GetEventFreezeFrameData: RteEventRef=OIE_EventInfo_CANSM_E_BUS_OFF_BCAN_GetEventFreezeFrameData
        RteEventToTaskMapping_OIE_EventInfo_CANSM_E_BUS_OFF_BCAN_GetEventStatus: RteEventRef=OIE_EventInfo_CANSM_E_BUS_OFF_BCAN_GetEventStatus
        RteEventToTaskMapping_OIE_EventInfo_CANSM_E_BUS_OFF_BCAN_GetEventTested: RteEventRef=OIE_EventInfo_CANSM_E_BUS_OFF_BCAN_GetEventTested
        RteEventToTaskMapping_OIE_EventInfo_CANSM_E_BUS_OFF_BCAN_GetFaultDetectionCounter: RteEventRef=OIE_EventInfo_CANSM_E_BUS_OFF_BCAN_GetFaultDetectionCounter
        RteEventToTaskMapping_OIE_EventInfo_CANSM_E_BUS_OFF_LOCALCAN_GetDTCOfEvent: RteEventRef=OIE_EventInfo_CANSM_E_BUS_OFF_LOCALCAN_GetDTCOfEvent
        RteEventToTaskMapping_OIE_EventInfo_CANSM_E_BUS_OFF_LOCALCAN_GetEventExtendedDataRecord: RteEventRef=OIE_EventInfo_CANSM_E_BUS_OFF_LOCALCAN_GetEventExtendedDataRecord
        RteEventToTaskMapping_OIE_EventInfo_CANSM_E_BUS_OFF_LOCALCAN_GetEventFailed: RteEventRef=OIE_EventInfo_CANSM_E_BUS_OFF_LOCALCAN_GetEventFailed
        RteEventToTaskMapping_OIE_EventInfo_CANSM_E_BUS_OFF_LOCALCAN_GetEventFreezeFrameData: RteEventRef=OIE_EventInfo_CANSM_E_BUS_OFF_LOCALCAN_GetEventFreezeFrameData
        RteEventToTaskMapping_OIE_EventInfo_CANSM_E_BUS_OFF_LOCALCAN_GetEventStatus: RteEventRef=OIE_EventInfo_CANSM_E_BUS_OFF_LOCALCAN_GetEventStatus
        RteEventToTaskMapping_OIE_EventInfo_CANSM_E_BUS_OFF_LOCALCAN_GetEventTested: RteEventRef=OIE_EventInfo_CANSM_E_BUS_OFF_LOCALCAN_GetEventTested
        RteEventToTaskMapping_OIE_EventInfo_CANSM_E_BUS_OFF_LOCALCAN_GetFaultDetectionCounter: RteEventRef=OIE_EventInfo_CANSM_E_BUS_OFF_LOCALCAN_GetFaultDetectionCounter
        RteEventToTaskMapping_OIE_EventInfo_CANSM_E_MODE_CHANGE_BCAN_GetDTCOfEvent: RteEventRef=OIE_EventInfo_CANSM_E_MODE_CHANGE_BCAN_GetDTCOfEvent
        RteEventToTaskMapping_OIE_EventInfo_CANSM_E_MODE_CHANGE_BCAN_GetEventExtendedDataRecord: RteEventRef=OIE_EventInfo_CANSM_E_MODE_CHANGE_BCAN_GetEventExtendedDataRecord
        RteEventToTaskMapping_OIE_EventInfo_CANSM_E_MODE_CHANGE_BCAN_GetEventFailed: RteEventRef=OIE_EventInfo_CANSM_E_MODE_CHANGE_BCAN_GetEventFailed
        RteEventToTaskMapping_OIE_EventInfo_CANSM_E_MODE_CHANGE_BCAN_GetEventFreezeFrameData: RteEventRef=OIE_EventInfo_CANSM_E_MODE_CHANGE_BCAN_GetEventFreezeFrameData
        RteEventToTaskMapping_OIE_EventInfo_CANSM_E_MODE_CHANGE_BCAN_GetEventStatus: RteEventRef=OIE_EventInfo_CANSM_E_MODE_CHANGE_BCAN_GetEventStatus
        RteEventToTaskMapping_OIE_EventInfo_CANSM_E_MODE_CHANGE_BCAN_GetEventTested: RteEventRef=OIE_EventInfo_CANSM_E_MODE_CHANGE_BCAN_GetEventTested
        RteEventToTaskMapping_OIE_EventInfo_CANSM_E_MODE_CHANGE_BCAN_GetFaultDetectionCounter: RteEventRef=OIE_EventInfo_CANSM_E_MODE_CHANGE_BCAN_GetFaultDetectionCounter
        RteEventToTaskMapping_OIE_EventInfo_CANSM_E_MODE_CHANGE_LOCALCAN_GetDTCOfEvent: RteEventRef=OIE_EventInfo_CANSM_E_MODE_CHANGE_LOCALCAN_GetDTCOfEvent
        RteEventToTaskMapping_OIE_EventInfo_CANSM_E_MODE_CHANGE_LOCALCAN_GetEventExtendedDataRecord: RteEventRef=OIE_EventInfo_CANSM_E_MODE_CHANGE_LOCALCAN_GetEventExtendedDataRecord
        RteEventToTaskMapping_OIE_EventInfo_CANSM_E_MODE_CHANGE_LOCALCAN_GetEventFailed: RteEventRef=OIE_EventInfo_CANSM_E_MODE_CHANGE_LOCALCAN_GetEventFailed
        RteEventToTaskMapping_OIE_EventInfo_CANSM_E_MODE_CHANGE_LOCALCAN_GetEventFreezeFrameData: RteEventRef=OIE_EventInfo_CANSM_E_MODE_CHANGE_LOCALCAN_GetEventFreezeFrameData
        RteEventToTaskMapping_OIE_EventInfo_CANSM_E_MODE_CHANGE_LOCALCAN_GetEventStatus: RteEventRef=OIE_EventInfo_CANSM_E_MODE_CHANGE_LOCALCAN_GetEventStatus
        RteEventToTaskMapping_OIE_EventInfo_CANSM_E_MODE_CHANGE_LOCALCAN_GetEventTested: RteEventRef=OIE_EventInfo_CANSM_E_MODE_CHANGE_LOCALCAN_GetEventTested
        RteEventToTaskMapping_OIE_EventInfo_CANSM_E_MODE_CHANGE_LOCALCAN_GetFaultDetectionCounter: RteEventRef=OIE_EventInfo_CANSM_E_MODE_CHANGE_LOCALCAN_GetFaultDetectionCounter
        RteEventToTaskMapping_OIE_EventInfo_CAN_E_HARDWARE_ERROR_GetDTCOfEvent: RteEventRef=OIE_EventInfo_CAN_E_HARDWARE_ERROR_GetDTCOfEvent
        RteEventToTaskMapping_OIE_EventInfo_CAN_E_HARDWARE_ERROR_GetEventExtendedDataRecord: RteEventRef=OIE_EventInfo_CAN_E_HARDWARE_ERROR_GetEventExtendedDataRecord
        RteEventToTaskMapping_OIE_EventInfo_CAN_E_HARDWARE_ERROR_GetEventFailed: RteEventRef=OIE_EventInfo_CAN_E_HARDWARE_ERROR_GetEventFailed
        RteEventToTaskMapping_OIE_EventInfo_CAN_E_HARDWARE_ERROR_GetEventFreezeFrameData: RteEventRef=OIE_EventInfo_CAN_E_HARDWARE_ERROR_GetEventFreezeFrameData
        RteEventToTaskMapping_OIE_EventInfo_CAN_E_HARDWARE_ERROR_GetEventStatus: RteEventRef=OIE_EventInfo_CAN_E_HARDWARE_ERROR_GetEventStatus
        RteEventToTaskMapping_OIE_EventInfo_CAN_E_HARDWARE_ERROR_GetEventTested: RteEventRef=OIE_EventInfo_CAN_E_HARDWARE_ERROR_GetEventTested
        RteEventToTaskMapping_OIE_EventInfo_CAN_E_HARDWARE_ERROR_GetFaultDetectionCounter: RteEventRef=OIE_EventInfo_CAN_E_HARDWARE_ERROR_GetFaultDetectionCounter
        RteEventToTaskMapping_OIE_EventInfo_DATALOG_E_EVENT_GetDTCOfEvent: RteEventRef=OIE_EventInfo_DATALOG_E_EVENT_GetDTCOfEvent
        RteEventToTaskMapping_OIE_EventInfo_DATALOG_E_EVENT_GetEventExtendedDataRecord: RteEventRef=OIE_EventInfo_DATALOG_E_EVENT_GetEventExtendedDataRecord
        RteEventToTaskMapping_OIE_EventInfo_DATALOG_E_EVENT_GetEventFailed: RteEventRef=OIE_EventInfo_DATALOG_E_EVENT_GetEventFailed
        RteEventToTaskMapping_OIE_EventInfo_DATALOG_E_EVENT_GetEventFreezeFrameData: RteEventRef=OIE_EventInfo_DATALOG_E_EVENT_GetEventFreezeFrameData
        RteEventToTaskMapping_OIE_EventInfo_DATALOG_E_EVENT_GetEventStatus: RteEventRef=OIE_EventInfo_DATALOG_E_EVENT_GetEventStatus
        RteEventToTaskMapping_OIE_EventInfo_DATALOG_E_EVENT_GetEventTested: RteEventRef=OIE_EventInfo_DATALOG_E_EVENT_GetEventTested
        RteEventToTaskMapping_OIE_EventInfo_DATALOG_E_EVENT_GetFaultDetectionCounter: RteEventRef=OIE_EventInfo_DATALOG_E_EVENT_GetFaultDetectionCounter
        RteEventToTaskMapping_OIE_EventInfo_DEM_E_TEST_EVENT1_GetDTCOfEvent: RteEventRef=OIE_EventInfo_DEM_E_TEST_EVENT1_GetDTCOfEvent
        RteEventToTaskMapping_OIE_EventInfo_DEM_E_TEST_EVENT1_GetEventExtendedDataRecord: RteEventRef=OIE_EventInfo_DEM_E_TEST_EVENT1_GetEventExtendedDataRecord
        RteEventToTaskMapping_OIE_EventInfo_DEM_E_TEST_EVENT1_GetEventFailed: RteEventRef=OIE_EventInfo_DEM_E_TEST_EVENT1_GetEventFailed
        RteEventToTaskMapping_OIE_EventInfo_DEM_E_TEST_EVENT1_GetEventFreezeFrameData: RteEventRef=OIE_EventInfo_DEM_E_TEST_EVENT1_GetEventFreezeFrameData
        RteEventToTaskMapping_OIE_EventInfo_DEM_E_TEST_EVENT1_GetEventStatus: RteEventRef=OIE_EventInfo_DEM_E_TEST_EVENT1_GetEventStatus
        RteEventToTaskMapping_OIE_EventInfo_DEM_E_TEST_EVENT1_GetEventTested: RteEventRef=OIE_EventInfo_DEM_E_TEST_EVENT1_GetEventTested
        RteEventToTaskMapping_OIE_EventInfo_DEM_E_TEST_EVENT1_GetFaultDetectionCounter: RteEventRef=OIE_EventInfo_DEM_E_TEST_EVENT1_GetFaultDetectionCounter
        RteEventToTaskMapping_OIE_EventInfo_DEM_E_TEST_EVENT2_GetDTCOfEvent: RteEventRef=OIE_EventInfo_DEM_E_TEST_EVENT2_GetDTCOfEvent
        RteEventToTaskMapping_OIE_EventInfo_DEM_E_TEST_EVENT2_GetEventExtendedDataRecord: RteEventRef=OIE_EventInfo_DEM_E_TEST_EVENT2_GetEventExtendedDataRecord
        RteEventToTaskMapping_OIE_EventInfo_DEM_E_TEST_EVENT2_GetEventFailed: RteEventRef=OIE_EventInfo_DEM_E_TEST_EVENT2_GetEventFailed
        RteEventToTaskMapping_OIE_EventInfo_DEM_E_TEST_EVENT2_GetEventFreezeFrameData: RteEventRef=OIE_EventInfo_DEM_E_TEST_EVENT2_GetEventFreezeFrameData
        RteEventToTaskMapping_OIE_EventInfo_DEM_E_TEST_EVENT2_GetEventStatus: RteEventRef=OIE_EventInfo_DEM_E_TEST_EVENT2_GetEventStatus
        RteEventToTaskMapping_OIE_EventInfo_DEM_E_TEST_EVENT2_GetEventTested: RteEventRef=OIE_EventInfo_DEM_E_TEST_EVENT2_GetEventTested
        RteEventToTaskMapping_OIE_EventInfo_DEM_E_TEST_EVENT2_GetFaultDetectionCounter: RteEventRef=OIE_EventInfo_DEM_E_TEST_EVENT2_GetFaultDetectionCounter
        RteEventToTaskMapping_OIE_EventInfo_DEM_E_TEST_EVENT3_GetDTCOfEvent: RteEventRef=OIE_EventInfo_DEM_E_TEST_EVENT3_GetDTCOfEvent
        RteEventToTaskMapping_OIE_EventInfo_DEM_E_TEST_EVENT3_GetEventExtendedDataRecord: RteEventRef=OIE_EventInfo_DEM_E_TEST_EVENT3_GetEventExtendedDataRecord
        RteEventToTaskMapping_OIE_EventInfo_DEM_E_TEST_EVENT3_GetEventFailed: RteEventRef=OIE_EventInfo_DEM_E_TEST_EVENT3_GetEventFailed
        RteEventToTaskMapping_OIE_EventInfo_DEM_E_TEST_EVENT3_GetEventFreezeFrameData: RteEventRef=OIE_EventInfo_DEM_E_TEST_EVENT3_GetEventFreezeFrameData
        RteEventToTaskMapping_OIE_EventInfo_DEM_E_TEST_EVENT3_GetEventStatus: RteEventRef=OIE_EventInfo_DEM_E_TEST_EVENT3_GetEventStatus
        RteEventToTaskMapping_OIE_EventInfo_DEM_E_TEST_EVENT3_GetEventTested: RteEventRef=OIE_EventInfo_DEM_E_TEST_EVENT3_GetEventTested
        RteEventToTaskMapping_OIE_EventInfo_DEM_E_TEST_EVENT3_GetFaultDetectionCounter: RteEventRef=OIE_EventInfo_DEM_E_TEST_EVENT3_GetFaultDetectionCounter
        RteEventToTaskMapping_OIE_EventInfo_DEM_E_TEST_EVENT4_GetDTCOfEvent: RteEventRef=OIE_EventInfo_DEM_E_TEST_EVENT4_GetDTCOfEvent
        RteEventToTaskMapping_OIE_EventInfo_DEM_E_TEST_EVENT4_GetEventExtendedDataRecord: RteEventRef=OIE_EventInfo_DEM_E_TEST_EVENT4_GetEventExtendedDataRecord
        RteEventToTaskMapping_OIE_EventInfo_DEM_E_TEST_EVENT4_GetEventFailed: RteEventRef=OIE_EventInfo_DEM_E_TEST_EVENT4_GetEventFailed
        RteEventToTaskMapping_OIE_EventInfo_DEM_E_TEST_EVENT4_GetEventFreezeFrameData: RteEventRef=OIE_EventInfo_DEM_E_TEST_EVENT4_GetEventFreezeFrameData
        RteEventToTaskMapping_OIE_EventInfo_DEM_E_TEST_EVENT4_GetEventStatus: RteEventRef=OIE_EventInfo_DEM_E_TEST_EVENT4_GetEventStatus
        RteEventToTaskMapping_OIE_EventInfo_DEM_E_TEST_EVENT4_GetEventTested: RteEventRef=OIE_EventInfo_DEM_E_TEST_EVENT4_GetEventTested
        RteEventToTaskMapping_OIE_EventInfo_DEM_E_TEST_EVENT4_GetFaultDetectionCounter: RteEventRef=OIE_EventInfo_DEM_E_TEST_EVENT4_GetFaultDetectionCounter
        RteEventToTaskMapping_OIE_EventInfo_DEM_E_TEST_EVENT5_GetDTCOfEvent: RteEventRef=OIE_EventInfo_DEM_E_TEST_EVENT5_GetDTCOfEvent
        RteEventToTaskMapping_OIE_EventInfo_DEM_E_TEST_EVENT5_GetEventExtendedDataRecord: RteEventRef=OIE_EventInfo_DEM_E_TEST_EVENT5_GetEventExtendedDataRecord
        RteEventToTaskMapping_OIE_EventInfo_DEM_E_TEST_EVENT5_GetEventFailed: RteEventRef=OIE_EventInfo_DEM_E_TEST_EVENT5_GetEventFailed
        RteEventToTaskMapping_OIE_EventInfo_DEM_E_TEST_EVENT5_GetEventFreezeFrameData: RteEventRef=OIE_EventInfo_DEM_E_TEST_EVENT5_GetEventFreezeFrameData
        RteEventToTaskMapping_OIE_EventInfo_DEM_E_TEST_EVENT5_GetEventStatus: RteEventRef=OIE_EventInfo_DEM_E_TEST_EVENT5_GetEventStatus
        RteEventToTaskMapping_OIE_EventInfo_DEM_E_TEST_EVENT5_GetEventTested: RteEventRef=OIE_EventInfo_DEM_E_TEST_EVENT5_GetEventTested
        RteEventToTaskMapping_OIE_EventInfo_DEM_E_TEST_EVENT5_GetFaultDetectionCounter: RteEventRef=OIE_EventInfo_DEM_E_TEST_EVENT5_GetFaultDetectionCounter
        RteEventToTaskMapping_OIE_EventInfo_DEM_E_TEST_EVENT6_GetDTCOfEvent: RteEventRef=OIE_EventInfo_DEM_E_TEST_EVENT6_GetDTCOfEvent
        RteEventToTaskMapping_OIE_EventInfo_DEM_E_TEST_EVENT6_GetEventExtendedDataRecord: RteEventRef=OIE_EventInfo_DEM_E_TEST_EVENT6_GetEventExtendedDataRecord
        RteEventToTaskMapping_OIE_EventInfo_DEM_E_TEST_EVENT6_GetEventFailed: RteEventRef=OIE_EventInfo_DEM_E_TEST_EVENT6_GetEventFailed
        RteEventToTaskMapping_OIE_EventInfo_DEM_E_TEST_EVENT6_GetEventFreezeFrameData: RteEventRef=OIE_EventInfo_DEM_E_TEST_EVENT6_GetEventFreezeFrameData
        RteEventToTaskMapping_OIE_EventInfo_DEM_E_TEST_EVENT6_GetEventStatus: RteEventRef=OIE_EventInfo_DEM_E_TEST_EVENT6_GetEventStatus
        RteEventToTaskMapping_OIE_EventInfo_DEM_E_TEST_EVENT6_GetEventTested: RteEventRef=OIE_EventInfo_DEM_E_TEST_EVENT6_GetEventTested
        RteEventToTaskMapping_OIE_EventInfo_DEM_E_TEST_EVENT6_GetFaultDetectionCounter: RteEventRef=OIE_EventInfo_DEM_E_TEST_EVENT6_GetFaultDetectionCounter
        RteEventToTaskMapping_OIE_EventInfo_ECUM_E_CONFIGURATION_DATA_INCONSISTENT_GetDTCOfEvent: RteEventRef=OIE_EventInfo_ECUM_E_CONFIGURATION_DATA_INCONSISTENT_GetDTCOfEvent
        RteEventToTaskMapping_OIE_EventInfo_ECUM_E_CONFIGURATION_DATA_INCONSISTENT_GetEventExtendedDataRecord: RteEventRef=OIE_EventInfo_ECUM_E_CONFIGURATION_DATA_INCONSISTENT_GetEventExtendedDataRecord
        RteEventToTaskMapping_OIE_EventInfo_ECUM_E_CONFIGURATION_DATA_INCONSISTENT_GetEventFailed: RteEventRef=OIE_EventInfo_ECUM_E_CONFIGURATION_DATA_INCONSISTENT_GetEventFailed
        RteEventToTaskMapping_OIE_EventInfo_ECUM_E_CONFIGURATION_DATA_INCONSISTENT_GetEventFreezeFrameData: RteEventRef=OIE_EventInfo_ECUM_E_CONFIGURATION_DATA_INCONSISTENT_GetEventFreezeFrameData
        RteEventToTaskMapping_OIE_EventInfo_ECUM_E_CONFIGURATION_DATA_INCONSISTENT_GetEventStatus: RteEventRef=OIE_EventInfo_ECUM_E_CONFIGURATION_DATA_INCONSISTENT_GetEventStatus
        RteEventToTaskMapping_OIE_EventInfo_ECUM_E_CONFIGURATION_DATA_INCONSISTENT_GetEventTested: RteEventRef=OIE_EventInfo_ECUM_E_CONFIGURATION_DATA_INCONSISTENT_GetEventTested
        RteEventToTaskMapping_OIE_EventInfo_ECUM_E_CONFIGURATION_DATA_INCONSISTENT_GetFaultDetectionCounter: RteEventRef=OIE_EventInfo_ECUM_E_CONFIGURATION_DATA_INCONSISTENT_GetFaultDetectionCounter
        RteEventToTaskMapping_OIE_EventInfo_ECUM_E_IMPROPER_CALLER_GetDTCOfEvent: RteEventRef=OIE_EventInfo_ECUM_E_IMPROPER_CALLER_GetDTCOfEvent
        RteEventToTaskMapping_OIE_EventInfo_ECUM_E_IMPROPER_CALLER_GetEventExtendedDataRecord: RteEventRef=OIE_EventInfo_ECUM_E_IMPROPER_CALLER_GetEventExtendedDataRecord
        RteEventToTaskMapping_OIE_EventInfo_ECUM_E_IMPROPER_CALLER_GetEventFailed: RteEventRef=OIE_EventInfo_ECUM_E_IMPROPER_CALLER_GetEventFailed
        RteEventToTaskMapping_OIE_EventInfo_ECUM_E_IMPROPER_CALLER_GetEventFreezeFrameData: RteEventRef=OIE_EventInfo_ECUM_E_IMPROPER_CALLER_GetEventFreezeFrameData
        RteEventToTaskMapping_OIE_EventInfo_ECUM_E_IMPROPER_CALLER_GetEventStatus: RteEventRef=OIE_EventInfo_ECUM_E_IMPROPER_CALLER_GetEventStatus
        RteEventToTaskMapping_OIE_EventInfo_ECUM_E_IMPROPER_CALLER_GetEventTested: RteEventRef=OIE_EventInfo_ECUM_E_IMPROPER_CALLER_GetEventTested
        RteEventToTaskMapping_OIE_EventInfo_ECUM_E_IMPROPER_CALLER_GetFaultDetectionCounter: RteEventRef=OIE_EventInfo_ECUM_E_IMPROPER_CALLER_GetFaultDetectionCounter
        RteEventToTaskMapping_OIE_EventInfo_ECUM_E_RAM_CHECK_FAILED_GetDTCOfEvent: RteEventRef=OIE_EventInfo_ECUM_E_RAM_CHECK_FAILED_GetDTCOfEvent
        RteEventToTaskMapping_OIE_EventInfo_ECUM_E_RAM_CHECK_FAILED_GetEventExtendedDataRecord: RteEventRef=OIE_EventInfo_ECUM_E_RAM_CHECK_FAILED_GetEventExtendedDataRecord
        RteEventToTaskMapping_OIE_EventInfo_ECUM_E_RAM_CHECK_FAILED_GetEventFailed: RteEventRef=OIE_EventInfo_ECUM_E_RAM_CHECK_FAILED_GetEventFailed
        RteEventToTaskMapping_OIE_EventInfo_ECUM_E_RAM_CHECK_FAILED_GetEventFreezeFrameData: RteEventRef=OIE_EventInfo_ECUM_E_RAM_CHECK_FAILED_GetEventFreezeFrameData
        RteEventToTaskMapping_OIE_EventInfo_ECUM_E_RAM_CHECK_FAILED_GetEventStatus: RteEventRef=OIE_EventInfo_ECUM_E_RAM_CHECK_FAILED_GetEventStatus
        RteEventToTaskMapping_OIE_EventInfo_ECUM_E_RAM_CHECK_FAILED_GetEventTested: RteEventRef=OIE_EventInfo_ECUM_E_RAM_CHECK_FAILED_GetEventTested
        RteEventToTaskMapping_OIE_EventInfo_ECUM_E_RAM_CHECK_FAILED_GetFaultDetectionCounter: RteEventRef=OIE_EventInfo_ECUM_E_RAM_CHECK_FAILED_GetFaultDetectionCounter
        RteEventToTaskMapping_OIE_EventInfo_EEP_E_COMPARE_FAILED_GetDTCOfEvent: RteEventRef=OIE_EventInfo_EEP_E_COMPARE_FAILED_GetDTCOfEvent
        RteEventToTaskMapping_OIE_EventInfo_EEP_E_COMPARE_FAILED_GetEventExtendedDataRecord: RteEventRef=OIE_EventInfo_EEP_E_COMPARE_FAILED_GetEventExtendedDataRecord
        RteEventToTaskMapping_OIE_EventInfo_EEP_E_COMPARE_FAILED_GetEventFailed: RteEventRef=OIE_EventInfo_EEP_E_COMPARE_FAILED_GetEventFailed
        RteEventToTaskMapping_OIE_EventInfo_EEP_E_COMPARE_FAILED_GetEventFreezeFrameData: RteEventRef=OIE_EventInfo_EEP_E_COMPARE_FAILED_GetEventFreezeFrameData
        RteEventToTaskMapping_OIE_EventInfo_EEP_E_COMPARE_FAILED_GetEventStatus: RteEventRef=OIE_EventInfo_EEP_E_COMPARE_FAILED_GetEventStatus
        RteEventToTaskMapping_OIE_EventInfo_EEP_E_COMPARE_FAILED_GetEventTested: RteEventRef=OIE_EventInfo_EEP_E_COMPARE_FAILED_GetEventTested
        RteEventToTaskMapping_OIE_EventInfo_EEP_E_COMPARE_FAILED_GetFaultDetectionCounter: RteEventRef=OIE_EventInfo_EEP_E_COMPARE_FAILED_GetFaultDetectionCounter
        RteEventToTaskMapping_OIE_EventInfo_EEP_E_ERASE_FAILED_GetDTCOfEvent: RteEventRef=OIE_EventInfo_EEP_E_ERASE_FAILED_GetDTCOfEvent
        RteEventToTaskMapping_OIE_EventInfo_EEP_E_ERASE_FAILED_GetEventExtendedDataRecord: RteEventRef=OIE_EventInfo_EEP_E_ERASE_FAILED_GetEventExtendedDataRecord
        RteEventToTaskMapping_OIE_EventInfo_EEP_E_ERASE_FAILED_GetEventFailed: RteEventRef=OIE_EventInfo_EEP_E_ERASE_FAILED_GetEventFailed
        RteEventToTaskMapping_OIE_EventInfo_EEP_E_ERASE_FAILED_GetEventFreezeFrameData: RteEventRef=OIE_EventInfo_EEP_E_ERASE_FAILED_GetEventFreezeFrameData
        RteEventToTaskMapping_OIE_EventInfo_EEP_E_ERASE_FAILED_GetEventStatus: RteEventRef=OIE_EventInfo_EEP_E_ERASE_FAILED_GetEventStatus
        RteEventToTaskMapping_OIE_EventInfo_EEP_E_ERASE_FAILED_GetEventTested: RteEventRef=OIE_EventInfo_EEP_E_ERASE_FAILED_GetEventTested
        RteEventToTaskMapping_OIE_EventInfo_EEP_E_ERASE_FAILED_GetFaultDetectionCounter: RteEventRef=OIE_EventInfo_EEP_E_ERASE_FAILED_GetFaultDetectionCounter
        RteEventToTaskMapping_OIE_EventInfo_EEP_E_READ_FAILED_GetDTCOfEvent: RteEventRef=OIE_EventInfo_EEP_E_READ_FAILED_GetDTCOfEvent
        RteEventToTaskMapping_OIE_EventInfo_EEP_E_READ_FAILED_GetEventExtendedDataRecord: RteEventRef=OIE_EventInfo_EEP_E_READ_FAILED_GetEventExtendedDataRecord
        RteEventToTaskMapping_OIE_EventInfo_EEP_E_READ_FAILED_GetEventFailed: RteEventRef=OIE_EventInfo_EEP_E_READ_FAILED_GetEventFailed
        RteEventToTaskMapping_OIE_EventInfo_EEP_E_READ_FAILED_GetEventFreezeFrameData: RteEventRef=OIE_EventInfo_EEP_E_READ_FAILED_GetEventFreezeFrameData
        RteEventToTaskMapping_OIE_EventInfo_EEP_E_READ_FAILED_GetEventStatus: RteEventRef=OIE_EventInfo_EEP_E_READ_FAILED_GetEventStatus
        RteEventToTaskMapping_OIE_EventInfo_EEP_E_READ_FAILED_GetEventTested: RteEventRef=OIE_EventInfo_EEP_E_READ_FAILED_GetEventTested
        RteEventToTaskMapping_OIE_EventInfo_EEP_E_READ_FAILED_GetFaultDetectionCounter: RteEventRef=OIE_EventInfo_EEP_E_READ_FAILED_GetFaultDetectionCounter
        RteEventToTaskMapping_OIE_EventInfo_EEP_E_WRITE_FAILED_GetDTCOfEvent: RteEventRef=OIE_EventInfo_EEP_E_WRITE_FAILED_GetDTCOfEvent
        RteEventToTaskMapping_OIE_EventInfo_EEP_E_WRITE_FAILED_GetEventExtendedDataRecord: RteEventRef=OIE_EventInfo_EEP_E_WRITE_FAILED_GetEventExtendedDataRecord
        RteEventToTaskMapping_OIE_EventInfo_EEP_E_WRITE_FAILED_GetEventFailed: RteEventRef=OIE_EventInfo_EEP_E_WRITE_FAILED_GetEventFailed
        RteEventToTaskMapping_OIE_EventInfo_EEP_E_WRITE_FAILED_GetEventFreezeFrameData: RteEventRef=OIE_EventInfo_EEP_E_WRITE_FAILED_GetEventFreezeFrameData
        RteEventToTaskMapping_OIE_EventInfo_EEP_E_WRITE_FAILED_GetEventStatus: RteEventRef=OIE_EventInfo_EEP_E_WRITE_FAILED_GetEventStatus
        RteEventToTaskMapping_OIE_EventInfo_EEP_E_WRITE_FAILED_GetEventTested: RteEventRef=OIE_EventInfo_EEP_E_WRITE_FAILED_GetEventTested
        RteEventToTaskMapping_OIE_EventInfo_EEP_E_WRITE_FAILED_GetFaultDetectionCounter: RteEventRef=OIE_EventInfo_EEP_E_WRITE_FAILED_GetFaultDetectionCounter
        RteEventToTaskMapping_OIE_EventInfo_ICU_E_HARDWARE_ERROR_GetDTCOfEvent: RteEventRef=OIE_EventInfo_ICU_E_HARDWARE_ERROR_GetDTCOfEvent
        RteEventToTaskMapping_OIE_EventInfo_ICU_E_HARDWARE_ERROR_GetEventExtendedDataRecord: RteEventRef=OIE_EventInfo_ICU_E_HARDWARE_ERROR_GetEventExtendedDataRecord
        RteEventToTaskMapping_OIE_EventInfo_ICU_E_HARDWARE_ERROR_GetEventFailed: RteEventRef=OIE_EventInfo_ICU_E_HARDWARE_ERROR_GetEventFailed
        RteEventToTaskMapping_OIE_EventInfo_ICU_E_HARDWARE_ERROR_GetEventFreezeFrameData: RteEventRef=OIE_EventInfo_ICU_E_HARDWARE_ERROR_GetEventFreezeFrameData
        RteEventToTaskMapping_OIE_EventInfo_ICU_E_HARDWARE_ERROR_GetEventStatus: RteEventRef=OIE_EventInfo_ICU_E_HARDWARE_ERROR_GetEventStatus
        RteEventToTaskMapping_OIE_EventInfo_ICU_E_HARDWARE_ERROR_GetEventTested: RteEventRef=OIE_EventInfo_ICU_E_HARDWARE_ERROR_GetEventTested
        RteEventToTaskMapping_OIE_EventInfo_ICU_E_HARDWARE_ERROR_GetFaultDetectionCounter: RteEventRef=OIE_EventInfo_ICU_E_HARDWARE_ERROR_GetFaultDetectionCounter
        RteEventToTaskMapping_OIE_EventInfo_IOHWAB_E_BUSY_GetDTCOfEvent: RteEventRef=OIE_EventInfo_IOHWAB_E_BUSY_GetDTCOfEvent
        RteEventToTaskMapping_OIE_EventInfo_IOHWAB_E_BUSY_GetEventExtendedDataRecord: RteEventRef=OIE_EventInfo_IOHWAB_E_BUSY_GetEventExtendedDataRecord
        RteEventToTaskMapping_OIE_EventInfo_IOHWAB_E_BUSY_GetEventFailed: RteEventRef=OIE_EventInfo_IOHWAB_E_BUSY_GetEventFailed
        RteEventToTaskMapping_OIE_EventInfo_IOHWAB_E_BUSY_GetEventFreezeFrameData: RteEventRef=OIE_EventInfo_IOHWAB_E_BUSY_GetEventFreezeFrameData
        RteEventToTaskMapping_OIE_EventInfo_IOHWAB_E_BUSY_GetEventStatus: RteEventRef=OIE_EventInfo_IOHWAB_E_BUSY_GetEventStatus
        RteEventToTaskMapping_OIE_EventInfo_IOHWAB_E_BUSY_GetEventTested: RteEventRef=OIE_EventInfo_IOHWAB_E_BUSY_GetEventTested
        RteEventToTaskMapping_OIE_EventInfo_IOHWAB_E_BUSY_GetFaultDetectionCounter: RteEventRef=OIE_EventInfo_IOHWAB_E_BUSY_GetFaultDetectionCounter
        RteEventToTaskMapping_OIE_EventInfo_IOHWAB_E_PROC_FAIL_GetDTCOfEvent: RteEventRef=OIE_EventInfo_IOHWAB_E_PROC_FAIL_GetDTCOfEvent
        RteEventToTaskMapping_OIE_EventInfo_IOHWAB_E_PROC_FAIL_GetEventExtendedDataRecord: RteEventRef=OIE_EventInfo_IOHWAB_E_PROC_FAIL_GetEventExtendedDataRecord
        RteEventToTaskMapping_OIE_EventInfo_IOHWAB_E_PROC_FAIL_GetEventFailed: RteEventRef=OIE_EventInfo_IOHWAB_E_PROC_FAIL_GetEventFailed
        RteEventToTaskMapping_OIE_EventInfo_IOHWAB_E_PROC_FAIL_GetEventFreezeFrameData: RteEventRef=OIE_EventInfo_IOHWAB_E_PROC_FAIL_GetEventFreezeFrameData
        RteEventToTaskMapping_OIE_EventInfo_IOHWAB_E_PROC_FAIL_GetEventStatus: RteEventRef=OIE_EventInfo_IOHWAB_E_PROC_FAIL_GetEventStatus
        RteEventToTaskMapping_OIE_EventInfo_IOHWAB_E_PROC_FAIL_GetEventTested: RteEventRef=OIE_EventInfo_IOHWAB_E_PROC_FAIL_GetEventTested
        RteEventToTaskMapping_OIE_EventInfo_IOHWAB_E_PROC_FAIL_GetFaultDetectionCounter: RteEventRef=OIE_EventInfo_IOHWAB_E_PROC_FAIL_GetFaultDetectionCounter
        RteEventToTaskMapping_OIE_EventInfo_IOHWAB_E_SETUP_FAIL_GetDTCOfEvent: RteEventRef=OIE_EventInfo_IOHWAB_E_SETUP_FAIL_GetDTCOfEvent
        RteEventToTaskMapping_OIE_EventInfo_IOHWAB_E_SETUP_FAIL_GetEventExtendedDataRecord: RteEventRef=OIE_EventInfo_IOHWAB_E_SETUP_FAIL_GetEventExtendedDataRecord
        RteEventToTaskMapping_OIE_EventInfo_IOHWAB_E_SETUP_FAIL_GetEventFailed: RteEventRef=OIE_EventInfo_IOHWAB_E_SETUP_FAIL_GetEventFailed
        RteEventToTaskMapping_OIE_EventInfo_IOHWAB_E_SETUP_FAIL_GetEventFreezeFrameData: RteEventRef=OIE_EventInfo_IOHWAB_E_SETUP_FAIL_GetEventFreezeFrameData
        RteEventToTaskMapping_OIE_EventInfo_IOHWAB_E_SETUP_FAIL_GetEventStatus: RteEventRef=OIE_EventInfo_IOHWAB_E_SETUP_FAIL_GetEventStatus
        RteEventToTaskMapping_OIE_EventInfo_IOHWAB_E_SETUP_FAIL_GetEventTested: RteEventRef=OIE_EventInfo_IOHWAB_E_SETUP_FAIL_GetEventTested
        RteEventToTaskMapping_OIE_EventInfo_IOHWAB_E_SETUP_FAIL_GetFaultDetectionCounter: RteEventRef=OIE_EventInfo_IOHWAB_E_SETUP_FAIL_GetFaultDetectionCounter
        RteEventToTaskMapping_OIE_EventInfo_IOHWAB_E_WRONG_PARAM_GetDTCOfEvent: RteEventRef=OIE_EventInfo_IOHWAB_E_WRONG_PARAM_GetDTCOfEvent
        RteEventToTaskMapping_OIE_EventInfo_IOHWAB_E_WRONG_PARAM_GetEventExtendedDataRecord: RteEventRef=OIE_EventInfo_IOHWAB_E_WRONG_PARAM_GetEventExtendedDataRecord
        RteEventToTaskMapping_OIE_EventInfo_IOHWAB_E_WRONG_PARAM_GetEventFailed: RteEventRef=OIE_EventInfo_IOHWAB_E_WRONG_PARAM_GetEventFailed
        RteEventToTaskMapping_OIE_EventInfo_IOHWAB_E_WRONG_PARAM_GetEventFreezeFrameData: RteEventRef=OIE_EventInfo_IOHWAB_E_WRONG_PARAM_GetEventFreezeFrameData
        RteEventToTaskMapping_OIE_EventInfo_IOHWAB_E_WRONG_PARAM_GetEventStatus: RteEventRef=OIE_EventInfo_IOHWAB_E_WRONG_PARAM_GetEventStatus
        RteEventToTaskMapping_OIE_EventInfo_IOHWAB_E_WRONG_PARAM_GetEventTested: RteEventRef=OIE_EventInfo_IOHWAB_E_WRONG_PARAM_GetEventTested
        RteEventToTaskMapping_OIE_EventInfo_IOHWAB_E_WRONG_PARAM_GetFaultDetectionCounter: RteEventRef=OIE_EventInfo_IOHWAB_E_WRONG_PARAM_GetFaultDetectionCounter
        RteEventToTaskMapping_OIE_EventInfo_IOHWAB_E_WRONG_SETTING_GetDTCOfEvent: RteEventRef=OIE_EventInfo_IOHWAB_E_WRONG_SETTING_GetDTCOfEvent
        RteEventToTaskMapping_OIE_EventInfo_IOHWAB_E_WRONG_SETTING_GetEventExtendedDataRecord: RteEventRef=OIE_EventInfo_IOHWAB_E_WRONG_SETTING_GetEventExtendedDataRecord
        RteEventToTaskMapping_OIE_EventInfo_IOHWAB_E_WRONG_SETTING_GetEventFailed: RteEventRef=OIE_EventInfo_IOHWAB_E_WRONG_SETTING_GetEventFailed
        RteEventToTaskMapping_OIE_EventInfo_IOHWAB_E_WRONG_SETTING_GetEventFreezeFrameData: RteEventRef=OIE_EventInfo_IOHWAB_E_WRONG_SETTING_GetEventFreezeFrameData
        RteEventToTaskMapping_OIE_EventInfo_IOHWAB_E_WRONG_SETTING_GetEventStatus: RteEventRef=OIE_EventInfo_IOHWAB_E_WRONG_SETTING_GetEventStatus
        RteEventToTaskMapping_OIE_EventInfo_IOHWAB_E_WRONG_SETTING_GetEventTested: RteEventRef=OIE_EventInfo_IOHWAB_E_WRONG_SETTING_GetEventTested
        RteEventToTaskMapping_OIE_EventInfo_IOHWAB_E_WRONG_SETTING_GetFaultDetectionCounter: RteEventRef=OIE_EventInfo_IOHWAB_E_WRONG_SETTING_GetFaultDetectionCounter
        RteEventToTaskMapping_OIE_EventInfo_IOHWAB_E_WRONG_STATE_GetDTCOfEvent: RteEventRef=OIE_EventInfo_IOHWAB_E_WRONG_STATE_GetDTCOfEvent
        RteEventToTaskMapping_OIE_EventInfo_IOHWAB_E_WRONG_STATE_GetEventExtendedDataRecord: RteEventRef=OIE_EventInfo_IOHWAB_E_WRONG_STATE_GetEventExtendedDataRecord
        RteEventToTaskMapping_OIE_EventInfo_IOHWAB_E_WRONG_STATE_GetEventFailed: RteEventRef=OIE_EventInfo_IOHWAB_E_WRONG_STATE_GetEventFailed
        RteEventToTaskMapping_OIE_EventInfo_IOHWAB_E_WRONG_STATE_GetEventFreezeFrameData: RteEventRef=OIE_EventInfo_IOHWAB_E_WRONG_STATE_GetEventFreezeFrameData
        RteEventToTaskMapping_OIE_EventInfo_IOHWAB_E_WRONG_STATE_GetEventStatus: RteEventRef=OIE_EventInfo_IOHWAB_E_WRONG_STATE_GetEventStatus
        RteEventToTaskMapping_OIE_EventInfo_IOHWAB_E_WRONG_STATE_GetEventTested: RteEventRef=OIE_EventInfo_IOHWAB_E_WRONG_STATE_GetEventTested
        RteEventToTaskMapping_OIE_EventInfo_IOHWAB_E_WRONG_STATE_GetFaultDetectionCounter: RteEventRef=OIE_EventInfo_IOHWAB_E_WRONG_STATE_GetFaultDetectionCounter
        RteEventToTaskMapping_OIE_EventInfo_LIN_E_TIMEOUT_GetDTCOfEvent: RteEventRef=OIE_EventInfo_LIN_E_TIMEOUT_GetDTCOfEvent
        RteEventToTaskMapping_OIE_EventInfo_LIN_E_TIMEOUT_GetEventExtendedDataRecord: RteEventRef=OIE_EventInfo_LIN_E_TIMEOUT_GetEventExtendedDataRecord
        RteEventToTaskMapping_OIE_EventInfo_LIN_E_TIMEOUT_GetEventFailed: RteEventRef=OIE_EventInfo_LIN_E_TIMEOUT_GetEventFailed
        RteEventToTaskMapping_OIE_EventInfo_LIN_E_TIMEOUT_GetEventFreezeFrameData: RteEventRef=OIE_EventInfo_LIN_E_TIMEOUT_GetEventFreezeFrameData
        RteEventToTaskMapping_OIE_EventInfo_LIN_E_TIMEOUT_GetEventStatus: RteEventRef=OIE_EventInfo_LIN_E_TIMEOUT_GetEventStatus
        RteEventToTaskMapping_OIE_EventInfo_LIN_E_TIMEOUT_GetEventTested: RteEventRef=OIE_EventInfo_LIN_E_TIMEOUT_GetEventTested
        RteEventToTaskMapping_OIE_EventInfo_LIN_E_TIMEOUT_GetFaultDetectionCounter: RteEventRef=OIE_EventInfo_LIN_E_TIMEOUT_GetFaultDetectionCounter
        RteEventToTaskMapping_OIE_EventInfo_MCU_E_CLOCK_FAILURE_GetDTCOfEvent: RteEventRef=OIE_EventInfo_MCU_E_CLOCK_FAILURE_GetDTCOfEvent
        RteEventToTaskMapping_OIE_EventInfo_MCU_E_CLOCK_FAILURE_GetEventExtendedDataRecord: RteEventRef=OIE_EventInfo_MCU_E_CLOCK_FAILURE_GetEventExtendedDataRecord
        RteEventToTaskMapping_OIE_EventInfo_MCU_E_CLOCK_FAILURE_GetEventFailed: RteEventRef=OIE_EventInfo_MCU_E_CLOCK_FAILURE_GetEventFailed
        RteEventToTaskMapping_OIE_EventInfo_MCU_E_CLOCK_FAILURE_GetEventFreezeFrameData: RteEventRef=OIE_EventInfo_MCU_E_CLOCK_FAILURE_GetEventFreezeFrameData
        RteEventToTaskMapping_OIE_EventInfo_MCU_E_CLOCK_FAILURE_GetEventStatus: RteEventRef=OIE_EventInfo_MCU_E_CLOCK_FAILURE_GetEventStatus
        RteEventToTaskMapping_OIE_EventInfo_MCU_E_CLOCK_FAILURE_GetEventTested: RteEventRef=OIE_EventInfo_MCU_E_CLOCK_FAILURE_GetEventTested
        RteEventToTaskMapping_OIE_EventInfo_MCU_E_CLOCK_FAILURE_GetFaultDetectionCounter: RteEventRef=OIE_EventInfo_MCU_E_CLOCK_FAILURE_GetFaultDetectionCounter
        RteEventToTaskMapping_OIE_EventInfo_MCU_E_RESET_FAILURE_GetDTCOfEvent: RteEventRef=OIE_EventInfo_MCU_E_RESET_FAILURE_GetDTCOfEvent
        RteEventToTaskMapping_OIE_EventInfo_MCU_E_RESET_FAILURE_GetEventExtendedDataRecord: RteEventRef=OIE_EventInfo_MCU_E_RESET_FAILURE_GetEventExtendedDataRecord
        RteEventToTaskMapping_OIE_EventInfo_MCU_E_RESET_FAILURE_GetEventFailed: RteEventRef=OIE_EventInfo_MCU_E_RESET_FAILURE_GetEventFailed
        RteEventToTaskMapping_OIE_EventInfo_MCU_E_RESET_FAILURE_GetEventFreezeFrameData: RteEventRef=OIE_EventInfo_MCU_E_RESET_FAILURE_GetEventFreezeFrameData
        RteEventToTaskMapping_OIE_EventInfo_MCU_E_RESET_FAILURE_GetEventStatus: RteEventRef=OIE_EventInfo_MCU_E_RESET_FAILURE_GetEventStatus
        RteEventToTaskMapping_OIE_EventInfo_MCU_E_RESET_FAILURE_GetEventTested: RteEventRef=OIE_EventInfo_MCU_E_RESET_FAILURE_GetEventTested
        RteEventToTaskMapping_OIE_EventInfo_MCU_E_RESET_FAILURE_GetFaultDetectionCounter: RteEventRef=OIE_EventInfo_MCU_E_RESET_FAILURE_GetFaultDetectionCounter
        RteEventToTaskMapping_OIE_EventInfo_NVM_E_INTEGRITY_FAILED_GetDTCOfEvent: RteEventRef=OIE_EventInfo_NVM_E_INTEGRITY_FAILED_GetDTCOfEvent
        RteEventToTaskMapping_OIE_EventInfo_NVM_E_INTEGRITY_FAILED_GetEventExtendedDataRecord: RteEventRef=OIE_EventInfo_NVM_E_INTEGRITY_FAILED_GetEventExtendedDataRecord
        RteEventToTaskMapping_OIE_EventInfo_NVM_E_INTEGRITY_FAILED_GetEventFailed: RteEventRef=OIE_EventInfo_NVM_E_INTEGRITY_FAILED_GetEventFailed
        RteEventToTaskMapping_OIE_EventInfo_NVM_E_INTEGRITY_FAILED_GetEventFreezeFrameData: RteEventRef=OIE_EventInfo_NVM_E_INTEGRITY_FAILED_GetEventFreezeFrameData
        RteEventToTaskMapping_OIE_EventInfo_NVM_E_INTEGRITY_FAILED_GetEventStatus: RteEventRef=OIE_EventInfo_NVM_E_INTEGRITY_FAILED_GetEventStatus
        RteEventToTaskMapping_OIE_EventInfo_NVM_E_INTEGRITY_FAILED_GetEventTested: RteEventRef=OIE_EventInfo_NVM_E_INTEGRITY_FAILED_GetEventTested
        RteEventToTaskMapping_OIE_EventInfo_NVM_E_INTEGRITY_FAILED_GetFaultDetectionCounter: RteEventRef=OIE_EventInfo_NVM_E_INTEGRITY_FAILED_GetFaultDetectionCounter
        RteEventToTaskMapping_OIE_EventInfo_NVM_E_LOSS_OF_REDUNDANCY_GetDTCOfEvent: RteEventRef=OIE_EventInfo_NVM_E_LOSS_OF_REDUNDANCY_GetDTCOfEvent
        RteEventToTaskMapping_OIE_EventInfo_NVM_E_LOSS_OF_REDUNDANCY_GetEventExtendedDataRecord: RteEventRef=OIE_EventInfo_NVM_E_LOSS_OF_REDUNDANCY_GetEventExtendedDataRecord
        RteEventToTaskMapping_OIE_EventInfo_NVM_E_LOSS_OF_REDUNDANCY_GetEventFailed: RteEventRef=OIE_EventInfo_NVM_E_LOSS_OF_REDUNDANCY_GetEventFailed
        RteEventToTaskMapping_OIE_EventInfo_NVM_E_LOSS_OF_REDUNDANCY_GetEventFreezeFrameData: RteEventRef=OIE_EventInfo_NVM_E_LOSS_OF_REDUNDANCY_GetEventFreezeFrameData
        RteEventToTaskMapping_OIE_EventInfo_NVM_E_LOSS_OF_REDUNDANCY_GetEventStatus: RteEventRef=OIE_EventInfo_NVM_E_LOSS_OF_REDUNDANCY_GetEventStatus
        RteEventToTaskMapping_OIE_EventInfo_NVM_E_LOSS_OF_REDUNDANCY_GetEventTested: RteEventRef=OIE_EventInfo_NVM_E_LOSS_OF_REDUNDANCY_GetEventTested
        RteEventToTaskMapping_OIE_EventInfo_NVM_E_LOSS_OF_REDUNDANCY_GetFaultDetectionCounter: RteEventRef=OIE_EventInfo_NVM_E_LOSS_OF_REDUNDANCY_GetFaultDetectionCounter
        RteEventToTaskMapping_OIE_EventInfo_NVM_E_QUEUE_OVERFLOW_GetDTCOfEvent: RteEventRef=OIE_EventInfo_NVM_E_QUEUE_OVERFLOW_GetDTCOfEvent
        RteEventToTaskMapping_OIE_EventInfo_NVM_E_QUEUE_OVERFLOW_GetEventExtendedDataRecord: RteEventRef=OIE_EventInfo_NVM_E_QUEUE_OVERFLOW_GetEventExtendedDataRecord
        RteEventToTaskMapping_OIE_EventInfo_NVM_E_QUEUE_OVERFLOW_GetEventFailed: RteEventRef=OIE_EventInfo_NVM_E_QUEUE_OVERFLOW_GetEventFailed
        RteEventToTaskMapping_OIE_EventInfo_NVM_E_QUEUE_OVERFLOW_GetEventFreezeFrameData: RteEventRef=OIE_EventInfo_NVM_E_QUEUE_OVERFLOW_GetEventFreezeFrameData
        RteEventToTaskMapping_OIE_EventInfo_NVM_E_QUEUE_OVERFLOW_GetEventStatus: RteEventRef=OIE_EventInfo_NVM_E_QUEUE_OVERFLOW_GetEventStatus
        RteEventToTaskMapping_OIE_EventInfo_NVM_E_QUEUE_OVERFLOW_GetEventTested: RteEventRef=OIE_EventInfo_NVM_E_QUEUE_OVERFLOW_GetEventTested
        RteEventToTaskMapping_OIE_EventInfo_NVM_E_QUEUE_OVERFLOW_GetFaultDetectionCounter: RteEventRef=OIE_EventInfo_NVM_E_QUEUE_OVERFLOW_GetFaultDetectionCounter
        RteEventToTaskMapping_OIE_EventInfo_NVM_E_REQ_FAILED_GetDTCOfEvent: RteEventRef=OIE_EventInfo_NVM_E_REQ_FAILED_GetDTCOfEvent
        RteEventToTaskMapping_OIE_EventInfo_NVM_E_REQ_FAILED_GetEventExtendedDataRecord: RteEventRef=OIE_EventInfo_NVM_E_REQ_FAILED_GetEventExtendedDataRecord
        RteEventToTaskMapping_OIE_EventInfo_NVM_E_REQ_FAILED_GetEventFailed: RteEventRef=OIE_EventInfo_NVM_E_REQ_FAILED_GetEventFailed
        RteEventToTaskMapping_OIE_EventInfo_NVM_E_REQ_FAILED_GetEventFreezeFrameData: RteEventRef=OIE_EventInfo_NVM_E_REQ_FAILED_GetEventFreezeFrameData
        RteEventToTaskMapping_OIE_EventInfo_NVM_E_REQ_FAILED_GetEventStatus: RteEventRef=OIE_EventInfo_NVM_E_REQ_FAILED_GetEventStatus
        RteEventToTaskMapping_OIE_EventInfo_NVM_E_REQ_FAILED_GetEventTested: RteEventRef=OIE_EventInfo_NVM_E_REQ_FAILED_GetEventTested
        RteEventToTaskMapping_OIE_EventInfo_NVM_E_REQ_FAILED_GetFaultDetectionCounter: RteEventRef=OIE_EventInfo_NVM_E_REQ_FAILED_GetFaultDetectionCounter
        RteEventToTaskMapping_OIE_EventInfo_NVM_E_VERIFY_FAILED_GetDTCOfEvent: RteEventRef=OIE_EventInfo_NVM_E_VERIFY_FAILED_GetDTCOfEvent
        RteEventToTaskMapping_OIE_EventInfo_NVM_E_VERIFY_FAILED_GetEventExtendedDataRecord: RteEventRef=OIE_EventInfo_NVM_E_VERIFY_FAILED_GetEventExtendedDataRecord
        RteEventToTaskMapping_OIE_EventInfo_NVM_E_VERIFY_FAILED_GetEventFailed: RteEventRef=OIE_EventInfo_NVM_E_VERIFY_FAILED_GetEventFailed
        RteEventToTaskMapping_OIE_EventInfo_NVM_E_VERIFY_FAILED_GetEventFreezeFrameData: RteEventRef=OIE_EventInfo_NVM_E_VERIFY_FAILED_GetEventFreezeFrameData
        RteEventToTaskMapping_OIE_EventInfo_NVM_E_VERIFY_FAILED_GetEventStatus: RteEventRef=OIE_EventInfo_NVM_E_VERIFY_FAILED_GetEventStatus
        RteEventToTaskMapping_OIE_EventInfo_NVM_E_VERIFY_FAILED_GetEventTested: RteEventRef=OIE_EventInfo_NVM_E_VERIFY_FAILED_GetEventTested
        RteEventToTaskMapping_OIE_EventInfo_NVM_E_VERIFY_FAILED_GetFaultDetectionCounter: RteEventRef=OIE_EventInfo_NVM_E_VERIFY_FAILED_GetFaultDetectionCounter
        RteEventToTaskMapping_OIE_EventInfo_NVM_E_WRITE_PROTECTED_GetDTCOfEvent: RteEventRef=OIE_EventInfo_NVM_E_WRITE_PROTECTED_GetDTCOfEvent
        RteEventToTaskMapping_OIE_EventInfo_NVM_E_WRITE_PROTECTED_GetEventExtendedDataRecord: RteEventRef=OIE_EventInfo_NVM_E_WRITE_PROTECTED_GetEventExtendedDataRecord
        RteEventToTaskMapping_OIE_EventInfo_NVM_E_WRITE_PROTECTED_GetEventFailed: RteEventRef=OIE_EventInfo_NVM_E_WRITE_PROTECTED_GetEventFailed
        RteEventToTaskMapping_OIE_EventInfo_NVM_E_WRITE_PROTECTED_GetEventFreezeFrameData: RteEventRef=OIE_EventInfo_NVM_E_WRITE_PROTECTED_GetEventFreezeFrameData
        RteEventToTaskMapping_OIE_EventInfo_NVM_E_WRITE_PROTECTED_GetEventStatus: RteEventRef=OIE_EventInfo_NVM_E_WRITE_PROTECTED_GetEventStatus
        RteEventToTaskMapping_OIE_EventInfo_NVM_E_WRITE_PROTECTED_GetEventTested: RteEventRef=OIE_EventInfo_NVM_E_WRITE_PROTECTED_GetEventTested
        RteEventToTaskMapping_OIE_EventInfo_NVM_E_WRITE_PROTECTED_GetFaultDetectionCounter: RteEventRef=OIE_EventInfo_NVM_E_WRITE_PROTECTED_GetFaultDetectionCounter
        RteEventToTaskMapping_OIE_EventInfo_NVM_E_WRONG_BLOCK_ID_GetDTCOfEvent: RteEventRef=OIE_EventInfo_NVM_E_WRONG_BLOCK_ID_GetDTCOfEvent
        RteEventToTaskMapping_OIE_EventInfo_NVM_E_WRONG_BLOCK_ID_GetEventExtendedDataRecord: RteEventRef=OIE_EventInfo_NVM_E_WRONG_BLOCK_ID_GetEventExtendedDataRecord
        RteEventToTaskMapping_OIE_EventInfo_NVM_E_WRONG_BLOCK_ID_GetEventFailed: RteEventRef=OIE_EventInfo_NVM_E_WRONG_BLOCK_ID_GetEventFailed
        RteEventToTaskMapping_OIE_EventInfo_NVM_E_WRONG_BLOCK_ID_GetEventFreezeFrameData: RteEventRef=OIE_EventInfo_NVM_E_WRONG_BLOCK_ID_GetEventFreezeFrameData
        RteEventToTaskMapping_OIE_EventInfo_NVM_E_WRONG_BLOCK_ID_GetEventStatus: RteEventRef=OIE_EventInfo_NVM_E_WRONG_BLOCK_ID_GetEventStatus
        RteEventToTaskMapping_OIE_EventInfo_NVM_E_WRONG_BLOCK_ID_GetEventTested: RteEventRef=OIE_EventInfo_NVM_E_WRONG_BLOCK_ID_GetEventTested
        RteEventToTaskMapping_OIE_EventInfo_NVM_E_WRONG_BLOCK_ID_GetFaultDetectionCounter: RteEventRef=OIE_EventInfo_NVM_E_WRONG_BLOCK_ID_GetFaultDetectionCounter
        RteEventToTaskMapping_OIE_EventInfo_RAMTST_E_RAM_FAILURE_GetDTCOfEvent: RteEventRef=OIE_EventInfo_RAMTST_E_RAM_FAILURE_GetDTCOfEvent
        RteEventToTaskMapping_OIE_EventInfo_RAMTST_E_RAM_FAILURE_GetEventExtendedDataRecord: RteEventRef=OIE_EventInfo_RAMTST_E_RAM_FAILURE_GetEventExtendedDataRecord
        RteEventToTaskMapping_OIE_EventInfo_RAMTST_E_RAM_FAILURE_GetEventFailed: RteEventRef=OIE_EventInfo_RAMTST_E_RAM_FAILURE_GetEventFailed
        RteEventToTaskMapping_OIE_EventInfo_RAMTST_E_RAM_FAILURE_GetEventFreezeFrameData: RteEventRef=OIE_EventInfo_RAMTST_E_RAM_FAILURE_GetEventFreezeFrameData
        RteEventToTaskMapping_OIE_EventInfo_RAMTST_E_RAM_FAILURE_GetEventStatus: RteEventRef=OIE_EventInfo_RAMTST_E_RAM_FAILURE_GetEventStatus
        RteEventToTaskMapping_OIE_EventInfo_RAMTST_E_RAM_FAILURE_GetEventTested: RteEventRef=OIE_EventInfo_RAMTST_E_RAM_FAILURE_GetEventTested
        RteEventToTaskMapping_OIE_EventInfo_RAMTST_E_RAM_FAILURE_GetFaultDetectionCounter: RteEventRef=OIE_EventInfo_RAMTST_E_RAM_FAILURE_GetFaultDetectionCounter
        RteEventToTaskMapping_OIE_EventInfo_SPI_E_HARDWARE_ERROR_GetDTCOfEvent: RteEventRef=OIE_EventInfo_SPI_E_HARDWARE_ERROR_GetDTCOfEvent
        RteEventToTaskMapping_OIE_EventInfo_SPI_E_HARDWARE_ERROR_GetEventExtendedDataRecord: RteEventRef=OIE_EventInfo_SPI_E_HARDWARE_ERROR_GetEventExtendedDataRecord
        RteEventToTaskMapping_OIE_EventInfo_SPI_E_HARDWARE_ERROR_GetEventFailed: RteEventRef=OIE_EventInfo_SPI_E_HARDWARE_ERROR_GetEventFailed
        RteEventToTaskMapping_OIE_EventInfo_SPI_E_HARDWARE_ERROR_GetEventFreezeFrameData: RteEventRef=OIE_EventInfo_SPI_E_HARDWARE_ERROR_GetEventFreezeFrameData
        RteEventToTaskMapping_OIE_EventInfo_SPI_E_HARDWARE_ERROR_GetEventStatus: RteEventRef=OIE_EventInfo_SPI_E_HARDWARE_ERROR_GetEventStatus
        RteEventToTaskMapping_OIE_EventInfo_SPI_E_HARDWARE_ERROR_GetEventTested: RteEventRef=OIE_EventInfo_SPI_E_HARDWARE_ERROR_GetEventTested
        RteEventToTaskMapping_OIE_EventInfo_SPI_E_HARDWARE_ERROR_GetFaultDetectionCounter: RteEventRef=OIE_EventInfo_SPI_E_HARDWARE_ERROR_GetFaultDetectionCounter
        RteEventToTaskMapping_OIE_EventInfo_WDGM_E_IMPROPER_CALLER_GetDTCOfEvent: RteEventRef=OIE_EventInfo_WDGM_E_IMPROPER_CALLER_GetDTCOfEvent
        RteEventToTaskMapping_OIE_EventInfo_WDGM_E_IMPROPER_CALLER_GetEventExtendedDataRecord: RteEventRef=OIE_EventInfo_WDGM_E_IMPROPER_CALLER_GetEventExtendedDataRecord
        RteEventToTaskMapping_OIE_EventInfo_WDGM_E_IMPROPER_CALLER_GetEventFailed: RteEventRef=OIE_EventInfo_WDGM_E_IMPROPER_CALLER_GetEventFailed
        RteEventToTaskMapping_OIE_EventInfo_WDGM_E_IMPROPER_CALLER_GetEventFreezeFrameData: RteEventRef=OIE_EventInfo_WDGM_E_IMPROPER_CALLER_GetEventFreezeFrameData
        RteEventToTaskMapping_OIE_EventInfo_WDGM_E_IMPROPER_CALLER_GetEventStatus: RteEventRef=OIE_EventInfo_WDGM_E_IMPROPER_CALLER_GetEventStatus
        RteEventToTaskMapping_OIE_EventInfo_WDGM_E_IMPROPER_CALLER_GetEventTested: RteEventRef=OIE_EventInfo_WDGM_E_IMPROPER_CALLER_GetEventTested
        RteEventToTaskMapping_OIE_EventInfo_WDGM_E_IMPROPER_CALLER_GetFaultDetectionCounter: RteEventRef=OIE_EventInfo_WDGM_E_IMPROPER_CALLER_GetFaultDetectionCounter
        RteEventToTaskMapping_OIE_EventInfo_WDGM_E_MONITORING_GetDTCOfEvent: RteEventRef=OIE_EventInfo_WDGM_E_MONITORING_GetDTCOfEvent
        RteEventToTaskMapping_OIE_EventInfo_WDGM_E_MONITORING_GetEventExtendedDataRecord: RteEventRef=OIE_EventInfo_WDGM_E_MONITORING_GetEventExtendedDataRecord
        RteEventToTaskMapping_OIE_EventInfo_WDGM_E_MONITORING_GetEventFailed: RteEventRef=OIE_EventInfo_WDGM_E_MONITORING_GetEventFailed
        RteEventToTaskMapping_OIE_EventInfo_WDGM_E_MONITORING_GetEventFreezeFrameData: RteEventRef=OIE_EventInfo_WDGM_E_MONITORING_GetEventFreezeFrameData
        RteEventToTaskMapping_OIE_EventInfo_WDGM_E_MONITORING_GetEventStatus: RteEventRef=OIE_EventInfo_WDGM_E_MONITORING_GetEventStatus
        RteEventToTaskMapping_OIE_EventInfo_WDGM_E_MONITORING_GetEventTested: RteEventRef=OIE_EventInfo_WDGM_E_MONITORING_GetEventTested
        RteEventToTaskMapping_OIE_EventInfo_WDGM_E_MONITORING_GetFaultDetectionCounter: RteEventRef=OIE_EventInfo_WDGM_E_MONITORING_GetFaultDetectionCounter
        RteEventToTaskMapping_OIE_EventInfo_WDGM_E_SET_MODE_GetDTCOfEvent: RteEventRef=OIE_EventInfo_WDGM_E_SET_MODE_GetDTCOfEvent
        RteEventToTaskMapping_OIE_EventInfo_WDGM_E_SET_MODE_GetEventExtendedDataRecord: RteEventRef=OIE_EventInfo_WDGM_E_SET_MODE_GetEventExtendedDataRecord
        RteEventToTaskMapping_OIE_EventInfo_WDGM_E_SET_MODE_GetEventFailed: RteEventRef=OIE_EventInfo_WDGM_E_SET_MODE_GetEventFailed
        RteEventToTaskMapping_OIE_EventInfo_WDGM_E_SET_MODE_GetEventFreezeFrameData: RteEventRef=OIE_EventInfo_WDGM_E_SET_MODE_GetEventFreezeFrameData
        RteEventToTaskMapping_OIE_EventInfo_WDGM_E_SET_MODE_GetEventStatus: RteEventRef=OIE_EventInfo_WDGM_E_SET_MODE_GetEventStatus
        RteEventToTaskMapping_OIE_EventInfo_WDGM_E_SET_MODE_GetEventTested: RteEventRef=OIE_EventInfo_WDGM_E_SET_MODE_GetEventTested
        RteEventToTaskMapping_OIE_EventInfo_WDGM_E_SET_MODE_GetFaultDetectionCounter: RteEventRef=OIE_EventInfo_WDGM_E_SET_MODE_GetFaultDetectionCounter
        RteEventToTaskMapping_OIE_EventInfo_WDG_76_ACW_E_DISABLE_REJECTED_GetDTCOfEvent: RteEventRef=OIE_EventInfo_WDG_76_ACW_E_DISABLE_REJECTED_GetDTCOfEvent
        RteEventToTaskMapping_OIE_EventInfo_WDG_76_ACW_E_DISABLE_REJECTED_GetEventExtendedDataRecord: RteEventRef=OIE_EventInfo_WDG_76_ACW_E_DISABLE_REJECTED_GetEventExtendedDataRecord
        RteEventToTaskMapping_OIE_EventInfo_WDG_76_ACW_E_DISABLE_REJECTED_GetEventFailed: RteEventRef=OIE_EventInfo_WDG_76_ACW_E_DISABLE_REJECTED_GetEventFailed
        RteEventToTaskMapping_OIE_EventInfo_WDG_76_ACW_E_DISABLE_REJECTED_GetEventFreezeFrameData: RteEventRef=OIE_EventInfo_WDG_76_ACW_E_DISABLE_REJECTED_GetEventFreezeFrameData
        RteEventToTaskMapping_OIE_EventInfo_WDG_76_ACW_E_DISABLE_REJECTED_GetEventStatus: RteEventRef=OIE_EventInfo_WDG_76_ACW_E_DISABLE_REJECTED_GetEventStatus
        RteEventToTaskMapping_OIE_EventInfo_WDG_76_ACW_E_DISABLE_REJECTED_GetEventTested: RteEventRef=OIE_EventInfo_WDG_76_ACW_E_DISABLE_REJECTED_GetEventTested
        RteEventToTaskMapping_OIE_EventInfo_WDG_76_ACW_E_DISABLE_REJECTED_GetFaultDetectionCounter: RteEventRef=OIE_EventInfo_WDG_76_ACW_E_DISABLE_REJECTED_GetFaultDetectionCounter
        RteEventToTaskMapping_OIE_EventInfo_WDG_76_ACW_E_MODE_FAILED_GetDTCOfEvent: RteEventRef=OIE_EventInfo_WDG_76_ACW_E_MODE_FAILED_GetDTCOfEvent
        RteEventToTaskMapping_OIE_EventInfo_WDG_76_ACW_E_MODE_FAILED_GetEventExtendedDataRecord: RteEventRef=OIE_EventInfo_WDG_76_ACW_E_MODE_FAILED_GetEventExtendedDataRecord
        RteEventToTaskMapping_OIE_EventInfo_WDG_76_ACW_E_MODE_FAILED_GetEventFailed: RteEventRef=OIE_EventInfo_WDG_76_ACW_E_MODE_FAILED_GetEventFailed
        RteEventToTaskMapping_OIE_EventInfo_WDG_76_ACW_E_MODE_FAILED_GetEventFreezeFrameData: RteEventRef=OIE_EventInfo_WDG_76_ACW_E_MODE_FAILED_GetEventFreezeFrameData
        RteEventToTaskMapping_OIE_EventInfo_WDG_76_ACW_E_MODE_FAILED_GetEventStatus: RteEventRef=OIE_EventInfo_WDG_76_ACW_E_MODE_FAILED_GetEventStatus
        RteEventToTaskMapping_OIE_EventInfo_WDG_76_ACW_E_MODE_FAILED_GetEventTested: RteEventRef=OIE_EventInfo_WDG_76_ACW_E_MODE_FAILED_GetEventTested
        RteEventToTaskMapping_OIE_EventInfo_WDG_76_ACW_E_MODE_FAILED_GetFaultDetectionCounter: RteEventRef=OIE_EventInfo_WDG_76_ACW_E_MODE_FAILED_GetFaultDetectionCounter
        RteEventToTaskMapping_OIE_EventInfo_WDG_E_DISABLE_REJECTED_GetDTCOfEvent: RteEventRef=OIE_EventInfo_WDG_E_DISABLE_REJECTED_GetDTCOfEvent
        RteEventToTaskMapping_OIE_EventInfo_WDG_E_DISABLE_REJECTED_GetEventExtendedDataRecord: RteEventRef=OIE_EventInfo_WDG_E_DISABLE_REJECTED_GetEventExtendedDataRecord
        RteEventToTaskMapping_OIE_EventInfo_WDG_E_DISABLE_REJECTED_GetEventFailed: RteEventRef=OIE_EventInfo_WDG_E_DISABLE_REJECTED_GetEventFailed
        RteEventToTaskMapping_OIE_EventInfo_WDG_E_DISABLE_REJECTED_GetEventFreezeFrameData: RteEventRef=OIE_EventInfo_WDG_E_DISABLE_REJECTED_GetEventFreezeFrameData
        RteEventToTaskMapping_OIE_EventInfo_WDG_E_DISABLE_REJECTED_GetEventStatus: RteEventRef=OIE_EventInfo_WDG_E_DISABLE_REJECTED_GetEventStatus
        RteEventToTaskMapping_OIE_EventInfo_WDG_E_DISABLE_REJECTED_GetEventTested: RteEventRef=OIE_EventInfo_WDG_E_DISABLE_REJECTED_GetEventTested
        RteEventToTaskMapping_OIE_EventInfo_WDG_E_DISABLE_REJECTED_GetFaultDetectionCounter: RteEventRef=OIE_EventInfo_WDG_E_DISABLE_REJECTED_GetFaultDetectionCounter
        RteEventToTaskMapping_OIE_EventInfo_WDG_E_HW_TIMEOUT_GetDTCOfEvent: RteEventRef=OIE_EventInfo_WDG_E_HW_TIMEOUT_GetDTCOfEvent
        RteEventToTaskMapping_OIE_EventInfo_WDG_E_HW_TIMEOUT_GetEventExtendedDataRecord: RteEventRef=OIE_EventInfo_WDG_E_HW_TIMEOUT_GetEventExtendedDataRecord
        RteEventToTaskMapping_OIE_EventInfo_WDG_E_HW_TIMEOUT_GetEventFailed: RteEventRef=OIE_EventInfo_WDG_E_HW_TIMEOUT_GetEventFailed
        RteEventToTaskMapping_OIE_EventInfo_WDG_E_HW_TIMEOUT_GetEventFreezeFrameData: RteEventRef=OIE_EventInfo_WDG_E_HW_TIMEOUT_GetEventFreezeFrameData
        RteEventToTaskMapping_OIE_EventInfo_WDG_E_HW_TIMEOUT_GetEventStatus: RteEventRef=OIE_EventInfo_WDG_E_HW_TIMEOUT_GetEventStatus
        RteEventToTaskMapping_OIE_EventInfo_WDG_E_HW_TIMEOUT_GetEventTested: RteEventRef=OIE_EventInfo_WDG_E_HW_TIMEOUT_GetEventTested
        RteEventToTaskMapping_OIE_EventInfo_WDG_E_HW_TIMEOUT_GetFaultDetectionCounter: RteEventRef=OIE_EventInfo_WDG_E_HW_TIMEOUT_GetFaultDetectionCounter
        RteEventToTaskMapping_OIE_EventInfo_WDG_E_MODE_FAILED_GetDTCOfEvent: RteEventRef=OIE_EventInfo_WDG_E_MODE_FAILED_GetDTCOfEvent
        RteEventToTaskMapping_OIE_EventInfo_WDG_E_MODE_FAILED_GetEventExtendedDataRecord: RteEventRef=OIE_EventInfo_WDG_E_MODE_FAILED_GetEventExtendedDataRecord
        RteEventToTaskMapping_OIE_EventInfo_WDG_E_MODE_FAILED_GetEventFailed: RteEventRef=OIE_EventInfo_WDG_E_MODE_FAILED_GetEventFailed
        RteEventToTaskMapping_OIE_EventInfo_WDG_E_MODE_FAILED_GetEventFreezeFrameData: RteEventRef=OIE_EventInfo_WDG_E_MODE_FAILED_GetEventFreezeFrameData
        RteEventToTaskMapping_OIE_EventInfo_WDG_E_MODE_FAILED_GetEventStatus: RteEventRef=OIE_EventInfo_WDG_E_MODE_FAILED_GetEventStatus
        RteEventToTaskMapping_OIE_EventInfo_WDG_E_MODE_FAILED_GetEventTested: RteEventRef=OIE_EventInfo_WDG_E_MODE_FAILED_GetEventTested
        RteEventToTaskMapping_OIE_EventInfo_WDG_E_MODE_FAILED_GetFaultDetectionCounter: RteEventRef=OIE_EventInfo_WDG_E_MODE_FAILED_GetFaultDetectionCounter
        RteEventToTaskMapping_OIE_EventInfo_WDG_E_WDG_STOPPED_GetDTCOfEvent: RteEventRef=OIE_EventInfo_WDG_E_WDG_STOPPED_GetDTCOfEvent
        RteEventToTaskMapping_OIE_EventInfo_WDG_E_WDG_STOPPED_GetEventExtendedDataRecord: RteEventRef=OIE_EventInfo_WDG_E_WDG_STOPPED_GetEventExtendedDataRecord
        RteEventToTaskMapping_OIE_EventInfo_WDG_E_WDG_STOPPED_GetEventFailed: RteEventRef=OIE_EventInfo_WDG_E_WDG_STOPPED_GetEventFailed
        RteEventToTaskMapping_OIE_EventInfo_WDG_E_WDG_STOPPED_GetEventFreezeFrameData: RteEventRef=OIE_EventInfo_WDG_E_WDG_STOPPED_GetEventFreezeFrameData
        RteEventToTaskMapping_OIE_EventInfo_WDG_E_WDG_STOPPED_GetEventStatus: RteEventRef=OIE_EventInfo_WDG_E_WDG_STOPPED_GetEventStatus
        RteEventToTaskMapping_OIE_EventInfo_WDG_E_WDG_STOPPED_GetEventTested: RteEventRef=OIE_EventInfo_WDG_E_WDG_STOPPED_GetEventTested
        RteEventToTaskMapping_OIE_EventInfo_WDG_E_WDG_STOPPED_GetFaultDetectionCounter: RteEventRef=OIE_EventInfo_WDG_E_WDG_STOPPED_GetFaultDetectionCounter
        RteEventToTaskMapping_OIE_Event_DEM_E_TEST_EVENT1_ClearPrestoredFreezeFrame: RteEventRef=OIE_Event_DEM_E_TEST_EVENT1_ClearPrestoredFreezeFrame
        RteEventToTaskMapping_OIE_Event_DEM_E_TEST_EVENT1_PrestoreFreezeFrame: RteEventRef=OIE_Event_DEM_E_TEST_EVENT1_PrestoreFreezeFrame
        RteEventToTaskMapping_OIE_Event_DEM_E_TEST_EVENT1_ResetEventStatus: RteEventRef=OIE_Event_DEM_E_TEST_EVENT1_ResetEventStatus
        RteEventToTaskMapping_OIE_Event_DEM_E_TEST_EVENT1_SetEventDisabled: RteEventRef=OIE_Event_DEM_E_TEST_EVENT1_SetEventDisabled
        RteEventToTaskMapping_OIE_Event_DEM_E_TEST_EVENT1_SetEventStatus: RteEventRef=OIE_Event_DEM_E_TEST_EVENT1_SetEventStatus
        RteEventToTaskMapping_OIE_Event_DEM_E_TEST_EVENT2_ClearPrestoredFreezeFrame: RteEventRef=OIE_Event_DEM_E_TEST_EVENT2_ClearPrestoredFreezeFrame
        RteEventToTaskMapping_OIE_Event_DEM_E_TEST_EVENT2_PrestoreFreezeFrame: RteEventRef=OIE_Event_DEM_E_TEST_EVENT2_PrestoreFreezeFrame
        RteEventToTaskMapping_OIE_Event_DEM_E_TEST_EVENT2_ResetEventStatus: RteEventRef=OIE_Event_DEM_E_TEST_EVENT2_ResetEventStatus
        RteEventToTaskMapping_OIE_Event_DEM_E_TEST_EVENT2_SetEventDisabled: RteEventRef=OIE_Event_DEM_E_TEST_EVENT2_SetEventDisabled
        RteEventToTaskMapping_OIE_Event_DEM_E_TEST_EVENT2_SetEventStatus: RteEventRef=OIE_Event_DEM_E_TEST_EVENT2_SetEventStatus
        RteEventToTaskMapping_OIE_Event_DEM_E_TEST_EVENT3_ClearPrestoredFreezeFrame: RteEventRef=OIE_Event_DEM_E_TEST_EVENT3_ClearPrestoredFreezeFrame
        RteEventToTaskMapping_OIE_Event_DEM_E_TEST_EVENT3_PrestoreFreezeFrame: RteEventRef=OIE_Event_DEM_E_TEST_EVENT3_PrestoreFreezeFrame
        RteEventToTaskMapping_OIE_Event_DEM_E_TEST_EVENT3_ResetEventStatus: RteEventRef=OIE_Event_DEM_E_TEST_EVENT3_ResetEventStatus
        RteEventToTaskMapping_OIE_Event_DEM_E_TEST_EVENT3_SetEventDisabled: RteEventRef=OIE_Event_DEM_E_TEST_EVENT3_SetEventDisabled
        RteEventToTaskMapping_OIE_Event_DEM_E_TEST_EVENT3_SetEventStatus: RteEventRef=OIE_Event_DEM_E_TEST_EVENT3_SetEventStatus
        RteEventToTaskMapping_OIE_Event_DEM_E_TEST_EVENT4_ClearPrestoredFreezeFrame: RteEventRef=OIE_Event_DEM_E_TEST_EVENT4_ClearPrestoredFreezeFrame
        RteEventToTaskMapping_OIE_Event_DEM_E_TEST_EVENT4_PrestoreFreezeFrame: RteEventRef=OIE_Event_DEM_E_TEST_EVENT4_PrestoreFreezeFrame
        RteEventToTaskMapping_OIE_Event_DEM_E_TEST_EVENT4_ResetEventStatus: RteEventRef=OIE_Event_DEM_E_TEST_EVENT4_ResetEventStatus
        RteEventToTaskMapping_OIE_Event_DEM_E_TEST_EVENT4_SetEventDisabled: RteEventRef=OIE_Event_DEM_E_TEST_EVENT4_SetEventDisabled
        RteEventToTaskMapping_OIE_Event_DEM_E_TEST_EVENT4_SetEventStatus: RteEventRef=OIE_Event_DEM_E_TEST_EVENT4_SetEventStatus
        RteEventToTaskMapping_OIE_Event_DEM_E_TEST_EVENT5_ClearPrestoredFreezeFrame: RteEventRef=OIE_Event_DEM_E_TEST_EVENT5_ClearPrestoredFreezeFrame
        RteEventToTaskMapping_OIE_Event_DEM_E_TEST_EVENT5_PrestoreFreezeFrame: RteEventRef=OIE_Event_DEM_E_TEST_EVENT5_PrestoreFreezeFrame
        RteEventToTaskMapping_OIE_Event_DEM_E_TEST_EVENT5_ResetEventStatus: RteEventRef=OIE_Event_DEM_E_TEST_EVENT5_ResetEventStatus
        RteEventToTaskMapping_OIE_Event_DEM_E_TEST_EVENT5_SetEventDisabled: RteEventRef=OIE_Event_DEM_E_TEST_EVENT5_SetEventDisabled
        RteEventToTaskMapping_OIE_Event_DEM_E_TEST_EVENT5_SetEventStatus: RteEventRef=OIE_Event_DEM_E_TEST_EVENT5_SetEventStatus
        RteEventToTaskMapping_OIE_Event_DEM_E_TEST_EVENT6_ClearPrestoredFreezeFrame: RteEventRef=OIE_Event_DEM_E_TEST_EVENT6_ClearPrestoredFreezeFrame
        RteEventToTaskMapping_OIE_Event_DEM_E_TEST_EVENT6_PrestoreFreezeFrame: RteEventRef=OIE_Event_DEM_E_TEST_EVENT6_PrestoreFreezeFrame
        RteEventToTaskMapping_OIE_Event_DEM_E_TEST_EVENT6_ResetEventStatus: RteEventRef=OIE_Event_DEM_E_TEST_EVENT6_ResetEventStatus
        RteEventToTaskMapping_OIE_Event_DEM_E_TEST_EVENT6_SetEventDisabled: RteEventRef=OIE_Event_DEM_E_TEST_EVENT6_SetEventDisabled
        RteEventToTaskMapping_OIE_Event_DEM_E_TEST_EVENT6_SetEventStatus: RteEventRef=OIE_Event_DEM_E_TEST_EVENT6_SetEventStatus
        RteEventToTaskMapping_OIE_GeneralEvtInfo_GetDTCOfEvent: RteEventRef=OIE_GeneralEvtInfo_GetDTCOfEvent
        RteEventToTaskMapping_OIE_GeneralEvtInfo_GetEventExtendedDataRecord: RteEventRef=OIE_GeneralEvtInfo_GetEventExtendedDataRecord
        RteEventToTaskMapping_OIE_GeneralEvtInfo_GetEventFailed: RteEventRef=OIE_GeneralEvtInfo_GetEventFailed
        RteEventToTaskMapping_OIE_GeneralEvtInfo_GetEventFreezeFrameData: RteEventRef=OIE_GeneralEvtInfo_GetEventFreezeFrameData
        RteEventToTaskMapping_OIE_GeneralEvtInfo_GetEventStatus: RteEventRef=OIE_GeneralEvtInfo_GetEventStatus
        RteEventToTaskMapping_OIE_GeneralEvtInfo_GetEventTested: RteEventRef=OIE_GeneralEvtInfo_GetEventTested
        RteEventToTaskMapping_OIE_GeneralEvtInfo_GetFaultDetectionCounter: RteEventRef=OIE_GeneralEvtInfo_GetFaultDetectionCounter
        RteEventToTaskMapping_OIE_IndStatus_DemIndicator_0_GetIndicatorStatus: RteEventRef=OIE_IndStatus_DemIndicator_0_GetIndicatorStatus
        RteEventToTaskMapping_OIE_IndStatus_DemIndicator_1_GetIndicatorStatus: RteEventRef=OIE_IndStatus_DemIndicator_1_GetIndicatorStatus
        RteEventToTaskMapping_OIE_OverflowIndPrimaryMemory_GetEventMemoryOverflow: RteEventRef=OIE_OverflowIndPrimaryMemory_GetEventMemoryOverflow
        RteEventToTaskMapping_OIE_StorageCond_DemStorageCondition_SetStorageCondition: RteEventRef=OIE_StorageCond_DemStorageCondition_SetStorageCondition
        RteEventToTaskMapping_OIE_OpCycle_IGNITION_CYCLE_SetOperationCycleState: RteEventRef=OIE_OpCycle_IGNITION_CYCLE_SetOperationCycleState
        RteEventToTaskMapping_OIE_OpCycle_POWER_CYCLE_SetOperationCycleState: RteEventRef=OIE_OpCycle_POWER_CYCLE_SetOperationCycleState
    RteSwComponentType_Dem (RteSwComponentType): RteComponentTypeRef=Dem
      RteComponentTypeCalibration: category=TOOL_CONFIGURED, RteCalibrationSupportEnabled=0
    SwcInstance_EcuM (RteSwComponentInstance): category=TOOL_CONFIGURED, RteSoftwareComponentInstanceRef=EcuM
      21 x RteEventToTaskMapping, all with category=TOOL_CONFIGURED, RteImmediateRestart=0:
        RteEventToTaskMapping_OIE_GetBootTarget: RteEventRef=OIE_GetBootTarget
        RteEventToTaskMapping_OIE_SelectBootTarget: RteEventRef=OIE_SelectBootTarget
        RteEventToTaskMapping_OIE_GetLastShutdownTarget: RteEventRef=OIE_GetLastShutdownTarget
        RteEventToTaskMapping_OIE_GetMostRecentShutdown: RteEventRef=OIE_GetMostRecentShutdown
        RteEventToTaskMapping_OIE_GetNextRecentShutdown: RteEventRef=OIE_GetNextRecentShutdown
        RteEventToTaskMapping_OIE_GetShutdownCause: RteEventRef=OIE_GetShutdownCause
        RteEventToTaskMapping_OIE_GetShutdownTarget: RteEventRef=OIE_GetShutdownTarget
        RteEventToTaskMapping_OIE_GoDown: RteEventRef=OIE_GoDown
        RteEventToTaskMapping_OIE_GoHalt: RteEventRef=OIE_GoHalt
        RteEventToTaskMapping_OIE_GoPoll: RteEventRef=OIE_GoPoll
        RteEventToTaskMapping_OIE_SelectShutdownCause: RteEventRef=OIE_SelectShutdownCause
        RteEventToTaskMapping_OIE_SelectShutdownTarget: RteEventRef=OIE_SelectShutdownTarget
        RteEventToTaskMapping_OIE_ReleaseRUN: RteEventRef=OIE_ReleaseRUN
        RteEventToTaskMapping_OIE_RequestOff: RteEventRef=OIE_RequestOff
        RteEventToTaskMapping_OIE_RequestRUN: RteEventRef=OIE_RequestRUN
        RteEventToTaskMapping_OIE_RequestReset: RteEventRef=OIE_RequestReset
        RteEventToTaskMapping_OIE_RequestSleep: RteEventRef=OIE_RequestSleep
        RteEventToTaskMapping_OIE_SetRunState: RteEventRef=OIE_SetRunState
        RteEventToTaskMapping_OIE_ClearWakeupEvent: RteEventRef=OIE_ClearWakeupEvent
        RteEventToTaskMapping_OIE_DisableWakeupSources: RteEventRef=OIE_DisableWakeupSources
        RteEventToTaskMapping_OIE_EnableWakeupSources: RteEventRef=OIE_EnableWakeupSources
    RteSwComponentType_EcuM (RteSwComponentType): RteComponentTypeRef=EcuM
      RteComponentTypeCalibration: category=TOOL_CONFIGURED, RteCalibrationSupportEnabled=0
    SwcInstance_IoHwAb (RteSwComponentInstance): category=TOOL_CONFIGURED, RteSoftwareComponentInstanceRef=IoHwAb
      166 x RteEventToTaskMapping, all with category=TOOL_CONFIGURED, RteImmediateRestart=0:
        RteEventToTaskMapping_IoHwAb_Ev_IoHwAbDigitalDirectLogical_BCAN_RX_ReadDirect: RteEventRef=IoHwAb_Ev_IoHwAbDigitalDirectLogical_BCAN_RX_ReadDirect
        RteEventToTaskMapping_IoHwAb_Ev_IoHwAbDigitalDirectLogical_BCAN_RX_WriteDirect: RteEventRef=IoHwAb_Ev_IoHwAbDigitalDirectLogical_BCAN_RX_WriteDirect
        RteEventToTaskMapping_IoHwAb_Ev_IoHwAbDigitalDirectLogical_BCAN_RX_SetToInput: RteEventRef=IoHwAb_Ev_IoHwAbDigitalDirectLogical_BCAN_RX_SetToInput
        RteEventToTaskMapping_IoHwAb_Ev_IoHwAbDigitalDirectLogical_BCAN_RX_SetToOutput: RteEventRef=IoHwAb_Ev_IoHwAbDigitalDirectLogical_BCAN_RX_SetToOutput
        RteEventToTaskMapping_IoHwAb_Ev_IoHwAbDigitalDirectLogical_BCAN_RX_IsInput: RteEventRef=IoHwAb_Ev_IoHwAbDigitalDirectLogical_BCAN_RX_IsInput
        RteEventToTaskMapping_IoHwAb_Ev_IoHwAbDigitalDirectLogical_BCAN_RX_IsOutput: RteEventRef=IoHwAb_Ev_IoHwAbDigitalDirectLogical_BCAN_RX_IsOutput
        RteEventToTaskMapping_IoHwAb_Ev_IoHwAbDigitalDirectLogical_LOCALCAN_RX_ReadDirect: RteEventRef=IoHwAb_Ev_IoHwAbDigitalDirectLogical_LOCALCAN_RX_ReadDirect
        RteEventToTaskMapping_IoHwAb_Ev_IoHwAbDigitalDirectLogical_LOCALCAN_RX_WriteDirect: RteEventRef=IoHwAb_Ev_IoHwAbDigitalDirectLogical_LOCALCAN_RX_WriteDirect
        RteEventToTaskMapping_IoHwAb_Ev_IoHwAbDigitalDirectLogical_LOCALCAN_RX_SetToInput: RteEventRef=IoHwAb_Ev_IoHwAbDigitalDirectLogical_LOCALCAN_RX_SetToInput
        RteEventToTaskMapping_IoHwAb_Ev_IoHwAbDigitalDirectLogical_LOCALCAN_RX_SetToOutput: RteEventRef=IoHwAb_Ev_IoHwAbDigitalDirectLogical_LOCALCAN_RX_SetToOutput
        RteEventToTaskMapping_IoHwAb_Ev_IoHwAbDigitalDirectLogical_LOCALCAN_RX_IsInput: RteEventRef=IoHwAb_Ev_IoHwAbDigitalDirectLogical_LOCALCAN_RX_IsInput
        RteEventToTaskMapping_IoHwAb_Ev_IoHwAbDigitalDirectLogical_LOCALCAN_RX_IsOutput: RteEventRef=IoHwAb_Ev_IoHwAbDigitalDirectLogical_LOCALCAN_RX_IsOutput
        RteEventToTaskMapping_IoHwAb_Ev_VolMon_Read: RteEventRef=IoHwAb_Ev_VolMon_Read
        RteEventToTaskMapping_IoHwAb_Ev_VolMon_GetStatus: RteEventRef=IoHwAb_Ev_VolMon_GetStatus
        RteEventToTaskMapping_IoHwAb_Ev_VolMon_IsThresholdOver: RteEventRef=IoHwAb_Ev_VolMon_IsThresholdOver
        RteEventToTaskMapping_IoHwAb_Ev_VolMon_IsThresholdUnder: RteEventRef=IoHwAb_Ev_VolMon_IsThresholdUnder
        RteEventToTaskMapping_IoHwAb_Ev_Icu_NFC_INTERRUPT_SetActivationCondition: RteEventRef=IoHwAb_Ev_Icu_NFC_INTERRUPT_SetActivationCondition
        RteEventToTaskMapping_IoHwAb_Ev_Icu_NFC_INTERRUPT_DisableNotification: RteEventRef=IoHwAb_Ev_Icu_NFC_INTERRUPT_DisableNotification
        RteEventToTaskMapping_IoHwAb_Ev_Icu_NFC_INTERRUPT_EnableNotification: RteEventRef=IoHwAb_Ev_Icu_NFC_INTERRUPT_EnableNotification
        RteEventToTaskMapping_IoHwAb_Ev_Icu_NFC_INTERRUPT_GetInputState: RteEventRef=IoHwAb_Ev_Icu_NFC_INTERRUPT_GetInputState
        RteEventToTaskMapping_IoHwAb_Ev_Icu_NFC_INTERRUPT_StartTimestamp: RteEventRef=IoHwAb_Ev_Icu_NFC_INTERRUPT_StartTimestamp
        RteEventToTaskMapping_IoHwAb_Ev_Icu_NFC_INTERRUPT_StopTimestamp: RteEventRef=IoHwAb_Ev_Icu_NFC_INTERRUPT_StopTimestamp
        RteEventToTaskMapping_IoHwAb_Ev_Icu_NFC_INTERRUPT_GetTimestampIndex: RteEventRef=IoHwAb_Ev_Icu_NFC_INTERRUPT_GetTimestampIndex
        RteEventToTaskMapping_IoHwAb_Ev_Icu_NFC_INTERRUPT_ResetEdgeCount: RteEventRef=IoHwAb_Ev_Icu_NFC_INTERRUPT_ResetEdgeCount
        RteEventToTaskMapping_IoHwAb_Ev_Icu_NFC_INTERRUPT_EnableEdgeCount: RteEventRef=IoHwAb_Ev_Icu_NFC_INTERRUPT_EnableEdgeCount
        RteEventToTaskMapping_IoHwAb_Ev_Icu_NFC_INTERRUPT_DisableEdgeCount: RteEventRef=IoHwAb_Ev_Icu_NFC_INTERRUPT_DisableEdgeCount
        RteEventToTaskMapping_IoHwAb_Ev_Icu_NFC_INTERRUPT_GetEdgeNumbers: RteEventRef=IoHwAb_Ev_Icu_NFC_INTERRUPT_GetEdgeNumbers
        RteEventToTaskMapping_IoHwAb_Ev_Icu_NFC_INTERRUPT_EnableEdgeDetection: RteEventRef=IoHwAb_Ev_Icu_NFC_INTERRUPT_EnableEdgeDetection
        RteEventToTaskMapping_IoHwAb_Ev_Icu_NFC_INTERRUPT_DisableEdgeDetection: RteEventRef=IoHwAb_Ev_Icu_NFC_INTERRUPT_DisableEdgeDetection
        RteEventToTaskMapping_IoHwAb_Ev_Icu_NFC_INTERRUPT_StartSignalMeasurement: RteEventRef=IoHwAb_Ev_Icu_NFC_INTERRUPT_StartSignalMeasurement
        RteEventToTaskMapping_IoHwAb_Ev_Icu_NFC_INTERRUPT_StopSignalMeasurement: RteEventRef=IoHwAb_Ev_Icu_NFC_INTERRUPT_StopSignalMeasurement
        RteEventToTaskMapping_IoHwAb_Ev_Icu_NFC_INTERRUPT_GetTimeElapsed: RteEventRef=IoHwAb_Ev_Icu_NFC_INTERRUPT_GetTimeElapsed
        RteEventToTaskMapping_IoHwAb_Ev_Icu_NFC_INTERRUPT_GetDutyCycleValues: RteEventRef=IoHwAb_Ev_Icu_NFC_INTERRUPT_GetDutyCycleValues
        RteEventToTaskMapping_IoHwAb_Ev_Icu_P9450_INTB_SetActivationCondition: RteEventRef=IoHwAb_Ev_Icu_P9450_INTB_SetActivationCondition
        RteEventToTaskMapping_IoHwAb_Ev_Icu_P9450_INTB_DisableNotification: RteEventRef=IoHwAb_Ev_Icu_P9450_INTB_DisableNotification
        RteEventToTaskMapping_IoHwAb_Ev_Icu_P9450_INTB_EnableNotification: RteEventRef=IoHwAb_Ev_Icu_P9450_INTB_EnableNotification
        RteEventToTaskMapping_IoHwAb_Ev_Icu_P9450_INTB_GetInputState: RteEventRef=IoHwAb_Ev_Icu_P9450_INTB_GetInputState
        RteEventToTaskMapping_IoHwAb_Ev_Icu_P9450_INTB_StartTimestamp: RteEventRef=IoHwAb_Ev_Icu_P9450_INTB_StartTimestamp
        RteEventToTaskMapping_IoHwAb_Ev_Icu_P9450_INTB_StopTimestamp: RteEventRef=IoHwAb_Ev_Icu_P9450_INTB_StopTimestamp
        RteEventToTaskMapping_IoHwAb_Ev_Icu_P9450_INTB_GetTimestampIndex: RteEventRef=IoHwAb_Ev_Icu_P9450_INTB_GetTimestampIndex
        RteEventToTaskMapping_IoHwAb_Ev_Icu_P9450_INTB_ResetEdgeCount: RteEventRef=IoHwAb_Ev_Icu_P9450_INTB_ResetEdgeCount
        RteEventToTaskMapping_IoHwAb_Ev_Icu_P9450_INTB_EnableEdgeCount: RteEventRef=IoHwAb_Ev_Icu_P9450_INTB_EnableEdgeCount
        RteEventToTaskMapping_IoHwAb_Ev_Icu_P9450_INTB_DisableEdgeCount: RteEventRef=IoHwAb_Ev_Icu_P9450_INTB_DisableEdgeCount
        RteEventToTaskMapping_IoHwAb_Ev_Icu_P9450_INTB_GetEdgeNumbers: RteEventRef=IoHwAb_Ev_Icu_P9450_INTB_GetEdgeNumbers
        RteEventToTaskMapping_IoHwAb_Ev_Icu_P9450_INTB_EnableEdgeDetection: RteEventRef=IoHwAb_Ev_Icu_P9450_INTB_EnableEdgeDetection
        RteEventToTaskMapping_IoHwAb_Ev_Icu_P9450_INTB_DisableEdgeDetection: RteEventRef=IoHwAb_Ev_Icu_P9450_INTB_DisableEdgeDetection
        RteEventToTaskMapping_IoHwAb_Ev_Icu_P9450_INTB_StartSignalMeasurement: RteEventRef=IoHwAb_Ev_Icu_P9450_INTB_StartSignalMeasurement
        RteEventToTaskMapping_IoHwAb_Ev_Icu_P9450_INTB_StopSignalMeasurement: RteEventRef=IoHwAb_Ev_Icu_P9450_INTB_StopSignalMeasurement
        RteEventToTaskMapping_IoHwAb_Ev_Icu_P9450_INTB_GetTimeElapsed: RteEventRef=IoHwAb_Ev_Icu_P9450_INTB_GetTimeElapsed
        RteEventToTaskMapping_IoHwAb_Ev_Icu_P9450_INTB_GetDutyCycleValues: RteEventRef=IoHwAb_Ev_Icu_P9450_INTB_GetDutyCycleValues
        RteEventToTaskMapping_IoHwAb_Ev_DigDir_BCAN_WakeUp_INT_ReadDirect: RteEventRef=IoHwAb_Ev_DigDir_BCAN_WakeUp_INT_ReadDirect
        RteEventToTaskMapping_IoHwAb_Ev_DigDir_BCAN_WakeUp_INT_WriteDirect: RteEventRef=IoHwAb_Ev_DigDir_BCAN_WakeUp_INT_WriteDirect
        RteEventToTaskMapping_IoHwAb_Ev_DigDir_BCAN_WakeUp_INT_SetToInput: RteEventRef=IoHwAb_Ev_DigDir_BCAN_WakeUp_INT_SetToInput
        RteEventToTaskMapping_IoHwAb_Ev_DigDir_BCAN_WakeUp_INT_SetToOutput: RteEventRef=IoHwAb_Ev_DigDir_BCAN_WakeUp_INT_SetToOutput
        RteEventToTaskMapping_IoHwAb_Ev_DigDir_BCAN_WakeUp_INT_IsInput: RteEventRef=IoHwAb_Ev_DigDir_BCAN_WakeUp_INT_IsInput
        RteEventToTaskMapping_IoHwAb_Ev_DigDir_BCAN_WakeUp_INT_IsOutput: RteEventRef=IoHwAb_Ev_DigDir_BCAN_WakeUp_INT_IsOutput
        RteEventToTaskMapping_IoHwAb_Ev_DigDir_FAN_DIAG_ReadDirect: RteEventRef=IoHwAb_Ev_DigDir_FAN_DIAG_ReadDirect
        RteEventToTaskMapping_IoHwAb_Ev_DigDir_FAN_DIAG_WriteDirect: RteEventRef=IoHwAb_Ev_DigDir_FAN_DIAG_WriteDirect
        RteEventToTaskMapping_IoHwAb_Ev_DigDir_FAN_DIAG_SetToInput: RteEventRef=IoHwAb_Ev_DigDir_FAN_DIAG_SetToInput
        RteEventToTaskMapping_IoHwAb_Ev_DigDir_FAN_DIAG_SetToOutput: RteEventRef=IoHwAb_Ev_DigDir_FAN_DIAG_SetToOutput
        RteEventToTaskMapping_IoHwAb_Ev_DigDir_FAN_DIAG_IsInput: RteEventRef=IoHwAb_Ev_DigDir_FAN_DIAG_IsInput
        RteEventToTaskMapping_IoHwAb_Ev_DigDir_FAN_DIAG_IsOutput: RteEventRef=IoHwAb_Ev_DigDir_FAN_DIAG_IsOutput
        RteEventToTaskMapping_IoHwAb_Ev_DigDir_LCAN_WakeUp_INT_ReadDirect: RteEventRef=IoHwAb_Ev_DigDir_LCAN_WakeUp_INT_ReadDirect
        RteEventToTaskMapping_IoHwAb_Ev_DigDir_LCAN_WakeUp_INT_WriteDirect: RteEventRef=IoHwAb_Ev_DigDir_LCAN_WakeUp_INT_WriteDirect
        RteEventToTaskMapping_IoHwAb_Ev_DigDir_LCAN_WakeUp_INT_SetToInput: RteEventRef=IoHwAb_Ev_DigDir_LCAN_WakeUp_INT_SetToInput
        RteEventToTaskMapping_IoHwAb_Ev_DigDir_LCAN_WakeUp_INT_SetToOutput: RteEventRef=IoHwAb_Ev_DigDir_LCAN_WakeUp_INT_SetToOutput
        RteEventToTaskMapping_IoHwAb_Ev_DigDir_LCAN_WakeUp_INT_IsInput: RteEventRef=IoHwAb_Ev_DigDir_LCAN_WakeUp_INT_IsInput
        RteEventToTaskMapping_IoHwAb_Ev_DigDir_LCAN_WakeUp_INT_IsOutput: RteEventRef=IoHwAb_Ev_DigDir_LCAN_WakeUp_INT_IsOutput
        RteEventToTaskMapping_IoHwAb_Ev_DigDir_NFC_INTERRUPT_INT_ReadDirect: RteEventRef=IoHwAb_Ev_DigDir_NFC_INTERRUPT_INT_ReadDirect
        RteEventToTaskMapping_IoHwAb_Ev_DigDir_NFC_INTERRUPT_INT_WriteDirect: RteEventRef=IoHwAb_Ev_DigDir_NFC_INTERRUPT_INT_WriteDirect
        RteEventToTaskMapping_IoHwAb_Ev_DigDir_NFC_INTERRUPT_INT_SetToInput: RteEventRef=IoHwAb_Ev_DigDir_NFC_INTERRUPT_INT_SetToInput
        RteEventToTaskMapping_IoHwAb_Ev_DigDir_NFC_INTERRUPT_INT_SetToOutput: RteEventRef=IoHwAb_Ev_DigDir_NFC_INTERRUPT_INT_SetToOutput
        RteEventToTaskMapping_IoHwAb_Ev_DigDir_NFC_INTERRUPT_INT_IsInput: RteEventRef=IoHwAb_Ev_DigDir_NFC_INTERRUPT_INT_IsInput
        RteEventToTaskMapping_IoHwAb_Ev_DigDir_NFC_INTERRUPT_INT_IsOutput: RteEventRef=IoHwAb_Ev_DigDir_NFC_INTERRUPT_INT_IsOutput
        RteEventToTaskMapping_IoHwAb_Ev_DigDir_P9450_INTB_INT_ReadDirect: RteEventRef=IoHwAb_Ev_DigDir_P9450_INTB_INT_ReadDirect
        RteEventToTaskMapping_IoHwAb_Ev_DigDir_P9450_INTB_INT_WriteDirect: RteEventRef=IoHwAb_Ev_DigDir_P9450_INTB_INT_WriteDirect
        RteEventToTaskMapping_IoHwAb_Ev_DigDir_P9450_INTB_INT_SetToInput: RteEventRef=IoHwAb_Ev_DigDir_P9450_INTB_INT_SetToInput
        RteEventToTaskMapping_IoHwAb_Ev_DigDir_P9450_INTB_INT_SetToOutput: RteEventRef=IoHwAb_Ev_DigDir_P9450_INTB_INT_SetToOutput
        RteEventToTaskMapping_IoHwAb_Ev_DigDir_P9450_INTB_INT_IsInput: RteEventRef=IoHwAb_Ev_DigDir_P9450_INTB_INT_IsInput
        RteEventToTaskMapping_IoHwAb_Ev_DigDir_P9450_INTB_INT_IsOutput: RteEventRef=IoHwAb_Ev_DigDir_P9450_INTB_INT_IsOutput
        RteEventToTaskMapping_IoHwAb_Ev_DigDir_VBATSW_EN_ReadDirect: RteEventRef=IoHwAb_Ev_DigDir_VBATSW_EN_ReadDirect
        RteEventToTaskMapping_IoHwAb_Ev_DigDir_VBATSW_EN_WriteDirect: RteEventRef=IoHwAb_Ev_DigDir_VBATSW_EN_WriteDirect
        RteEventToTaskMapping_IoHwAb_Ev_DigDir_VBATSW_EN_SetToInput: RteEventRef=IoHwAb_Ev_DigDir_VBATSW_EN_SetToInput
        RteEventToTaskMapping_IoHwAb_Ev_DigDir_VBATSW_EN_SetToOutput: RteEventRef=IoHwAb_Ev_DigDir_VBATSW_EN_SetToOutput
        RteEventToTaskMapping_IoHwAb_Ev_DigDir_VBATSW_EN_IsInput: RteEventRef=IoHwAb_Ev_DigDir_VBATSW_EN_IsInput
        RteEventToTaskMapping_IoHwAb_Ev_DigDir_VBATSW_EN_IsOutput: RteEventRef=IoHwAb_Ev_DigDir_VBATSW_EN_IsOutput
        RteEventToTaskMapping_IoHwAb_Ev_DigDir_VN7140AS_IN_ReadDirect: RteEventRef=IoHwAb_Ev_DigDir_VN7140AS_IN_ReadDirect
        RteEventToTaskMapping_IoHwAb_Ev_DigDir_VN7140AS_IN_WriteDirect: RteEventRef=IoHwAb_Ev_DigDir_VN7140AS_IN_WriteDirect
        RteEventToTaskMapping_IoHwAb_Ev_DigDir_VN7140AS_IN_SetToInput: RteEventRef=IoHwAb_Ev_DigDir_VN7140AS_IN_SetToInput
        RteEventToTaskMapping_IoHwAb_Ev_DigDir_VN7140AS_IN_SetToOutput: RteEventRef=IoHwAb_Ev_DigDir_VN7140AS_IN_SetToOutput
        RteEventToTaskMapping_IoHwAb_Ev_DigDir_VN7140AS_IN_IsInput: RteEventRef=IoHwAb_Ev_DigDir_VN7140AS_IN_IsInput
        RteEventToTaskMapping_IoHwAb_Ev_DigDir_VN7140AS_IN_IsOutput: RteEventRef=IoHwAb_Ev_DigDir_VN7140AS_IN_IsOutput
        RteEventToTaskMapping_IoHwAb_Ev_DigDir_VN7140AS_MULTI_ReadDirect: RteEventRef=IoHwAb_Ev_DigDir_VN7140AS_MULTI_ReadDirect
        RteEventToTaskMapping_IoHwAb_Ev_DigDir_VN7140AS_MULTI_WriteDirect: RteEventRef=IoHwAb_Ev_DigDir_VN7140AS_MULTI_WriteDirect
        RteEventToTaskMapping_IoHwAb_Ev_DigDir_VN7140AS_MULTI_SetToInput: RteEventRef=IoHwAb_Ev_DigDir_VN7140AS_MULTI_SetToInput
        RteEventToTaskMapping_IoHwAb_Ev_DigDir_VN7140AS_MULTI_SetToOutput: RteEventRef=IoHwAb_Ev_DigDir_VN7140AS_MULTI_SetToOutput
        RteEventToTaskMapping_IoHwAb_Ev_DigDir_VN7140AS_MULTI_IsInput: RteEventRef=IoHwAb_Ev_DigDir_VN7140AS_MULTI_IsInput
        RteEventToTaskMapping_IoHwAb_Ev_DigDir_VN7140AS_MULTI_IsOutput: RteEventRef=IoHwAb_Ev_DigDir_VN7140AS_MULTI_IsOutput
        RteEventToTaskMapping_IoHwAb_Ev_DigDir_VN7140AS_SEN_ReadDirect: RteEventRef=IoHwAb_Ev_DigDir_VN7140AS_SEN_ReadDirect
        RteEventToTaskMapping_IoHwAb_Ev_DigDir_VN7140AS_SEN_WriteDirect: RteEventRef=IoHwAb_Ev_DigDir_VN7140AS_SEN_WriteDirect
        RteEventToTaskMapping_IoHwAb_Ev_DigDir_VN7140AS_SEN_SetToInput: RteEventRef=IoHwAb_Ev_DigDir_VN7140AS_SEN_SetToInput
        RteEventToTaskMapping_IoHwAb_Ev_DigDir_VN7140AS_SEN_SetToOutput: RteEventRef=IoHwAb_Ev_DigDir_VN7140AS_SEN_SetToOutput
        RteEventToTaskMapping_IoHwAb_Ev_DigDir_VN7140AS_SEN_IsInput: RteEventRef=IoHwAb_Ev_DigDir_VN7140AS_SEN_IsInput
        RteEventToTaskMapping_IoHwAb_Ev_DigDir_VN7140AS_SEN_IsOutput: RteEventRef=IoHwAb_Ev_DigDir_VN7140AS_SEN_IsOutput
        RteEventToTaskMapping_IoHwAb_Ev_AnaInDir_ACC_Real_ReadDirect: RteEventRef=IoHwAb_Ev_AnaInDir_ACC_Real_ReadDirect
        RteEventToTaskMapping_IoHwAb_Ev_AnaInDir_Battery_Real_ReadDirect: RteEventRef=IoHwAb_Ev_AnaInDir_Battery_Real_ReadDirect
        RteEventToTaskMapping_IoHwAb_Ev_AnaInDir_Thermistor_ReadDirect: RteEventRef=IoHwAb_Ev_AnaInDir_Thermistor_ReadDirect
        RteEventToTaskMapping_IoHwAb_Ev_AnaIn_ACC_Real_Read: RteEventRef=IoHwAb_Ev_AnaIn_ACC_Real_Read
        RteEventToTaskMapping_IoHwAb_Ev_AnaIn_ACC_Real_Freeze: RteEventRef=IoHwAb_Ev_AnaIn_ACC_Real_Freeze
        RteEventToTaskMapping_IoHwAb_Ev_AnaIn_ACC_Real_Unfreeze: RteEventRef=IoHwAb_Ev_AnaIn_ACC_Real_Unfreeze
        RteEventToTaskMapping_IoHwAb_Ev_AnaIn_Thermistor_Read: RteEventRef=IoHwAb_Ev_AnaIn_Thermistor_Read
        RteEventToTaskMapping_IoHwAb_Ev_AnaIn_Thermistor_Freeze: RteEventRef=IoHwAb_Ev_AnaIn_Thermistor_Freeze
        RteEventToTaskMapping_IoHwAb_Ev_AnaIn_Thermistor_Unfreeze: RteEventRef=IoHwAb_Ev_AnaIn_Thermistor_Unfreeze
        RteEventToTaskMapping_IoHwAb_Ev_Pwm_AMBER_IND_OUT_SetDutyCycle: RteEventRef=IoHwAb_Ev_Pwm_AMBER_IND_OUT_SetDutyCycle
        RteEventToTaskMapping_IoHwAb_Ev_Pwm_AMBER_IND_OUT_SetPeriodAndDuty: RteEventRef=IoHwAb_Ev_Pwm_AMBER_IND_OUT_SetPeriodAndDuty
        RteEventToTaskMapping_IoHwAb_Ev_Pwm_AMBER_IND_OUT_SetOutputToIdle: RteEventRef=IoHwAb_Ev_Pwm_AMBER_IND_OUT_SetOutputToIdle
        RteEventToTaskMapping_IoHwAb_Ev_Pwm_AMBER_IND_OUT_GetOutputState: RteEventRef=IoHwAb_Ev_Pwm_AMBER_IND_OUT_GetOutputState
        RteEventToTaskMapping_IoHwAb_Ev_Pwm_AMBER_IND_OUT_DisableNotification: RteEventRef=IoHwAb_Ev_Pwm_AMBER_IND_OUT_DisableNotification
        RteEventToTaskMapping_IoHwAb_Ev_Pwm_AMBER_IND_OUT_EnableNotification: RteEventRef=IoHwAb_Ev_Pwm_AMBER_IND_OUT_EnableNotification
        RteEventToTaskMapping_IoHwAb_Ev_Pwm_FAN_OUT_SetDutyCycle: RteEventRef=IoHwAb_Ev_Pwm_FAN_OUT_SetDutyCycle
        RteEventToTaskMapping_IoHwAb_Ev_Pwm_FAN_OUT_SetPeriodAndDuty: RteEventRef=IoHwAb_Ev_Pwm_FAN_OUT_SetPeriodAndDuty
        RteEventToTaskMapping_IoHwAb_Ev_Pwm_FAN_OUT_SetOutputToIdle: RteEventRef=IoHwAb_Ev_Pwm_FAN_OUT_SetOutputToIdle
        RteEventToTaskMapping_IoHwAb_Ev_Pwm_FAN_OUT_GetOutputState: RteEventRef=IoHwAb_Ev_Pwm_FAN_OUT_GetOutputState
        RteEventToTaskMapping_IoHwAb_Ev_Pwm_FAN_OUT_DisableNotification: RteEventRef=IoHwAb_Ev_Pwm_FAN_OUT_DisableNotification
        RteEventToTaskMapping_IoHwAb_Ev_Pwm_FAN_OUT_EnableNotification: RteEventRef=IoHwAb_Ev_Pwm_FAN_OUT_EnableNotification
        RteEventToTaskMapping_IoHwAb_Ev_Pwm_GREEN_IND_OUT1_SetDutyCycle: RteEventRef=IoHwAb_Ev_Pwm_GREEN_IND_OUT1_SetDutyCycle
        RteEventToTaskMapping_IoHwAb_Ev_Pwm_GREEN_IND_OUT1_SetPeriodAndDuty: RteEventRef=IoHwAb_Ev_Pwm_GREEN_IND_OUT1_SetPeriodAndDuty
        RteEventToTaskMapping_IoHwAb_Ev_Pwm_GREEN_IND_OUT1_SetOutputToIdle: RteEventRef=IoHwAb_Ev_Pwm_GREEN_IND_OUT1_SetOutputToIdle
        RteEventToTaskMapping_IoHwAb_Ev_Pwm_GREEN_IND_OUT1_GetOutputState: RteEventRef=IoHwAb_Ev_Pwm_GREEN_IND_OUT1_GetOutputState
        RteEventToTaskMapping_IoHwAb_Ev_Pwm_GREEN_IND_OUT1_DisableNotification: RteEventRef=IoHwAb_Ev_Pwm_GREEN_IND_OUT1_DisableNotification
        RteEventToTaskMapping_IoHwAb_Ev_Pwm_GREEN_IND_OUT1_EnableNotification: RteEventRef=IoHwAb_Ev_Pwm_GREEN_IND_OUT1_EnableNotification
        RteEventToTaskMapping_IoHwAb_Ev_Pwm_GREEN_IND_OUT2_SetDutyCycle: RteEventRef=IoHwAb_Ev_Pwm_GREEN_IND_OUT2_SetDutyCycle
        RteEventToTaskMapping_IoHwAb_Ev_Pwm_GREEN_IND_OUT2_SetPeriodAndDuty: RteEventRef=IoHwAb_Ev_Pwm_GREEN_IND_OUT2_SetPeriodAndDuty
        RteEventToTaskMapping_IoHwAb_Ev_Pwm_GREEN_IND_OUT2_SetOutputToIdle: RteEventRef=IoHwAb_Ev_Pwm_GREEN_IND_OUT2_SetOutputToIdle
        RteEventToTaskMapping_IoHwAb_Ev_Pwm_GREEN_IND_OUT2_GetOutputState: RteEventRef=IoHwAb_Ev_Pwm_GREEN_IND_OUT2_GetOutputState
        RteEventToTaskMapping_IoHwAb_Ev_Pwm_GREEN_IND_OUT2_DisableNotification: RteEventRef=IoHwAb_Ev_Pwm_GREEN_IND_OUT2_DisableNotification
        RteEventToTaskMapping_IoHwAb_Ev_Pwm_GREEN_IND_OUT2_EnableNotification: RteEventRef=IoHwAb_Ev_Pwm_GREEN_IND_OUT2_EnableNotification
        RteEventToTaskMapping_IoHwAb_Ev_Pwm_GREEN_IND_OUT3_SetDutyCycle: RteEventRef=IoHwAb_Ev_Pwm_GREEN_IND_OUT3_SetDutyCycle
        RteEventToTaskMapping_IoHwAb_Ev_Pwm_GREEN_IND_OUT3_SetPeriodAndDuty: RteEventRef=IoHwAb_Ev_Pwm_GREEN_IND_OUT3_SetPeriodAndDuty
        RteEventToTaskMapping_IoHwAb_Ev_Pwm_GREEN_IND_OUT3_SetOutputToIdle: RteEventRef=IoHwAb_Ev_Pwm_GREEN_IND_OUT3_SetOutputToIdle
        RteEventToTaskMapping_IoHwAb_Ev_Pwm_GREEN_IND_OUT3_GetOutputState: RteEventRef=IoHwAb_Ev_Pwm_GREEN_IND_OUT3_GetOutputState
        RteEventToTaskMapping_IoHwAb_Ev_Pwm_GREEN_IND_OUT3_DisableNotification: RteEventRef=IoHwAb_Ev_Pwm_GREEN_IND_OUT3_DisableNotification
        RteEventToTaskMapping_IoHwAb_Ev_Pwm_GREEN_IND_OUT3_EnableNotification: RteEventRef=IoHwAb_Ev_Pwm_GREEN_IND_OUT3_EnableNotification
        RteEventToTaskMapping_IoHwAb_Ev_DigDir_SPI_CS_ReadDirect: RteEventRef=IoHwAb_Ev_DigDir_SPI_CS_ReadDirect
        RteEventToTaskMapping_IoHwAb_Ev_DigDir_SPI_CS_WriteDirect: RteEventRef=IoHwAb_Ev_DigDir_SPI_CS_WriteDirect
        RteEventToTaskMapping_IoHwAb_Ev_DigDir_SPI_CS_SetToInput: RteEventRef=IoHwAb_Ev_DigDir_SPI_CS_SetToInput
        RteEventToTaskMapping_IoHwAb_Ev_DigDir_SPI_CS_SetToOutput: RteEventRef=IoHwAb_Ev_DigDir_SPI_CS_SetToOutput
        RteEventToTaskMapping_IoHwAb_Ev_DigDir_SPI_CS_IsInput: RteEventRef=IoHwAb_Ev_DigDir_SPI_CS_IsInput
        RteEventToTaskMapping_IoHwAb_Ev_DigDir_SPI_CS_IsOutput: RteEventRef=IoHwAb_Ev_DigDir_SPI_CS_IsOutput
        RteEventToTaskMapping_IoHwAb_Ev_Gpt_NFC_TickTimer_StartTimer: RteEventRef=IoHwAb_Ev_Gpt_NFC_TickTimer_StartTimer
        RteEventToTaskMapping_IoHwAb_Ev_Gpt_NFC_TickTimer_StopTimer: RteEventRef=IoHwAb_Ev_Gpt_NFC_TickTimer_StopTimer
        RteEventToTaskMapping_IoHwAb_Ev_Gpt_NFC_TickTimer_GetTimeElapsed: RteEventRef=IoHwAb_Ev_Gpt_NFC_TickTimer_GetTimeElapsed
        RteEventToTaskMapping_IoHwAb_Ev_Gpt_NFC_TickTimer_GetTimeRemaining: RteEventRef=IoHwAb_Ev_Gpt_NFC_TickTimer_GetTimeRemaining
        RteEventToTaskMapping_IoHwAb_Ev_Gpt_NFC_TickTimer_DisableNotification: RteEventRef=IoHwAb_Ev_Gpt_NFC_TickTimer_DisableNotification
        RteEventToTaskMapping_IoHwAb_Ev_Gpt_NFC_TickTimer_EnableNotification: RteEventRef=IoHwAb_Ev_Gpt_NFC_TickTimer_EnableNotification
        RteEventToTaskMapping_IoHwAb_Ev_AnaIn_Battery_Real_Read: RteEventRef=IoHwAb_Ev_AnaIn_Battery_Real_Read
        RteEventToTaskMapping_IoHwAb_Ev_AnaIn_Battery_Real_Freeze: RteEventRef=IoHwAb_Ev_AnaIn_Battery_Real_Freeze
        RteEventToTaskMapping_IoHwAb_Ev_AnaIn_Battery_Real_Unfreeze: RteEventRef=IoHwAb_Ev_AnaIn_Battery_Real_Unfreeze
        RteEventToTaskMapping_IoHwAb_Ev_DigDir_NFC_OPTION_ReadDirect: RteEventRef=IoHwAb_Ev_DigDir_NFC_OPTION_ReadDirect
        RteEventToTaskMapping_IoHwAb_Ev_DigDir_NFC_OPTION_WriteDirect: RteEventRef=IoHwAb_Ev_DigDir_NFC_OPTION_WriteDirect
        RteEventToTaskMapping_IoHwAb_Ev_DigDir_NFC_OPTION_SetToInput: RteEventRef=IoHwAb_Ev_DigDir_NFC_OPTION_SetToInput
        RteEventToTaskMapping_IoHwAb_Ev_DigDir_NFC_OPTION_SetToOutput: RteEventRef=IoHwAb_Ev_DigDir_NFC_OPTION_SetToOutput
        RteEventToTaskMapping_IoHwAb_Ev_DigDir_NFC_OPTION_IsInput: RteEventRef=IoHwAb_Ev_DigDir_NFC_OPTION_IsInput
        RteEventToTaskMapping_IoHwAb_Ev_DigDir_NFC_OPTION_IsOutput: RteEventRef=IoHwAb_Ev_DigDir_NFC_OPTION_IsOutput
        RteEventToTaskMapping_IoHwAb_Ev_AnaInDir_Thermistor2_ReadDirect: RteEventRef=IoHwAb_Ev_AnaInDir_Thermistor2_ReadDirect
        RteEventToTaskMapping_IoHwAb_Ev_AnaInDir_Thermistor3_ReadDirect: RteEventRef=IoHwAb_Ev_AnaInDir_Thermistor3_ReadDirect
    RteSwComponentType_IoHwAb (RteSwComponentType): RteComponentTypeRef=IoHwAb
      RteComponentTypeCalibration: category=TOOL_CONFIGURED, RteCalibrationSupportEnabled=0
    BswInstance_DataLog (RteBswModuleInstance): RteBswImplementationRef=BswImplementation_DataLog, RteBswModuleConfigurationRef=DataLog
      RteBswEventToTaskMapping_BswTE_DataLog_MainFunction (RteBswEventToTaskMapping):
        RteBswPositionInTask = 0
        RteBswImmediateRestart = 0
        RteBswEventRef = BswTE_DataLog_MainFunction
        RteBswMappedToTaskRef = OsTask_BSW_FG1_100ms
        RteBswUsedOsAlarmRef = OsAlarm_BSW_100ms
      RteBswExclusiveAreaImpl_DATA_PROTECTION (RteBswExclusiveAreaImpl):
        SchMDisableMacroName = RteBswExclusiveAreaImpl_DATA_PROTECTION
        RteExclusiveAreaImplMechanism = ALL_INTERRUPT_BLOCKING
        RteBswExclusiveAreaRef = DATA_PROTECTION
      RteBswRequiredModeGroupConnection_DataLog_EM_R (RteBswRequiredModeGroupConnection): RteBswProvidedModeGroupRef=modeSwitchPort_EcuMode, RteBswRequiredModeGroupRef=DataLog_EM_R, RteBswProvidedModeGrpModInstRef=BswInstance_BswM
    SwcInstance_SWC_NvM (RteSwComponentInstance): category=TOOL_CONFIGURED, RteSoftwareComponentInstanceRef=SWC_NvM
      24 x RteEventToTaskMapping, all with category=TOOL_CONFIGURED, RteImmediateRestart=0:
        RteEventToTaskMapping_TE_RE_NvM_10ms_Process: RtePositionInTask=2, RteMappedToTaskRef=OsTask_ASW_FG1_10ms, RteUsedOsAlarmRef=OsAlarm_ASW_10ms, RteEventRef=TE_RE_NvM_10ms_Process
        RteEventToTaskMapping_OIE_RE_NvMJobFinished_DTCInfo_PNJF_NvMBlock_DTCInfo_JobFinished: RteEventRef=OIE_RE_NvMJobFinished_DTCInfo_PNJF_NvMBlock_DTCInfo_JobFinished
        RteEventToTaskMapping_OIE_RE_NvMJobFinished_Function_PNJF_NvMBlock_Function_JobFinished: RteEventRef=OIE_RE_NvMJobFinished_Function_PNJF_NvMBlock_Function_JobFinished
        RteEventToTaskMapping_OIE_Runnable2_PNJF_NvMBlock_MDate_JobFinished: RteEventRef=OIE_Runnable2_PNJF_NvMBlock_MDate_JobFinished
        RteEventToTaskMapping_OIE_Runnable3_PNJF_NvMBlock_Option_JobFinished: RteEventRef=OIE_Runnable3_PNJF_NvMBlock_Option_JobFinished
        RteEventToTaskMapping_OIE_Runnable4_PNJF_NvMBlock_PartNO_JobFinished: RteEventRef=OIE_Runnable4_PNJF_NvMBlock_PartNO_JobFinished
        RteEventToTaskMapping_OIE_Runnable5_PNJF_NvMBlock_SerialNO_JobFinished: RteEventRef=OIE_Runnable5_PNJF_NvMBlock_SerialNO_JobFinished
        RteEventToTaskMapping_OIE_Runnable6_PNJF_NvMBlock_Dummy_JobFinished: RteEventRef=OIE_Runnable6_PNJF_NvMBlock_Dummy_JobFinished
        RteEventToTaskMapping_OIE_RE_ReadEep_PartNO_P_ReadEep_PartNO_ReadEep: RteEventRef=OIE_RE_ReadEep_PartNO_P_ReadEep_PartNO_ReadEep
        RteEventToTaskMapping_OIE_RE_WriteEep_PartNO_P_WriteEep_PartNO_WriteEep: RteEventRef=OIE_RE_WriteEep_PartNO_P_WriteEep_PartNO_WriteEep
        RteEventToTaskMapping_OIE_RE_Set_EepromData_PartNO_P_PartNOEeprom_Set: RteEventRef=OIE_RE_Set_EepromData_PartNO_P_PartNOEeprom_Set
        RteEventToTaskMapping_OIE_RE_Get_EepromData_PartNO_P_PartNOEeprom_Get: RteEventRef=OIE_RE_Get_EepromData_PartNO_P_PartNOEeprom_Get
        RteEventToTaskMapping_OIE_RE_Set_EepromData_DTCInfo_P_DTCInfoEeprom_Set: RteEventRef=OIE_RE_Set_EepromData_DTCInfo_P_DTCInfoEeprom_Set
        RteEventToTaskMapping_OIE_RE_Set_EepromData_Function_P_FunctionEeprom_Set: RteEventRef=OIE_RE_Set_EepromData_Function_P_FunctionEeprom_Set
        RteEventToTaskMapping_OIE_RE_Set_EepromData_MDate_P_MDateEeprom_Set: RteEventRef=OIE_RE_Set_EepromData_MDate_P_MDateEeprom_Set
        RteEventToTaskMapping_OIE_RE_Set_EepromData_Option_P_OptionEeprom_Set: RteEventRef=OIE_RE_Set_EepromData_Option_P_OptionEeprom_Set
        RteEventToTaskMapping_OIE_RE_Set_EepromData_SerialNO_P_SerialNOEeprom_Set: RteEventRef=OIE_RE_Set_EepromData_SerialNO_P_SerialNOEeprom_Set
        RteEventToTaskMapping_OIE_RE_Set_EepromData_Dummy_P_DummyEeprom_Set: RteEventRef=OIE_RE_Set_EepromData_Dummy_P_DummyEeprom_Set
        RteEventToTaskMapping_OIE_RE_Get_EepromData_DTCInfo_P_DTCInfoEeprom_Get: RteEventRef=OIE_RE_Get_EepromData_DTCInfo_P_DTCInfoEeprom_Get
        RteEventToTaskMapping_OIE_RE_Get_EepromData_Function_P_FunctionEeprom_Get: RteEventRef=OIE_RE_Get_EepromData_Function_P_FunctionEeprom_Get
        RteEventToTaskMapping_OIE_RE_Get_EepromData_MDate_P_MDateEeprom_Get: RteEventRef=OIE_RE_Get_EepromData_MDate_P_MDateEeprom_Get
        RteEventToTaskMapping_OIE_RE_Get_EepromData_Opton_P_OptionEeprom_Get: RteEventRef=OIE_RE_Get_EepromData_Opton_P_OptionEeprom_Get
        RteEventToTaskMapping_OIE_RE_Get_EepromData_SerialNO_P_SerialNOEeprom_Get: RteEventRef=OIE_RE_Get_EepromData_SerialNO_P_SerialNOEeprom_Get
        RteEventToTaskMapping_OIE_RE_Get_EepromData_Dummy_P_DummyEeprom_Get: RteEventRef=OIE_RE_Get_EepromData_Dummy_P_DummyEeprom_Get
    RteSwComponentType_SWC_NvM (RteSwComponentType): RteComponentTypeRef=SWC_NvM
      RteComponentTypeCalibration: category=TOOL_CONFIGURED, RteCalibrationSupportEnabled=0
    SwcInstance_SWC_Input (RteSwComponentInstance): category=TOOL_CONFIGURED, RteSoftwareComponentInstanceRef=SWC_Input
      42 x RteEventToTaskMapping, all with category=TOOL_CONFIGURED, RteImmediateRestart=0:
        RteEventToTaskMapping_ETOE_RE_Input_10ms_Process_R_RE_Input_10ms_Input_10ms_Process: RtePositionInTask=0, RteMappedToTaskRef=OsTask_ASW_TaskEvent_10ms_NP0, RteEventRef=ETOE_RE_Input_10ms_Process_R_RE_Input_10ms_Input_10ms_Process
        RteEventToTaskMapping_OIE_RE_SwInput_P_SwInput_CS: RteEventRef=OIE_RE_SwInput_P_SwInput_CS
        RteEventToTaskMapping_DRE_RE_BCAN_HU_USM_E_02_BCAN_HU_USM_E_02_CF_Gway_RWPCNValueSet: RtePositionInTask=9, RteMappedToTaskRef=OsTask_ASW_FG1_BCanCbkRx, RteUsedOsEventRef=OsEvent_BCAN_DRE_10, RteEventRef=DRE_RE_BCAN_HU_USM_E_02_BCAN_HU_USM_E_02_CF_Gway_RWPCNValueSet
        RteEventToTaskMapping_DRE_RE_BCAN_ATS_00_00ms_BCAN_ATS_00_00ms_ATS_RWPC_RWPCNValueSet: RtePositionInTask=0, RteMappedToTaskRef=OsTask_ASW_FG1_BCanCbkRx, RteUsedOsEventRef=OsEvent_BCAN_DRE_01, RteEventRef=DRE_RE_BCAN_ATS_00_00ms_BCAN_ATS_00_00ms_ATS_RWPC_RWPCNValueSet
        RteEventToTaskMapping0: RtePositionInTask=1, RteMappedToTaskRef=OsTask_ASW_FG1_BCanCbkRx, RteUsedOsEventRef=OsEvent_BCAN_DRE_02, RteEventRef=DRE_RE_BCAN_BCM_07_200ms_BCAN_BCM_07_200ms_Lamp_IntTailLmpOnReq
        RteEventToTaskMapping1: RtePositionInTask=2, RteMappedToTaskRef=OsTask_ASW_FG1_BCanCbkRx, RteUsedOsEventRef=OsEvent_BCAN_DRE_03, RteEventRef=DRE_RE_BCAN_BCM_12_200ms_BCAN_BCM_12_200ms_BCM_SmkOptTyp
        RteEventToTaskMapping3: RtePositionInTask=3, RteMappedToTaskRef=OsTask_ASW_FG1_BCanCbkRx, RteUsedOsEventRef=OsEvent_BCAN_DRE_04, RteEventRef=DRE_RE_BCAN_CLU_01_20ms_1_BCAN_CLU_01_20ms_1_CLU_DtntOutSta
        RteEventToTaskMapping4: RtePositionInTask=4, RteMappedToTaskRef=OsTask_ASW_FG1_BCanCbkRx, RteUsedOsEventRef=OsEvent_BCAN_DRE_05, RteEventRef=DRE_RE_BCAN_CLU_01_20ms_2_BCAN_CLU_01_20ms_2_CLU_AutoBrightSta
        RteEventToTaskMapping5: RtePositionInTask=5, RteMappedToTaskRef=OsTask_ASW_FG1_BCanCbkRx, RteUsedOsEventRef=OsEvent_BCAN_DRE_06, RteEventRef=DRE_RE_BCAN_EMS_02_10ms_1_BCAN_EMS_02_10ms_1_ENG_EngSta
        RteEventToTaskMapping6: RtePositionInTask=6, RteMappedToTaskRef=OsTask_ASW_FG1_BCanCbkRx, RteUsedOsEventRef=OsEvent_BCAN_DRE_07, RteEventRef=DRE_RE_BCAN_EMS_07_10ms_2_BCAN_EMS_07_10ms_2_HEV_EngOpSta
        RteEventToTaskMapping7: RtePositionInTask=7, RteMappedToTaskRef=OsTask_ASW_FG1_BCanCbkRx, RteUsedOsEventRef=OsEvent_BCAN_DRE_08, RteEventRef=DRE_RE_BCAN_HCU_03_10ms_2_BCAN_HCU_03_10ms_2_HCU_HevRdySta
        RteEventToTaskMapping8: RtePositionInTask=8, RteMappedToTaskRef=OsTask_ASW_FG1_BCanCbkRx, RteUsedOsEventRef=OsEvent_BCAN_DRE_09, RteEventRef=DRE_RE_BCAN_HU_GW_PE_01_BCAN_HU_GW_PE_01_CF_AVN_ProfileIDRValue
        RteEventToTaskMapping9: RtePositionInTask=10, RteMappedToTaskRef=OsTask_ASW_FG1_BCanCbkRx, RteUsedOsEventRef=OsEvent_BCAN_DRE_11, RteEventRef=DRE_RE_BCAN_HU_USM_E_04_BCAN_HU_USM_E_04_CF_AVN_CluUSMReset
        RteEventToTaskMapping10: RtePositionInTask=11, RteMappedToTaskRef=OsTask_ASW_FG1_BCanCbkRx, RteUsedOsEventRef=OsEvent_BCAN_DRE_12, RteEventRef=DRE_RE_BCAN_IAU_16_200ms_BCAN_IAU_16_200ms_IAU_ProfileIDRVal
        RteEventToTaskMapping11: RtePositionInTask=12, RteMappedToTaskRef=OsTask_ASW_FG1_BCanCbkRx, RteUsedOsEventRef=OsEvent_BCAN_DRE_13, RteEventRef=DRE_RE_BCAN_ICU_02_200ms_BCAN_ICU_02_200ms_Warn_AsstDrSwSta
        RteEventToTaskMapping12: RtePositionInTask=13, RteMappedToTaskRef=OsTask_ASW_FG1_BCanCbkRx, RteUsedOsEventRef=OsEvent_BCAN_DRE_14, RteEventRef=DRE_RE_BCAN_SBCM_AST_02_200ms_BCAN_SBCM_AST_02_200ms_Warn_AsstDrSwSta_SBCM
        RteEventToTaskMapping13: RtePositionInTask=14, RteMappedToTaskRef=OsTask_ASW_FG1_BCanCbkRx, RteUsedOsEventRef=OsEvent_BCAN_DRE_15, RteEventRef=DRE_RE_BCAN_SBCM_DRV_01_200ms_BCAN_SBCM_DRV_01_200ms_Warn_DrvDrSwSta_SBCM
        RteEventToTaskMapping14: RtePositionInTask=15, RteMappedToTaskRef=OsTask_ASW_FG1_BCanCbkRx, RteUsedOsEventRef=OsEvent_BCAN_DRE_16, RteEventRef=DRE_RE_BCAN_SBCM_RL_01_200ms_BCAN_SBCM_RL_01_200ms_Warn_RrLftDrSwSta_SBCM
        RteEventToTaskMapping15: RtePositionInTask=16, RteMappedToTaskRef=OsTask_ASW_FG1_BCanCbkRx, RteUsedOsEventRef=OsEvent_BCAN_DRE_17, RteEventRef=DRE_RE_BCAN_SBCM_RR_01_200ms_BCAN_SBCM_RR_01_200ms_Warn_RrRtDrSwSta_SBCM
        RteEventToTaskMapping16: RtePositionInTask=17, RteMappedToTaskRef=OsTask_ASW_FG1_BCanCbkRx, RteUsedOsEventRef=OsEvent_BCAN_DRE_18, RteEventRef=DRE_RE_BCAN_SMK_06_200ms_BCAN_SMK_06_200ms_LFAnt_SrchSta
        RteEventToTaskMapping17: RtePositionInTask=18, RteMappedToTaskRef=OsTask_ASW_FG1_BCanCbkRx, RteUsedOsEventRef=OsEvent_BCAN_DRE_19, RteEventRef=DRE_RE_BCAN_VCU_01_10ms_1_BCAN_VCU_01_10ms_1_VCU_EvDrvRdySta
        RteEventToTaskMapping2: RtePositionInTask=0, RteMappedToTaskRef=OsTask_ASW_FG1_BCanCbkRxTOut, RteUsedOsEventRef=OsEvent_BCAN_DREE_01, RteEventRef=DREE_RE_BCAN_BCM_07_200ms_Timeout_BCAN_BCM_07_200ms_Lamp_IntTailLmpOnReq
        RteEventToTaskMapping18: RtePositionInTask=1, RteMappedToTaskRef=OsTask_ASW_FG1_BCanCbkRxTOut, RteUsedOsEventRef=OsEvent_BCAN_DREE_02, RteEventRef=DREE_RE_BCAN_BCM_12_200ms_Timeout_BCAN_BCM_12_200ms_BCM_SmkOptTyp
        RteEventToTaskMapping19: RtePositionInTask=2, RteMappedToTaskRef=OsTask_ASW_FG1_BCanCbkRxTOut, RteUsedOsEventRef=OsEvent_BCAN_DREE_03, RteEventRef=DREE_RE_BCAN_CLU_01_20ms_1_Timeout_BCAN_CLU_01_20ms_1_CLU_DtntOutSta
        RteEventToTaskMapping20: RtePositionInTask=3, RteMappedToTaskRef=OsTask_ASW_FG1_BCanCbkRxTOut, RteUsedOsEventRef=OsEvent_BCAN_DREE_04, RteEventRef=DREE_RE_BCAN_CLU_01_20ms_2_Timeout_BCAN_CLU_01_20ms_2_CLU_AutoBrightSta
        RteEventToTaskMapping21: RtePositionInTask=4, RteMappedToTaskRef=OsTask_ASW_FG1_BCanCbkRxTOut, RteUsedOsEventRef=OsEvent_BCAN_DREE_05, RteEventRef=DREE_RE_BCAN_EMS_02_10ms_1_Timeout_BCAN_EMS_02_10ms_1_ENG_EngSta
        RteEventToTaskMapping22: RtePositionInTask=5, RteMappedToTaskRef=OsTask_ASW_FG1_BCanCbkRxTOut, RteUsedOsEventRef=OsEvent_BCAN_DREE_06, RteEventRef=DREE_RE_BCAN_EMS_07_10ms_2_Timeout_BCAN_EMS_07_10ms_2_HEV_EngOpSta
        RteEventToTaskMapping23: RtePositionInTask=6, RteMappedToTaskRef=OsTask_ASW_FG1_BCanCbkRxTOut, RteUsedOsEventRef=OsEvent_BCAN_DREE_07, RteEventRef=DREE_RE_BCAN_HCU_03_10ms_2_Timeout_BCAN_HCU_03_10ms_2_HCU_HevRdySta
        RteEventToTaskMapping24: RtePositionInTask=7, RteMappedToTaskRef=OsTask_ASW_FG1_BCanCbkRxTOut, RteUsedOsEventRef=OsEvent_BCAN_DREE_08, RteEventRef=DREE_RE_BCAN_HU_GW_PE_01_Timeout_BCAN_HU_GW_PE_01_CF_AVN_ProfileIDRValue
        RteEventToTaskMapping25: RtePositionInTask=8, RteMappedToTaskRef=OsTask_ASW_FG1_BCanCbkRxTOut, RteUsedOsEventRef=OsEvent_BCAN_DREE_09, RteEventRef=DREE_RE_BCAN_IAU_16_200ms_Timeout_BCAN_IAU_16_200ms_IAU_ProfileIDRVal
        RteEventToTaskMapping26: RtePositionInTask=9, RteMappedToTaskRef=OsTask_ASW_FG1_BCanCbkRxTOut, RteUsedOsEventRef=OsEvent_BCAN_DREE_10, RteEventRef=DREE_RE_BCAN_ICU_02_200ms_Timeout_BCAN_ICU_02_200ms_Warn_AsstDrSwSta
        RteEventToTaskMapping27: RtePositionInTask=10, RteMappedToTaskRef=OsTask_ASW_FG1_BCanCbkRxTOut, RteUsedOsEventRef=OsEvent_BCAN_DREE_11, RteEventRef=DREE_RE_BCAN_SBCM_AST_02_200ms_Timeout_BCAN_SBCM_AST_02_200ms_Warn_AsstDrSwSta_SBCM
        RteEventToTaskMapping28: RtePositionInTask=11, RteMappedToTaskRef=OsTask_ASW_FG1_BCanCbkRxTOut, RteUsedOsEventRef=OsEvent_BCAN_DREE_12, RteEventRef=DREE_RE_BCAN_SBCM_DRV_01_200ms_Timeout_BCAN_SBCM_DRV_01_200ms_Warn_DrvDrSwSta_SBCM
        RteEventToTaskMapping29: RtePositionInTask=12, RteMappedToTaskRef=OsTask_ASW_FG1_BCanCbkRxTOut, RteUsedOsEventRef=OsEvent_BCAN_DREE_13, RteEventRef=DREE_RE_BCAN_SBCM_RL_01_200ms_Timeout_BCAN_SBCM_RL_01_200ms_Warn_RrLftDrSwSta_SBCM
        RteEventToTaskMapping30: RtePositionInTask=13, RteMappedToTaskRef=OsTask_ASW_FG1_BCanCbkRxTOut, RteUsedOsEventRef=OsEvent_BCAN_DREE_14, RteEventRef=DREE_RE_BCAN_SBCM_RR_01_200ms_Timeout_BCAN_SBCM_RR_01_200ms_Warn_RrRtDrSwSta_SBCM
        RteEventToTaskMapping31: RtePositionInTask=14, RteMappedToTaskRef=OsTask_ASW_FG1_BCanCbkRxTOut, RteUsedOsEventRef=OsEvent_BCAN_DREE_15, RteEventRef=DREE_RE_BCAN_SMK_06_200ms_Timeout_BCAN_SMK_06_200ms_LFAnt_SrchSta
        RteEventToTaskMapping32: RtePositionInTask=15, RteMappedToTaskRef=OsTask_ASW_FG1_BCanCbkRxTOut, RteUsedOsEventRef=OsEvent_BCAN_DREE_16, RteEventRef=DREE_RE_BCAN_VCU_01_10ms_1_Timeout_BCAN_VCU_01_10ms_1_VCU_EvDrvRdySta
        RteEventToTaskMapping33: RtePositionInTask=19, RteMappedToTaskRef=OsTask_ASW_FG1_BCanCbkRx, RteUsedOsEventRef=OsEvent_BCAN_DRE_20, RteEventRef=DRE_RE_BCAN_WPC_01_200ms_BCAN_WPC_01_200ms_WPC_IndSyncVal
        RteEventToTaskMapping34: RtePositionInTask=20, RteMappedToTaskRef=OsTask_ASW_FG1_BCanCbkRx, RteUsedOsEventRef=OsEvent_BCAN_DRE_21, RteEventRef=DRE_RE_BCAN_WPC2_01_200ms_BCAN_WPC2_01_200ms_WPC2_IndSyncVal
        RteEventToTaskMapping35: RtePositionInTask=16, RteMappedToTaskRef=OsTask_ASW_FG1_BCanCbkRxTOut, RteUsedOsEventRef=OsEvent_BCAN_DREE_17, RteEventRef=DREE_RE_BCAN_WPC_01_200ms_Timeout_BCAN_WPC_01_200ms_WPC_IndSyncVal
        RteEventToTaskMapping36: RtePositionInTask=17, RteMappedToTaskRef=OsTask_ASW_FG1_BCanCbkRxTOut, RteUsedOsEventRef=OsEvent_BCAN_DREE_18, RteEventRef=DREE_RE_BCAN_WPC2_01_200ms_Timeout_BCAN_WPC2_01_200ms_WPC2_IndSyncVal
        RteEventToTaskMapping_DRE_RE_BCAN_HU_UMS_E_14_BCAN_HU_USM_E_14_CF_Gway_WPCAnimationNvalueSet: RtePositionInTask=21, RteMappedToTaskRef=OsTask_ASW_FG1_BCanCbkRx, RteUsedOsEventRef=OsEvent_BCAN_DRE_22, RteEventRef=DRE_RE_BCAN_HU_UMS_E_14_BCAN_HU_USM_E_14_CF_Gway_WPCAnimationNvalueSet
    RteSwComponentType_SWC_Input (RteSwComponentType): RteComponentTypeRef=SWC_Input
      RteComponentTypeCalibration: category=TOOL_CONFIGURED, RteCalibrationSupportEnabled=0
    SwcInstance_SWC_Output (RteSwComponentInstance): category=TOOL_CONFIGURED, RteSoftwareComponentInstanceRef=SWC_Output
      RteEventToTaskMapping_ETOE_RE_Output_10ms_Process_R_RE_Output_10ms_Output_10ms_Process (RteEventToTaskMapping):
        category = TOOL_CONFIGURED
        RteImmediateRestart = 0
        RtePositionInTask = 0
        RteMappedToTaskRef = OsTask_ASW_TaskEvent_10ms_NP1
        RteEventRef = ETOE_RE_Output_10ms_Process_R_RE_Output_10ms_Output_10ms_Process
      RteEventToTaskMapping_OIE_RE_Start_WPCDiagState_P_Start_WPCDiagState_CS (RteEventToTaskMapping): category=TOOL_CONFIGURED, RteImmediateRestart=0, RteEventRef=OIE_RE_Start_WPCDiagState_P_Start_WPCDiagState_CS
    RteSwComponentType_SWC_Output (RteSwComponentType): RteComponentTypeRef=SWC_Output
      RteComponentTypeCalibration: category=TOOL_CONFIGURED, RteCalibrationSupportEnabled=0
    SwcInstance_SWC_Task (RteSwComponentInstance): category=TOOL_CONFIGURED, RteSoftwareComponentInstanceRef=SWC_Task
      RteEventToTaskMapping_TE_RE_ASW_10ms_TASK (RteEventToTaskMapping):
        category = TOOL_CONFIGURED
        RteImmediateRestart = 0
        RtePositionInTask = 4
        RteMappedToTaskRef = OsTask_ASW_FG1_10ms
        RteUsedOsAlarmRef = OsAlarm_ASW_10ms
        RteEventRef = TE_RE_ASW_10ms_TASK
      3 x RteExternalTriggerConfig, all with category=TOOL_CONFIGURED, RteTriggerSourceQueueLength=0:
        Input_10ms_Process: RteSwcTriggerSourceRef=Input_10ms_Process
        Output_10ms_Process: RteSwcTriggerSourceRef=Output_10ms_Process
        WPC_Process_10ms: RteSwcTriggerSourceRef=WPC_Process_10ms
      RteEventToTaskMapping0 (RteEventToTaskMapping):
        category = TOOL_CONFIGURED
        RtePositionInTask = 0
        RteImmediateRestart = 0
        RteMappedToTaskRef = OsTask_ASW_FG1_5ms
        RteUsedOsAlarmRef = OsAlarm_ASW_5ms
        RteEventRef = TE_RE_ASW_5ms_TASK
      P9450_Update_5ms (RteExternalTriggerConfig): category=TOOL_CONFIGURED, RteTriggerSourceQueueLength=0, RteSwcTriggerSourceRef=P9450_Update_5ms
      StandardTrigger_5ms_NP3 (RteExternalTriggerConfig): category=TOOL_CONFIGURED, RteTriggerSourceQueueLength=0, RteSwcTriggerSourceRef=StandardTrigger_5ms_NP3
    RteSwComponentType_SWC_Task (RteSwComponentType): RteComponentTypeRef=SWC_Task
      RteComponentTypeCalibration: category=TOOL_CONFIGURED, RteCalibrationSupportEnabled=0
    SwcInstance_CDD_NFCIC (RteSwComponentInstance): category=TOOL_CONFIGURED, RteSoftwareComponentInstanceRef=CDD_NFCIC
      RteEventToTaskMapping_OIE_RE_IcuSignalEdgeDetection_NFC_INTERRUPT_P_Icu_NFC_INTERRUPT_Cbk_Notification (RteEventToTaskMapping): category=TOOL_CONFIGURED, RteImmediateRestart=0, RteEventRef=OIE_RE_IcuSignalEdgeDetection_NFC_INTERRUPT_P_Icu_NFC_INTERRUPT_Cbk_Notification
      RteEventToTaskMapping_OIE_RE_NFC_TickTimer_Cbk_P_Gpt_NFC_TickTimer_Cbk_Notification (RteEventToTaskMapping): category=TOOL_CONFIGURED, RteImmediateRestart=0, RteEventRef=OIE_RE_NFC_TickTimer_Cbk_P_Gpt_NFC_TickTimer_Cbk_Notification
    RteSwComponentType_CDD_NFCIC (RteSwComponentType): RteComponentTypeRef=CDD_NFCIC
      RteComponentTypeCalibration: category=TOOL_CONFIGURED, RteCalibrationSupportEnabled=0
    SwcInstance_SWC_WPC_Process (RteSwComponentInstance): category=TOOL_CONFIGURED, RteSoftwareComponentInstanceRef=SWC_WPC_Process
      45 x RteEventToTaskMapping, all with category=TOOL_CONFIGURED, RteImmediateRestart=0:
        RteEventToTaskMapping0: RtePositionInTask=0, RteMappedToTaskRef=OsTask_ASW_TaskEvent_10ms_NP2, RteEventRef=ETOE_RE_WPC_Process_R_RE_WPC_Process_10ms_WPC_Process_10ms
        RteEventToTaskMapping_OIE_RE_VehicleManufacturerSparePartNumberDataIdentifier_0xF187_DataServices_VehicleManufacturerSparePartNumberDataIdentifier_0xF187_ReadData: RteEventRef=OIE_RE_VehicleManufacturerSparePartNumberDataIdentifier_0xF187_DataServices_VehicleManufacturerSparePartNumberDataIdentifier_0xF187_ReadData
        RteEventToTaskMapping_OIE_RE_VehicleManufacturerSparePartNumberDataIdentifier_0xF187_CC_DataServices_VehicleManufacturerSparePartNumberDataIdentifier_0xF187_ConditionCheckRead: RteEventRef=OIE_RE_VehicleManufacturerSparePartNumberDataIdentifier_0xF187_CC_DataServices_VehicleManufacturerSparePartNumberDataIdentifier_0xF187_ConditionCheckRead
        RteEventToTaskMapping_OIE_RE_ECUManufacturingDateDataIdentifier_0xF18B_DataServices_ECUManufacturingDateDataIdentifier_0xF18B_ReadData: RteEventRef=OIE_RE_ECUManufacturingDateDataIdentifier_0xF18B_DataServices_ECUManufacturingDateDataIdentifier_0xF18B_ReadData
        RteEventToTaskMapping_OIE_RE_ECUManufacturingDateDataIdentifier_0xF18B_CC_DataServices_ECUManufacturingDateDataIdentifier_0xF18B_ConditionCheckRead: RteEventRef=OIE_RE_ECUManufacturingDateDataIdentifier_0xF18B_CC_DataServices_ECUManufacturingDateDataIdentifier_0xF18B_ConditionCheckRead
        RteEventToTaskMapping_OIE_RE_ECUSerialNumberDataIdentifier_0xF18C_DataServices_ECUSerialNumberDataIdentifier_0xF18C_ReadData: RteEventRef=OIE_RE_ECUSerialNumberDataIdentifier_0xF18C_DataServices_ECUSerialNumberDataIdentifier_0xF18C_ReadData
        RteEventToTaskMapping_OIE_RE_ECUSerialNumberDataIdentifier_0xF18C_CC_DataServices_ECUSerialNumberDataIdentifier_0xF18C_ConditionCheckRead: RteEventRef=OIE_RE_ECUSerialNumberDataIdentifier_0xF18C_CC_DataServices_ECUSerialNumberDataIdentifier_0xF18C_ConditionCheckRead
        RteEventToTaskMapping_OIE_RE_ECUSupplierCodeDataIdentifier_0xF1A1_DataServices_ECUSupplierCodeDataIdentifier_0xF1A1_ReadData: RteEventRef=OIE_RE_ECUSupplierCodeDataIdentifier_0xF1A1_DataServices_ECUSupplierCodeDataIdentifier_0xF1A1_ReadData
        RteEventToTaskMapping_OIE_RE_ECUSupplierCodeDataIdentifier_0xF1A1_CC_DataServices_ECUSupplierCodeDataIdentifier_0xF1A1_ConditionCheckRead: RteEventRef=OIE_RE_ECUSupplierCodeDataIdentifier_0xF1A1_CC_DataServices_ECUSupplierCodeDataIdentifier_0xF1A1_ConditionCheckRead
        RteEventToTaskMapping_OIE_RE_ECUSoftwareUNITnumberDataIdentifier_0xF1B0_DataServices_ECUSoftwareUNITnumberDataIdentifier_0xF1B0_ReadData: RteEventRef=OIE_RE_ECUSoftwareUNITnumberDataIdentifier_0xF1B0_DataServices_ECUSoftwareUNITnumberDataIdentifier_0xF1B0_ReadData
        RteEventToTaskMapping_OIE_RE_ECUSoftwareUNITnumberDataIdentifier_0xF1B0_CC_DataServices_ECUSoftwareUNITnumberDataIdentifier_0xF1B0_ConditionCheckRead: RteEventRef=OIE_RE_ECUSoftwareUNITnumberDataIdentifier_0xF1B0_CC_DataServices_ECUSoftwareUNITnumberDataIdentifier_0xF1B0_ConditionCheckRead
        RteEventToTaskMapping_OIE_RE_ECUSoftwareUNIT1VersionDataIdentifier_0xF1B1_DataServices_ECUSoftwareUNIT1VersionDataIdentifier_0xF1B1_ReadData: RteEventRef=OIE_RE_ECUSoftwareUNIT1VersionDataIdentifier_0xF1B1_DataServices_ECUSoftwareUNIT1VersionDataIdentifier_0xF1B1_ReadData
        RteEventToTaskMapping_OIE_RE_ECUSoftwareUNIT1VersionDataIdentifier_0xF1B1_CC_DataServices_ECUSoftwareUNIT1VersionDataIdentifier_0xF1B1_ConditionCheckRead: RteEventRef=OIE_RE_ECUSoftwareUNIT1VersionDataIdentifier_0xF1B1_CC_DataServices_ECUSoftwareUNIT1VersionDataIdentifier_0xF1B1_ConditionCheckRead
        RteEventToTaskMapping_OIE_RE_VehicleManufacturerECUHardwareNumberDataIdentifier_0xF191_DataServices_VehicleManufacturerECUHardwareNumberDataIdentifier_0xF191_ReadData: RteEventRef=OIE_RE_VehicleManufacturerECUHardwareNumberDataIdentifier_0xF191_DataServices_VehicleManufacturerECUHardwareNumberDataIdentifier_0xF191_ReadData
        RteEventToTaskMapping_OIE_RE_VehicleManufacturerECUHardwareNumberDataIdentifier_0xF191_CC_DataServices_VehicleManufacturerECUHardwareNumberDataIdentifier_0xF191_ConditionCheckRead: RteEventRef=OIE_RE_VehicleManufacturerECUHardwareNumberDataIdentifier_0xF191_CC_DataServices_VehicleManufacturerECUHardwareNumberDataIdentifier_0xF191_ConditionCheckRead
        RteEventToTaskMapping_OIE_RE_SystemSupplierECUHardwareVersionNumberDataIdentifier_0xF193_DataServices_SystemSupplierECUHardwareVersionNumberDataIdentifier_0xF193_ReadData: RteEventRef=OIE_RE_SystemSupplierECUHardwareVersionNumberDataIdentifier_0xF193_DataServices_SystemSupplierECUHardwareVersionNumberDataIdentifier_0xF193_ReadData
        RteEventToTaskMapping_OIE_RE_SystemSupplierECUHardwareVersionNumberDataIdentifier_0xF193_CC_DataServices_SystemSupplierECUHardwareVersionNumberDataIdentifier_0xF193_ConditionCheckRead: RteEventRef=OIE_RE_SystemSupplierECUHardwareVersionNumberDataIdentifier_0xF193_CC_DataServices_SystemSupplierECUHardwareVersionNumberDataIdentifier_0xF193_ConditionCheckRead
        RteEventToTaskMapping_OIE_RE_CANDataBaseVersionNumberDataIdentifier_0xF100_DataServices_CANDataBaseVersionNumberDataIdentifier_0xF100_ReadData: RteEventRef=OIE_RE_CANDataBaseVersionNumberDataIdentifier_0xF100_DataServices_CANDataBaseVersionNumberDataIdentifier_0xF100_ReadData
        RteEventToTaskMapping_OIE_RE_CANDataBaseVersionNumberDataIdentifier_0xF100_CC_DataServices_CANDataBaseVersionNumberDataIdentifier_0xF100_ConditionCheckRead: RteEventRef=OIE_RE_CANDataBaseVersionNumberDataIdentifier_0xF100_CC_DataServices_CANDataBaseVersionNumberDataIdentifier_0xF100_ConditionCheckRead
        RteEventToTaskMapping_OIE_RE_ReadECUIdentificationLocalRXSWINDataIdentifier_0xF1EF_DataServices_ReadECUIdentificationLocalRXSWINDataIdentifier_0xF1EF_ReadData: RteEventRef=OIE_RE_ReadECUIdentificationLocalRXSWINDataIdentifier_0xF1EF_DataServices_ReadECUIdentificationLocalRXSWINDataIdentifier_0xF1EF_ReadData
        RteEventToTaskMapping_OIE_RE_ReadECUIdentificationLocalRXSWINDataIdentifier_0xF1EF_CC_DataServices_ReadECUIdentificationLocalRXSWINDataIdentifier_0xF1EF_ConditionCheckRead: RteEventRef=OIE_RE_ReadECUIdentificationLocalRXSWINDataIdentifier_0xF1EF_CC_DataServices_ReadECUIdentificationLocalRXSWINDataIdentifier_0xF1EF_ConditionCheckRead
        RteEventToTaskMapping_OIE_RE_ECUSoftwareUnit1IVDDataIdentifier_0xF1C1_DataServices_ECUSoftwareUnit1IVDDataIdentifier_0xF1C1_ReadData: RteEventRef=OIE_RE_ECUSoftwareUnit1IVDDataIdentifier_0xF1C1_DataServices_ECUSoftwareUnit1IVDDataIdentifier_0xF1C1_ReadData
        RteEventToTaskMapping_OIE_RE_ECUSoftwareUnit1IVDDataIdentifier_0xF1C1_CC_DataServices_ECUSoftwareUnit1IVDDataIdentifier_0xF1C1_ConditionCheckRead: RteEventRef=OIE_RE_ECUSoftwareUnit1IVDDataIdentifier_0xF1C1_CC_DataServices_ECUSoftwareUnit1IVDDataIdentifier_0xF1C1_ConditionCheckRead
        RteEventToTaskMapping_OIE_RE_WDBI_Factory_SerialNumber_0x12A3_DataServices_WDBI_Factory_SerialNumber_0x12A3_WriteData: RteEventRef=OIE_RE_WDBI_Factory_SerialNumber_0x12A3_DataServices_WDBI_Factory_SerialNumber_0x12A3_WriteData
        RteEventToTaskMapping_OIE_RE_WDBI_ManufacturingDate_0x12A4_DataServices_WDBI_ManufacturingDate_0x12A4_WriteData: RteEventRef=OIE_RE_WDBI_ManufacturingDate_0x12A4_DataServices_WDBI_ManufacturingDate_0x12A4_WriteData
        RteEventToTaskMapping_OIE_RE_UserOptionRecordLocalIdentifier_0xBE01_DataServices_UserOptionRecordLocalIdentifier_0xBE01_ReadData: RteEventRef=OIE_RE_UserOptionRecordLocalIdentifier_0xBE01_DataServices_UserOptionRecordLocalIdentifier_0xBE01_ReadData
        RteEventToTaskMapping_OIE_RE_UserOptionRecordLocalIdentifier_0xBE01_CC_DataServices_UserOptionRecordLocalIdentifier_0xBE01_ConditionCheckRead: RteEventRef=OIE_RE_UserOptionRecordLocalIdentifier_0xBE01_CC_DataServices_UserOptionRecordLocalIdentifier_0xBE01_ConditionCheckRead
        RteEventToTaskMapping_OIE_RE_InputOutputRecordLocalIdentifier_0xBE02_DataServices_InputOutputRecordLocalIdentifier_0xBE02_ReadData: RteEventRef=OIE_RE_InputOutputRecordLocalIdentifier_0xBE02_DataServices_InputOutputRecordLocalIdentifier_0xBE02_ReadData
        RteEventToTaskMapping_OIE_RE_InputOutputRecordLocalIdentifier_0xBE02_CC_DataServices_InputOutputRecordLocalIdentifier_0xBE02_ConditionCheckRead: RteEventRef=OIE_RE_InputOutputRecordLocalIdentifier_0xBE02_CC_DataServices_InputOutputRecordLocalIdentifier_0xBE02_ConditionCheckRead
        RteEventToTaskMapping_OIE_RE_InputOutputRecordLocalIdentifier_0xBE03_DataServices_InputOutputRecordLocalIdentifier_0xBE03_ReadData: RteEventRef=OIE_RE_InputOutputRecordLocalIdentifier_0xBE03_DataServices_InputOutputRecordLocalIdentifier_0xBE03_ReadData
        RteEventToTaskMapping_OIE_RE_InputOutputRecordLocalIdentifier_0xBE03_CC_DataServices_InputOutputRecordLocalIdentifier_0xBE03_ConditionCheckRead: RteEventRef=OIE_RE_InputOutputRecordLocalIdentifier_0xBE03_CC_DataServices_InputOutputRecordLocalIdentifier_0xBE03_ConditionCheckRead
        RteEventToTaskMapping_OIE_RE_ChargingECUSoftwareVersionMobase_0xF101_DataServices_ChargingECUSoftwareVersionMobase_0xF101_ReadData: RteEventRef=OIE_RE_ChargingECUSoftwareVersionMobase_0xF101_DataServices_ChargingECUSoftwareVersionMobase_0xF101_ReadData
        RteEventToTaskMapping_OIE_RE_ChargingECUSoftwareVersionMobase_0xF101_CC_DataServices_ChargingECUSoftwareVersionMobase_0xF101_ConditionCheckRead: RteEventRef=OIE_RE_ChargingECUSoftwareVersionMobase_0xF101_CC_DataServices_ChargingECUSoftwareVersionMobase_0xF101_ConditionCheckRead
        RteEventToTaskMapping_OIE_RE_ECUSoftwareInternalVersion_0xF189_DataServices_ECUSoftwareInternalVersion_0xF189_ReadData: RteEventRef=OIE_RE_ECUSoftwareInternalVersion_0xF189_DataServices_ECUSoftwareInternalVersion_0xF189_ReadData
        RteEventToTaskMapping_OIE_RE_ECUSoftwareInternalVersion_0xF189_CC_DataServices_ECUSoftwareInternalVersion_0xF189_ConditionCheckRead: RteEventRef=OIE_RE_ECUSoftwareInternalVersion_0xF189_CC_DataServices_ECUSoftwareInternalVersion_0xF189_ConditionCheckRead
        RteEventToTaskMapping_ETOE_RE_Hash_Calculation_function_R_Trg_Interface_5ms_NP3_StandardTrigger_5ms_NP3: RtePositionInTask=0, RteMappedToTaskRef=OsTask_ASW_TaskEvent_5ms_NP3, RteEventRef=ETOE_RE_Hash_Calculation_function_R_Trg_Interface_5ms_NP3_StandardTrigger_5ms_NP3
        RteEventToTaskMapping_OIE_RE_SystemName_0xF197_DataServices_SystemName_0xF197_ReadData: RteEventRef=OIE_RE_SystemName_0xF197_DataServices_SystemName_0xF197_ReadData
        RteEventToTaskMapping_OIE_RE_SystemName_0xF197_CC_DataServices_SystemName_0xF197_ConditionCheckRead: RteEventRef=OIE_RE_SystemName_0xF197_CC_DataServices_SystemName_0xF197_ConditionCheckRead
        RteEventToTaskMapping_OIE_RE_PlatformHardwareVersion_0xF17D_DataServices_PlatformHardwareVersion_0xF17D_ReadData: RteEventRef=OIE_RE_PlatformHardwareVersion_0xF17D_DataServices_PlatformHardwareVersion_0xF17D_ReadData
        RteEventToTaskMapping_OIE_RE_PlatformHardwareVersion_0xF17D_CC_DataServices_PlatformHardwareVersion_0xF17D_ConditionCheckRead: RteEventRef=OIE_RE_PlatformHardwareVersion_0xF17D_CC_DataServices_PlatformHardwareVersion_0xF17D_ConditionCheckRead
        RteEventToTaskMapping_OIE_RE_PlatformVersion_0xF17F_DataServices_PlatformVersion_0xF17F_ReadData: RteEventRef=OIE_RE_PlatformVersion_0xF17F_DataServices_PlatformVersion_0xF17F_ReadData
        RteEventToTaskMapping_OIE_RE_PlatformVersion_0xF17F_CC_DataServices_PlatformVersion_0xF17F_ConditionCheckRead: RteEventRef=OIE_RE_PlatformVersion_0xF17F_CC_DataServices_PlatformVersion_0xF17F_ConditionCheckRead
        RteEventToTaskMapping_OIE_RE_OTAReady_Start_0x0300_RoutineServices_RID_0300h_OTAReady_Start: RteEventRef=OIE_RE_OTAReady_Start_0x0300_RoutineServices_RID_0300h_OTAReady_Start
        RteEventToTaskMapping_OIE_RE_NonSleepCollectedEachEcuDataIdentifier_0xED90_DataServices_NonSleepCollectedEachEcuDataIdentifier_0xED90_ReadData: RteEventRef=OIE_RE_NonSleepCollectedEachEcuDataIdentifier_0xED90_DataServices_NonSleepCollectedEachEcuDataIdentifier_0xED90_ReadData
        RteEventToTaskMapping_OIE_RE_NonSleepCollectedEachEcuDataIdentifier_0xED90_CC_DataServices_NonSleepCollectedEachEcuDataIdentifier_0xED90_ConditionCheckRead: RteEventRef=OIE_RE_NonSleepCollectedEachEcuDataIdentifier_0xED90_CC_DataServices_NonSleepCollectedEachEcuDataIdentifier_0xED90_ConditionCheckRead
    RteSwComponentType_SWC_WPC_Process (RteSwComponentType): RteComponentTypeRef=SWC_WPC_Process
      RteComponentTypeCalibration: category=TOOL_CONFIGURED, RteCalibrationSupportEnabled=0
    SwcInstance_CDD_SLPWUP (RteSwComponentInstance): category=TOOL_CONFIGURED, RteSoftwareComponentInstanceRef=CDD_SLPWUP
      RteEventToTaskMapping_TE_RE_Slpwup_10ms_Task (RteEventToTaskMapping):
        category = TOOL_CONFIGURED
        RteImmediateRestart = 0
        RtePositionInTask = 5
        RteMappedToTaskRef = OsTask_ASW_FG1_10ms
        RteUsedOsAlarmRef = OsAlarm_ASW_10ms
        RteEventRef = TE_RE_Slpwup_10ms_Task
    RteSwComponentType_CDD_SLPWUP (RteSwComponentType): RteComponentTypeRef=CDD_SLPWUP
      RteComponentTypeCalibration: category=TOOL_CONFIGURED, RteCalibrationSupportEnabled=0
    SwcInstance_CDD_WPCIC (RteSwComponentInstance): category=TOOL_CONFIGURED, RteSoftwareComponentInstanceRef=CDD_WPCIC
    RteSwComponentType_CDD_WPCIC (RteSwComponentType): RteComponentTypeRef=CDD_WPCIC
      RteComponentTypeCalibration: category=TOOL_CONFIGURED, RteCalibrationSupportEnabled=0
    SwcInstance_SWC_P9450Update_Process (RteSwComponentInstance): category=TOOL_CONFIGURED, RteSoftwareComponentInstanceRef=SWC_P9450Update_Process
      RteEventToTaskMapping_ETOE_RE_P9450_Update_Process_R_RE_P9450_Update_Process_5ms_P9450_Update_5ms (RteEventToTaskMapping):
        category = TOOL_CONFIGURED
        RteImmediateRestart = 0
        RtePositionInTask = 0
        RteMappedToTaskRef = OsTask_ASW_TaskEvent_5ms_NP0
        RteEventRef = ETOE_RE_P9450_Update_Process_R_RE_P9450_Update_Process_5ms_P9450_Update_5ms
    RteSwComponentType_SWC_P9450Update_Process (RteSwComponentType): RteComponentTypeRef=SWC_P9450Update_Process
      RteComponentTypeCalibration: category=TOOL_CONFIGURED, RteCalibrationSupportEnabled=0
    SwcInstance_CDD_UDS (RteSwComponentInstance): category=TOOL_CONFIGURED, RteSoftwareComponentInstanceRef=CDD_UDS
    RteSwComponentType_CDD_UDS (RteSwComponentType): RteComponentTypeRef=CDD_UDS
      RteComponentTypeCalibration: category=TOOL_CONFIGURED, RteCalibrationSupportEnabled=0

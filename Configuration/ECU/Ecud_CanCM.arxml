AUTOSAR XML (schema 4-0-3)
package /AUTOSAR
  module config CanCM: implementation-config-variant=VARIANT-PRE-COMPILE, module-description=BswImplementation_CanCM
    CanCMGlobalConfig:
      CanCMDevErrorDetect = 1
      CanCMMainFunctionPeriod = 0.005
      CanCMVersionInfoApi = 0
      CanCMDemStatusReport = 1
      CanCMDisableDMOnAbnormalVoltage = 1
      CanCMFilteringConstant = 128
      CanCMWakeupSupport = 1
      CanCMHysteresisSupport = 1
    CanCMBatMonConfig_Main (CanCMBatMonConfig): CanCMAdcDefault=500, CanCMBatAnalogInputRef=AnaInDir_Battery_Real
    CanCMChannel_BCAN (CanCMChannelConfig):
      CanCMChannelId = 0
      CanCMVoltageHysteresis = 40
      CanCMNetworkActivationTime = 0.12
      CanCMVoltageErrorDelayTime = 0.10
      CanCMTimeoutMonitoringStartTime = 1
      CanCMVoltageAbnormalUpper = 3111
      CanCMVoltageAbnormalLower = 1683
      CanCMVoltageCriticalUpper = 3563
      CanCMVoltageCriticalLower = 1234
      CanCMComMChannelId = ComMChannel_BCAN
      CanCMDemEventParameterRefs: CANCM_E_BAT_FAIL=CANCM_E_BAT_FAIL
      CanCMWakeupParameterRefs: CanCMEcuMWakeupSourceRef=ECUM_WKSOURCE_BCAN_RX_POLL, CanCMIoHwAbWakeupPinNameRef=IoHwAbDigitalDirectLogical_BCAN_RX
    CanCMChannel_LOCALCAN (CanCMChannelConfig):
      CanCMChannelId = 1
      CanCMVoltageHysteresis = 40
      CanCMNetworkActivationTime = 0.12
      CanCMVoltageErrorDelayTime = 0.10
      CanCMTimeoutMonitoringStartTime = 1
      CanCMVoltageAbnormalUpper = 3111
      CanCMVoltageAbnormalLower = 1683
      CanCMVoltageCriticalUpper = 3563
      CanCMVoltageCriticalLower = 1234
      CanCMComMChannelId = ComMChannel_LOCALCAN
      CanCMDemEventParameterRefs: CANCM_E_BAT_FAIL=CANCM_E_BAT_FAIL
      CanCMWakeupParameterRefs: CanCMEcuMWakeupSourceRef=ECUM_WKSOURCE_LOCALCAN_RX_POLL, CanCMIoHwAbWakeupPinNameRef=IoHwAbDigitalDirectLogical_LOCALCAN_RX

AUTOSAR XML (schema 4-0-3)
package /Mcu
  module config Mcu: implementation-config-variant=VARIANT-POST-BUILD, module-description=McuImplementation
    McuGeneralConfiguration:
      McuDevErrorDetect = 1
      McuErrorCalloutFunction = Det_ReportError
      McuGetRamStateApi = 0
      McuInitClock = 1
      McuNoPll = 0
      McuPerformResetApi = 1
      McuSafetyFunctionApi = 1
      McuVersionInfoApi = 1
      McuIncludeFile = Det.h
    McuModuleConfiguration_0 (McuModuleConfiguration):
      McuClearResetReasonRegister = 1
      McuClockSrcFailureNotification = DISABLED
      McuEnableCacheFlushBeforeReset = 0
      McuEnableDefaultClock = 1
      McuForcedResetEnable = 1
      McuNumberOfMcuModes = 2
      McuRam0Macro{0..3}RetainBeforeReset = 1
      McuRam1RetainBeforeReset = 1
      McuRamSectors = 0
      McuResetFailureNotification = 0
      McuResetSelect = MCU_SW_RESET
      McuResetSetting = 1
      McuDefaultClockSetting = McuClockSettingConfig_0
      McuClockSettingConfig_0 (McuClockSettingConfig): McuClockSettingId=0, McuUnlockWatchdogEnable=1
        29 x McuClockReferencePoint:
          McuClockReferencePoint_IMO: McuClock=MCU_CLOCK_IMO, McuClockReferencePointFrequency=8.0E6
          McuClockReferencePoint_ECO: McuClock=MCU_CLOCK_ECO, McuClockReferencePointFrequency=16000000
          McuClockReferencePoint_ECO_PRESCALE: McuClock=MCU_CLOCK_ECO_PRESCALE, McuClockReferencePointFrequency=0.0
          McuClockReferencePoint_EXTCLK: McuClock=MCU_CLOCK_EXTCLK, McuClockReferencePointFrequency=8.0E6
          McuClockReferencePoint_ILO0: McuClock=MCU_CLOCK_ILO0, McuClockReferencePointFrequency=32768.0
          McuClockReferencePoint_ILO1: McuClock=MCU_CLOCK_ILO1, McuClockReferencePointFrequency=32768.0
          McuClockReferencePoint_WCO: McuClock=MCU_CLOCK_WCO, McuClockReferencePointFrequency=0.0
          McuClockReferencePoint_ALTHF: McuClock=MCU_CLOCK_ALTHF, McuClockReferencePointFrequency=0.0
          McuClockReferencePoint_ALTLF: McuClock=MCU_CLOCK_ALTLF, McuClockReferencePointFrequency=0.0
          McuClockReferencePoint_PLL0: McuClock=MCU_CLOCK_PLL0, McuClockReferencePointFrequency=160000000
          McuClockReferencePoint_PATH2: McuClock=MCU_CLOCK_PATH2, McuClockReferencePointFrequency=16000000
          McuClockReferencePoint_PATH3: McuClock=MCU_CLOCK_PATH3, McuClockReferencePointFrequency=16000000
          McuClockReferencePoint_ROOT0: McuClock=MCU_CLOCK_ROOT0, McuClockReferencePointFrequency=160000000
          McuClockReferencePoint_ROOT1: McuClock=MCU_CLOCK_ROOT1, McuClockReferencePointFrequency=0.0
          McuClockReferencePoint_ROOT2: McuClock=MCU_CLOCK_ROOT2, McuClockReferencePointFrequency=0.0
          McuClockReferencePoint_MMIO0: McuClock=MCU_PERI_GROUP0_MMIO0, McuClockReferencePointFrequency=80000000
          McuClockReferencePoint_MMIO{1..3}: McuClock=MCU_PERI_GROUP{1..3}_MMIO{1..3}, McuClockReferencePointFrequency=0.0
          McuClockReferencePoint_MMIO5: McuClock=MCU_PERI_GROUP5_MMIO5, McuClockReferencePointFrequency=0.0
          McuClockReferencePoint_MMIO6: McuClock=MCU_PERI_GROUP6_MMIO6, McuClockReferencePointFrequency=0.0
          McuClockReferencePoint_MMIO9: McuClock=MCU_PERI_GROUP9_MMIO9, McuClockReferencePointFrequency=0.0
          McuClockReferencePoint_LF: McuClock=MCU_CLOCK_LF, McuClockReferencePointFrequency=32768.0
          McuClockReferencePoint_FAST0: McuClock=MCU_CLOCK_FAST0, McuClockReferencePointFrequency=160000000
          McuClockReferencePoint_SLOW: McuClock=MCU_CLOCK_SLOW, McuClockReferencePointFrequency=80000000
          McuClockReferencePoint_PERI: McuClock=MCU_CLOCK_PERI, McuClockReferencePointFrequency=80000000
          McuClockReferencePoint_PASS0_CLOCK_SAR{0..2}: McuClock=MCU_PCLK_PASS0_CLOCK_SAR{0..2}, McuClockReferencePointFrequency=20000000
        McuClockSettings:
          McuCsvReferenceClock = MCU_CLOCK_IMO
          McuFast0ClockDivision = 1.0
          McuFast0ClockFrequency = 160000000
          McuFastRam0WaitCycle = 0
          McuFastRam1WaitCycle = 0
          McuFastRomWaitCycle = 0
          McuFlashWaitCycle = 1
          McuPclkEnableTimeout = 1
          McuPeriClockDivision = 2
          McuPeriClockFrequency = 80000000
          McuPeriGroupBusTransferTimeout = 65534
          McuSlowClockDivision = 1
          McuSlowClockFrequency = 80000000
          McuSlowRam0WaitCycle = 1
          McuSlowRam1WaitCycle = 1
          McuSlowRomWaitCycle = 1
          McuClockOutputSettings:
            McuClockOutput0Division = MCU_CLK_DIV_1
            McuClockOutput0Enable = 0
            McuClockOutput0Frequency = 0.0
            McuClockOutput0Source = MCU_CLOCK_PLL0
            McuClockOutput1Division = MCU_CLK_DIV_1
            McuClockOutput1Enable = 0
            McuClockOutput1Frequency = 0.0
            McuClockOutput1Source = MCU_CLOCK_LOW
          McuClockPathSettings_0 (McuClockPathSettings): McuClockPathFrequency=8000000.0, McuClockPathSource=MCU_CLOCK_IMO, McuClockPath=MCU_CLOCK_PATH2
          McuClockPathSettings_1 (McuClockPathSettings): McuClockPath=MCU_CLOCK_PATH3, McuClockPathFrequency=16000000.0, McuClockPathSource=MCU_CLOCK_ECO
          McuClockRootSettings_0 (McuClockRootSettings):
            McuClockRoot = MCU_CLOCK_ROOT0
            McuClockRootDivision = MCU_CLK_DIV_1
            McuClockRootEnable = 1
            McuClockRootFrequency = 160000000
            McuClockRootSource = MCU_CLOCK_PLL
            McuClockRootPllRef = McuPllSettings_0
          McuClockRootSettings_LPA (McuClockRootSettings):
            McuClockRoot = MCU_CLOCK_ROOT1
            McuClockRootEnable = 1
            McuClockRootFrequency = 8.0E6
            McuClockRootSource = MCU_CLOCK_PATH
            McuClockRootDivision = MCU_CLK_DIV_1
            McuClockRootPathRef = McuClockPathSettings_0
          McuCsvSettings_0 (McuCsvSettings):
            McuCsvAction = MCU_CSV_ACTION_FAULT
            McuCsvClock = MCU_CLOCK_CSVREF
            McuCsvEnable = 1
            McuCsvLowerLimit = 1
            McuCsvPeriod = 1
            McuCsvStartupDelay = 1
            McuCsvUpperLimit = 2
          McuLfClockSettings: McuLfClockFrequency=32768.0, McuLfClockSource=MCU_CLOCK_ILO0
          McuPclkGroupSettings_0 (McuPclkGroupSettings): McuPclkGroup=MCU_PCLK_GROUP0
            7 x McuPclkDividerSettings, all with McuPclkDividerEnable=1, McuPclkDividerStopForUpdate=1:
              McuPclkDividerSettings_1: McuPclkDividerIndex=0, McuPclkDividerType=MCU_PCLK_DIVIDER_8, McuPclkDividerValue=1
              McuPclkDividerSettings_4: McuPclkDividerType=MCU_PCLK_DIVIDER_8, McuPclkDividerIndex=1, McuPclkDividerValue=4
              McuPclkDividerSettings_3: McuPclkDividerIndex=2, McuPclkDividerValue=8, McuPclkDividerType=MCU_PCLK_DIVIDER_8
              McuPclkDividerSettings_2: McuPclkDividerIndex=3, McuPclkDividerType=MCU_PCLK_DIVIDER_8, McuPclkDividerValue=50
              McuPclkDividerSettings_0: McuPclkDividerIndex=4, McuPclkDividerType=MCU_PCLK_DIVIDER_8, McuPclkDividerValue=100
              McuPclkDividerSettings_5: McuPclkDividerType=MCU_PCLK_DIVIDER_24_5, McuPclkDividerIndex=5, McuPclkDividerValue=260.41
              McuPclkDividerSettings_6: McuPclkDividerType=MCU_PCLK_DIVIDER_16, McuPclkDividerIndex=6, McuPclkDividerValue=80
            20 x McuPclkSettings, all with McuPclkEnable=1:
              McuPclkSettings_PASS0_CLOCK_SAR{0..2}: McuPclk=MCU_PCLK_PASS0_CLOCK_SAR{0..2}, McuPclkFrequency=20000000, McuPclkDividerRef=McuPclkDividerSettings_4
              McuPclkSettings_CANFD0_CLOCK_CAN0: McuPclk=MCU_PCLK_CANFD0_CLOCK_CAN0, McuPclkFrequency=80000000, McuPclkDividerRef=McuPclkDividerSettings_1
              McuPclkSettings_CANFD0_CLOCK_CAN2: McuPclk=MCU_PCLK_CANFD0_CLOCK_CAN2, McuPclkFrequency=80000000, McuPclkDividerRef=McuPclkDividerSettings_1
              McuPclkSettings_TCPWM0_CLOCKS7: McuPclk=MCU_PCLK_TCPWM0_CLOCKS7, McuPclkFrequency=1000000, McuPclkDividerRef=McuPclkDividerSettings_6
              McuPclkSettings_TCPWM0_CLOCKS512: McuPclk=MCU_PCLK_TCPWM0_CLOCKS512, McuPclkFrequency=1000000, McuPclkDividerRef=McuPclkDividerSettings_6
              McuPclkSettings_TCPWM0_CLOCKS10: McuPclk=MCU_PCLK_TCPWM0_CLOCKS10, McuPclkFrequency=1000000, McuPclkDividerRef=McuPclkDividerSettings_6
              McuPclkSettings_TCPWM0_CLOCKS3: McuPclk=MCU_PCLK_TCPWM0_CLOCKS3, McuPclkFrequency=1000000, McuPclkDividerRef=McuPclkDividerSettings_6
              McuPclkSettings_TCPWM0_CLOCKS262: McuPclk=MCU_PCLK_TCPWM0_CLOCKS262, McuPclkFrequency=1000000, McuPclkDividerRef=McuPclkDividerSettings_6
              McuPclkSettings_TCPWM0_CLOCKS18: McuPclk=MCU_PCLK_TCPWM0_CLOCKS18, McuPclkFrequency=1000000, McuPclkDividerRef=McuPclkDividerSettings_6
              McuPclkSettings_TCPWM0_CLOCKS17: McuPclk=MCU_PCLK_TCPWM0_CLOCKS17, McuPclkFrequency=1000000, McuPclkDividerRef=McuPclkDividerSettings_6
              McuPclkSettings_SCB0_CLOCK: McuPclk=MCU_PCLK_SCB0_CLOCK, McuPclkFrequency=10000000, McuPclkDividerRef=McuPclkDividerSettings_3
              McuPclkSettings_TCPWM0_CLOCKS5: McuPclk=MCU_PCLK_TCPWM0_CLOCKS5, McuPclkFrequency=1000000, McuPclkDividerRef=McuPclkDividerSettings_6
              McuPclkSettings_TCPWM0_CLOCKS44: McuPclk=MCU_PCLK_TCPWM0_CLOCKS44, McuPclkFrequency=1000000, McuPclkDividerRef=McuPclkDividerSettings_6
              McuPclkSettings_TCPWM0_CLOCKS45: McuPclk=MCU_PCLK_TCPWM0_CLOCKS45, McuPclkFrequency=1000000, McuPclkDividerRef=McuPclkDividerSettings_6
              McuPclkSettings_TCPWM0_CLOCKS48: McuPclk=MCU_PCLK_TCPWM0_CLOCKS48, McuPclkFrequency=1000000, McuPclkDividerRef=McuPclkDividerSettings_6
              McuPclkSettings_TCPWM0_CLOCKS53: McuPclk=MCU_PCLK_TCPWM0_CLOCKS53, McuPclkFrequency=1000000, McuPclkDividerRef=McuPclkDividerSettings_6
              McuPclkSettings_TCPWM0_CLOCKS54: McuPclk=MCU_PCLK_TCPWM0_CLOCKS54, McuPclkFrequency=1000000, McuPclkDividerRef=McuPclkDividerSettings_6
              McuPclkSettings_SCB2_CLOCK: McuPclk=MCU_PCLK_SCB2_CLOCK, McuPclkFrequency=10000000, McuPclkDividerRef=McuPclkDividerSettings_3
          McuPeriGroupSettings_0 (McuPeriGroupSettings): McuPeriGroupClockFrequency=80000000, McuPeriGroup=MCU_PERI_GROUP0_MMIO0, McuPeriGroupClockDivision=2
            McuPeriGroupSlaveSettings_0 (McuPeriGroupSlaveSettings): McuPeriGroupSlaveEnable=1, McuPeriGroupSlaveName=MCU_PERI_GROUP0_SLAVE0_PERI
          McuPllSettings_0 (McuPllSettings):
            McuPllAutoDistributeEnable = 1
            McuPllAutoDistributeType = MCU_DISTRIBUTE_AFTER_LOCKED
            McuPllEnable = 1
            McuPllFeedbackDivision = 40
            McuPllFrequency = 160000000
            McuPllLockSensitivity = MCU_LOCK_SENSITIVITY_NORMAL
            McuPllOutputDivision = 2
            McuPllReferenceDivision = 2
            McuPllSource = MCU_CLOCK_ECO
            McuPllStopForUpdate = 1
            McuPllType = MCU_CLOCK_PLL0
        McuClocksIn: McuAlthfFrequency=0.0, McuAltlfFrequency=0.0, McuExtFrequency=8000000.0, McuImoEnable=1, McuImoFrequency=8000000.0
          McuEcoSettings: McuAgcEnable=0, McuEcoAmpStabilizationTimeout=1000000, McuEcoEnable=1, McuEcoFrequency=16000000
            McuEcoPrescalerSettings: McuEcoPrescaledFrequency=0.0, McuEcoPrescalerEnable=0, McuEcoPrescalerEnableTimeout=1, McuEcoPrescalerValue=1.0
            McuEcoTrimSettings:
              McuEcoAmplitudeTrimValue = MCU_ECO_AMPLITUDE_TRIM_VP_LESS_THAN_0_35V
              McuEcoFeedbackResistorTrimValue = 2
              McuEcoFilterTrimValue = 3
              McuEcoGainTrimValue = 1
              McuEcoWatchdogTrimValue = MCU_ECO_WATCHDOG_TRIM_VP_GREATER_THAN_0_40V
          McuIloSettings: McuIlo0Enable=1, McuIlo0Frequency=32768.0, McuIlo0MonitorEnable=0, McuIlo0OnBackupEnable=0
            McuIlo1Settings: McuIlo1Enable=1, McuIlo1Frequency=32768.0, McuIlo1MonitorEnable=0
          McuWcoSettings:
            McuWcoEnable = 0
            McuWcoFrequency = 0.0
            McuWcoPrescaler = MCU_WCO_SQUAREWAVE_32768HZ
            McuWcoStabilizationTimeout = 1
            McuWcoStopForUpdate = 0
            McuWcoType = MCU_WCO_WATCH_CRYSTAL
        17 x McuClockReferencePoint:
          McuClockReferencePoint_CANFD0_CLOCK_CAN0: McuClock=MCU_PCLK_CANFD0_CLOCK_CAN0, McuClockReferencePointFrequency=80000000
          McuClockReferencePoint_CANFD0_CLOCK_CAN2: McuClock=MCU_PCLK_CANFD0_CLOCK_CAN2, McuClockReferencePointFrequency=80000000
          McuClockReferencePoint_TCPWM0_CLOCKS7: McuClock=MCU_PCLK_TCPWM0_CLOCKS7, McuClockReferencePointFrequency=1000000
          McuClockReferencePoint_TCPWM0_CLOCKS512: McuClock=MCU_PCLK_TCPWM0_CLOCKS512, McuClockReferencePointFrequency=1000000
          McuClockReferencePoint_TCPWM0_CLOCKS10: McuClock=MCU_PCLK_TCPWM0_CLOCKS10, McuClockReferencePointFrequency=1000000
          McuClockReferencePoint_TCPWM0_CLOCKS3: McuClock=MCU_PCLK_TCPWM0_CLOCKS3, McuClockReferencePointFrequency=1000000
          McuClockReferencePoint_TCPWM0_CLOCKS262: McuClock=MCU_PCLK_TCPWM0_CLOCKS262, McuClockReferencePointFrequency=1000000
          McuClockReferencePoint_TCPWM0_CLOCKS18: McuClock=MCU_PCLK_TCPWM0_CLOCKS18, McuClockReferencePointFrequency=1000000
          McuClockReferencePoint_TCPWM0_CLOCKS17: McuClock=MCU_PCLK_TCPWM0_CLOCKS17, McuClockReferencePointFrequency=1000000
          McuClockReferencePoint_SCB0_CLOCK: McuClock=MCU_PCLK_SCB0_CLOCK, McuClockReferencePointFrequency=10000000
          McuClockReferencePoint_TCPWM0_CLOCKS5: McuClock=MCU_PCLK_TCPWM0_CLOCKS5, McuClockReferencePointFrequency=1000000
          McuClockReferencePoint_TCPWM0_CLOCKS44: McuClock=MCU_PCLK_TCPWM0_CLOCKS44, McuClockReferencePointFrequency=1000000
          McuClockReferencePoint_TCPWM0_CLOCKS45: McuClockReferencePointFrequency=1000000, McuClock=MCU_PCLK_TCPWM0_CLOCKS45
          McuClockReferencePoint_TCPWM0_CLOCKS48: McuClock=MCU_PCLK_TCPWM0_CLOCKS48, McuClockReferencePointFrequency=1000000
          McuClockReferencePoint_TCPWM0_CLOCKS53: McuClock=MCU_PCLK_TCPWM0_CLOCKS53, McuClockReferencePointFrequency=1000000
          McuClockReferencePoint_TCPWM0_CLOCKS54: McuClock=MCU_PCLK_TCPWM0_CLOCKS54, McuClockReferencePointFrequency=1000000
          McuClockReferencePoint_SCB2_CLOCK: McuClock=MCU_PCLK_SCB2_CLOCK, McuClockReferencePointFrequency=10000000
      McuLowVoltageDetectionCallbackFunctions
      McuModeSettingConf_ACTIVE (McuModeSettingConf):
        McuBandgapReferencePowerMode = MCU_POWERMODE_NORMAL
        McuBypassPllLevelShifter = 0
        McuCpuPowerMode = MCU_CPUMODE_ACTIVE
        McuDeepSleepRegulatorDisable = 0
        McuEnableCacheFlushBeforeModeChange = 0
        McuEnableLowPowerTransition = 1
        McuFreezeIoRelease = 0
        McuLinearCoreRegulatorDisable = 0
        McuMainCore0PowerUpDelay = 300
        McuMode = 0
        McuRam0Macro{0..3}PowerMode = MCU_POWERMODE_ENABLED
        McuRam1PowerMode = MCU_POWERMODE_ENABLED
        McuRamPowerUpDelay = 150
        McuReferenceCurrentGeneratorDisable = 0
        McuSleepOnExitIsrEnable = 0
        McuTargetCpu = MCU_CPU_CM4
        McuUpdateSystemResource = 1
        McuVoltageReferenceBufferDisable = 0
        McuWakeupByPendingInterruptEnable = 1
      McuModeSettingConf_DEEPSLEEP (McuModeSettingConf):
        McuMode = 1
        McuTargetCpu = MCU_CPU_CM4
        McuCpuPowerMode = MCU_CPUMODE_DEEPSLEEP
        McuEnableLowPowerTransition = 1
        McuWakeupByPendingInterruptEnable = 1
        McuEnableCacheFlushBeforeModeChange = 0
        McuFreezeIoRelease = 0
        McuUpdateSystemResource = 1
        McuMainCore0PowerUpDelay = 300
        McuRamPowerUpDelay = 150
        McuLinearCoreRegulatorDisable = 0
        McuDeepSleepRegulatorDisable = 0
        McuVoltageReferenceBufferDisable = 0
        McuReferenceCurrentGeneratorDisable = 0
        McuBandgapReferencePowerMode = MCU_POWERMODE_LOWPOWER
        McuBypassPllLevelShifter = 0
        McuRam0Macro{0..3}PowerMode = MCU_POWERMODE_ENABLED
        McuRam1PowerMode = MCU_POWERMODE_ENABLED
        McuSleepOnExitIsrEnable = 0
      McuDemEventParameterRefs: MCU_E_CLOCK_FAILURE=MCU_E_CLOCK_FAILURE, MCU_E_RESET_FAILURE=MCU_E_RESET_FAILURE
    McuPublishedInformation
      27 x McuResetReasonConf:
        MCU_ACT_FAULT_RESET: McuResetReason=3
        MCU_BOD_VCCD_RESET: McuResetReason=14
        MCU_BOD_VDDA_RESET: McuResetReason=13
        MCU_BOD_VDDD_RESET: McuResetReason=12
        MCU_CSV_HF_RESET: McuResetReason=21
        MCU_CSV_REF_RESET: McuResetReason=22
        MCU_DPSLP_FAULT_RESET: McuResetReason=4
        MCU_MCWDT0_RESET: McuResetReason=7
        MCU_MCWDT1_RESET: McuResetReason=8
        MCU_MCWDT2_RESET: McuResetReason=9
        MCU_MCWDT3_RESET: McuResetReason=10
        MCU_OCD_ACTIVE_REGULATOR_RESET: McuResetReason=18
        MCU_OCD_DEEPSLEEP_REGULATOR_RESET: McuResetReason=19
        MCU_OVD_VCCD_RESET: McuResetReason=17
        MCU_OVD_VDDA_RESET: McuResetReason=16
        MCU_OVD_VDDD_RESET: McuResetReason=15
        MCU_POWER_ON_RESET: McuResetReason=1
        MCU_PXRES_RESET: McuResetReason=26
        MCU_REGHC_OCD_RESET: McuResetReason=24
        MCU_REGHC_PMIC_RESET: McuResetReason=25
        MCU_RESET_UNDEFINED: McuResetReason=0
        MCU_STRUCTURAL_XRES_RESET: McuResetReason=20
        MCU_SW_RESET: McuResetReason=6
        MCU_TEST_DEBUG_RESET: McuResetReason=5
        MCU_WAKEUP_RESET: McuResetReason=23
        MCU_WATCHDOG_RESET: McuResetReason=2
        MCU_XRES_RESET: McuResetReason=11

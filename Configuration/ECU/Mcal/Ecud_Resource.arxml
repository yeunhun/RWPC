AUTOSAR XML (schema 4-0-3)
package /Resource
  module config Resource
    ResourceGeneral: ResourceSubDerivative=CYT2B93CAS

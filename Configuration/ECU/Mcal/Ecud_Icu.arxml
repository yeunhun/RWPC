AUTOSAR XML (schema 4-0-3)
package /Icu
  module config Icu: implementation-config-variant=VARIANT-POST-BUILD, module-description=IcuImplementation
    IcuConfigSet_0 (IcuConfigSet): IcuMaxChannel=4
      4 x IcuChannel, all with IcuMeasurementMode=ICU_MODE_SIGNAL_EDGE_DETECT, IcuWakeupCapability=0:
        IcuChannel_BCAN_WakeUp: IcuChannelId=0, IcuResource=GPIO_6_5, IcuDefaultStartEdge=ICU_FALLING_EDGE
          IcuSignalEdgeDetection_BCAN_WakeUp (IcuSignalEdgeDetection): IcuSignalNotification=CheckWakeup_BCAN_WakeUp
        IcuChannel_LCAN_WakeUp: IcuChannelId=1, IcuResource=GPIO_7_1, IcuDefaultStartEdge=ICU_FALLING_EDGE
          IcuSignalEdgeDetection_LCAN_WakeUp (IcuSignalEdgeDetection): IcuSignalNotification=CheckWakeup_LCAN_WakeUp
        IcuChannel_NFC_INTERRUPT: IcuChannelId=2, IcuResource=GPIO_2_1, IcuDefaultStartEdge=ICU_RISING_EDGE
          IcuSignalEdgeDetection_NFC_INTERRUPT (IcuSignalEdgeDetection): IcuSignalNotification=IcuSignalEdgeDetection_NFC_INTERRUPT_Cbk
        IcuChannel_P9450_INTB: IcuChannelId=3, IcuResource=GPIO_18_1, IcuDefaultStartEdge=ICU_FALLING_EDGE
          IcuSignalEdgeDetection_P9450_INTB (IcuSignalEdgeDetection): IcuSignalNotification=IcuSignalEdgeDetection_P9450_INTB_Cbk
    IcuGeneral:
      IcuErrorCalloutFunction = Det_ReportError
      IcuIndex = 0
      IcuReportWakeupSource = 0
      IcuIncludeFile = Det.h
      IcuDevErrorDetect = 1
      IcuIncludeFile = Rte_IoHwAb.h
      IcuIncludeFile = LowPower_Callout.h
    IcuOptionalApis:
      IcuChannelGroupApi = 1
      IcuDeInitApi = 1
      IcuDisableNotiApiCapableWakeup = 0
      IcuDisableWakeupApi = 1
      IcuEdgeCountApi = 1
      IcuEdgeDetectApi = 1
      IcuEnableNotiApiCapableWakeup = 0
      IcuEnableWakeupApi = 1
      IcuGetDutyCycleValuesApi = 1
      IcuGetInputLevelApi = 1
      IcuGetInputStateApi = 1
      IcuGetTimeElapsedApi = 1
      IcuGetVersionInfoApi = 1
      IcuSafetyFunctionApi = 1
      IcuSetModeApi = 1
      IcuSetPrescalerApi = 1
      IcuSignalMeasurementApi = 1
      IcuTimestampApi = 1
      IcuWakeupAcceptanceInSetMode = 1
      IcuWakeupFunctionalityApi = 1
    IcuDemEventParameterRefs: ICU_E_HARDWARE_ERROR=ICU_E_HARDWARE_ERROR

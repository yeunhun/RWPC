AUTOSAR XML (schema 4-0-3)
package /Adc
  module config Adc: implementation-config-variant=VARIANT-POST-BUILD, module-description=AdcImplementation
    AdcConfigSet_0 (AdcConfigSet)
      AdcHwUnit_0 (AdcHwUnit): AdcDiagnoseEnable=0, AdcHwUnitId=ADC_SAR_0_0, AdcPreconditionCycle=1, AdcClockSource=ADC_NOT_USED
        AdcGroup_U0All (AdcGroup):
          AdcFirstLogicalChannel = 2
          AdcGroupAccessMode = ADC_ACCESS_MODE_SINGLE
          AdcGroupConversionMode = ADC_CONV_MODE_ONESHOT
          AdcGroupId = 2
          AdcGroupTriggSrc = ADC_TRIGG_SRC_SW
          AdcSampleMode = ADC_SAMPLE_NORMAL
          AdcStreamingBufferMode = ADC_STREAM_BUFFER_LINEAR
          AdcStreamingNumSamples = 1
          AdcUseAlternateCalibration = 0
          AdcUseDma = 0
          AdcGroupPriority = 0
          AdcInterruptMode = 1
          AdcNotification = AdcAllGrp0Nf
          AdcGroupDefinition = AdcChannel_U0C8
          AdcGroupDefinition = AdcChannel_U0C6
        AdcChannel_U0C6 (AdcChannel):
          AdcChannelConvTime = 14
          AdcChannelHighLimit = 65535
          AdcChannelId = 6
          AdcChannelLimitCheck = 0
          AdcChannelLowLimit = 0
          AdcChannelRangeSelect = ADC_RANGE_ALWAYS
          AdcChannelRefVoltsrcHigh = ADC_NOT_USED
          AdcChannelRefVoltsrcLow = ADC_NOT_USED
          AdcChannelResolution = 12
          AdcChannelSampTime = 60
          AdcChannelResultSigned = 0
        AdcChannel_U0C8 (AdcChannel):
          AdcChannelId = 8
          AdcChannelResultSigned = 0
          AdcChannelConvTime = 14
          AdcChannelHighLimit = 65535
          AdcChannelLimitCheck = 0
          AdcChannelLowLimit = 0
          AdcChannelRangeSelect = ADC_RANGE_ALWAYS
          AdcChannelRefVoltsrcHigh = ADC_NOT_USED
          AdcChannelRefVoltsrcLow = ADC_NOT_USED
          AdcChannelResolution = 12
          AdcChannelSampTime = 60
        AdcGroup_U0C6 (AdcGroup):
          AdcGroupAccessMode = ADC_ACCESS_MODE_SINGLE
          AdcGroupConversionMode = ADC_CONV_MODE_ONESHOT
          AdcGroupId = 0
          AdcGroupPriority = 0
          AdcGroupTriggSrc = ADC_TRIGG_SRC_SW
          AdcStreamingBufferMode = ADC_STREAM_BUFFER_LINEAR
          AdcStreamingNumSamples = 1
          AdcInterruptMode = 1
          AdcUseDma = 0
          AdcFirstLogicalChannel = 0
          AdcUseAlternateCalibration = 0
          AdcSampleMode = ADC_SAMPLE_NORMAL
          AdcGroupDefinition = AdcChannel_U0C6
        AdcGroup_U0C8 (AdcGroup):
          AdcGroupAccessMode = ADC_ACCESS_MODE_SINGLE
          AdcGroupConversionMode = ADC_CONV_MODE_ONESHOT
          AdcGroupId = 1
          AdcGroupTriggSrc = ADC_TRIGG_SRC_SW
          AdcStreamingBufferMode = ADC_STREAM_BUFFER_LINEAR
          AdcStreamingNumSamples = 1
          AdcFirstLogicalChannel = 1
          AdcInterruptMode = 1
          AdcUseDma = 0
          AdcSampleMode = ADC_SAMPLE_NORMAL
          AdcGroupPriority = 0
          AdcUseAlternateCalibration = 0
          AdcGroupDefinition = AdcChannel_U0C8
      AdcHwUnit_2 (AdcHwUnit): AdcHwUnitId=ADC_SAR_0_2, AdcDiagnoseEnable=0, AdcPreconditionCycle=1, AdcClockSource=ADC_NOT_USED
        3 x AdcChannel, all with AdcChannelResultSigned=0, AdcChannelConvTime=14, AdcChannelHighLimit=65535, AdcChannelLimitCheck=0, AdcChannelLowLimit=0, AdcChannelRangeSelect=ADC_RANGE_ALWAYS, AdcChannelRefVoltsrcHigh=ADC_NOT_USED, AdcChannelRefVoltsrcLow=ADC_NOT_USED, AdcChannelResolution=12, AdcChannelSampTime=60:
          AdcChannel_U2C5: AdcChannelId=133
          AdcChannel_U2C6: AdcChannelId=134
          AdcChannel_U2C7: AdcChannelId=135
        4 x AdcGroup, all with AdcGroupAccessMode=ADC_ACCESS_MODE_SINGLE, AdcGroupConversionMode=ADC_CONV_MODE_ONESHOT, AdcGroupTriggSrc=ADC_TRIGG_SRC_SW, AdcStreamingBufferMode=ADC_STREAM_BUFFER_LINEAR, AdcStreamingNumSamples=1, AdcInterruptMode=1, AdcUseDma=0, AdcSampleMode=ADC_SAMPLE_NORMAL, AdcGroupPriority=0, AdcUseAlternateCalibration=0:
          AdcGroup_U2All: AdcGroupId=6, AdcFirstLogicalChannel=3, AdcNotification=AdcAllGrp2Nf, AdcGroupDefinition=AdcChannel_U2C7
          AdcGroup_U2C5: AdcGroupId=3, AdcFirstLogicalChannel=0, AdcGroupDefinition=AdcChannel_U2C5
          AdcGroup_U2C6: AdcGroupId=4, AdcFirstLogicalChannel=1, AdcGroupDefinition=AdcChannel_U2C6
          AdcGroup_U2C7: AdcGroupId=5, AdcFirstLogicalChannel=2, AdcGroupDefinition=AdcChannel_U2C7
    AdcGeneral:
      AdcCalibrationApi = 0
      AdcDeInitApi = 0
      AdcDevErrorDetect = 1
      AdcEnableLimitCheck = 0
      AdcEnableQueuing = 0
      AdcEnableStartStopGroupApi = 1
      AdcHwTriggerApi = 0
      AdcLowPowerStatesSupport = 0
      AdcPriorityImplementation = ADC_PRIORITY_HW
      AdcReadGroupApi = 1
      AdcResultAlignment = ADC_ALIGN_RIGHT
      AdcVersionInfoApi = 1
      AdcErrorCalloutFunction = Det_ReportError
      AdcIncludeFile = Det.h
      AdcGrpNotifCapability = 1
      AdcIncludeFile = IoHwAb_Cfg.h
    AdcPublishedInformation: AdcChannelValueSigned=1, AdcGroupFirstChannelFixed=0, AdcMaxChannelResolution=12
    AdcDemEventParameterRefs: ADC_E_HARDWARE_ERROR=ADC_E_HARDWARE_ERROR

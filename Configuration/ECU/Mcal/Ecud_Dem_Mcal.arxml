AUTOSAR XML (schema 4-0-3)
package /Dem
  module config Dem: implementation-config-variant=VARIANT-POST-BUILD
    DemConfigSet
      11 x DemEventParameter, all with DemEventKind=DEM_EVENT_KIND_BSW:
        ADC_E_HARDWARE_ERROR: DemEventId=1
          DemEventClass
            DemDebounceAlgorithmClass
              DemDebounceCounterBased
        CAN_E_HARDWARE_ERROR: DemEventId=2
          DemEventClass
            DemDebounceAlgorithmClass
              DemDebounceCounterBased
        ICU_E_HARDWARE_ERROR: DemEventId=3
          DemEventClass
            DemDebounceAlgorithmClass
              DemDebounceCounterBased
        LIN_E_TIMEOUT: DemEventId=4
          DemEventClass
            DemDebounceAlgorithmClass
              DemDebounceCounterBased
        MCU_E_CLOCK_FAILURE: DemEventId=5
          DemEventClass
            DemDebounceAlgorithmClass
              DemDebounceCounterBased
        MCU_E_RESET_FAILURE: DemEventId=6
          DemEventClass
            DemDebounceAlgorithmClass
              DemDebounceCounterBased
        SPI_E_HARDWARE_ERROR: DemEventId=7
          DemEventClass
            DemDebounceAlgorithmClass
              DemDebounceCounterBased
        WDG_E_DISABLE_REJECTED: DemEventId=8
          DemEventClass
            DemDebounceAlgorithmClass
              DemDebounceCounterBased
        WDG_E_MODE_FAILED: DemEventId=9
          DemEventClass
            DemDebounceAlgorithmClass
              DemDebounceCounterBased
        WDG_E_HW_TIMEOUT: DemEventId=10
          DemEventClass
            DemDebounceAlgorithmClass
              DemDebounceCounterBased
        WDG_E_WDG_STOPPED: DemEventId=11
          DemEventClass
            DemDebounceAlgorithmClass
              DemDebounceCounterBased
    DemGeneral:
      DemClearDTCBehavior = DEM_CLRRESP_NONVOLATILE_FINISH
      DemDebounceCounterBasedSupport = 1
      DemDebounceTimeBasedSupport = 1
      DemDevErrorDetect = 1
      DemDtcStatusAvailabilityMask = 0
      DemEventCombinationSupport = DEM_EVCOMB_DISABLED
      DemMaxNumberEventEntryPermanent = 0
      DemMaxNumberPrestoredFF = 0
      DemOccurrenceCounterProcessing = DEM_PROCESS_OCCCTR_CDTC
      DemOperationCycleStatusStorage = 1
      DemPTOSupport = 1
      DemStatusBitHandlingTestFailedSinceLastClear = DEM_STATUS_BIT_NORMAL
      DemStatusBitStorageTestFailed = 1
      DemTaskTime = 0.001
      DemTriggerDcmReports = 1
      DemTriggerDltReports = 1
      DemTriggerFiMReports = 1
      DemTriggerMonitorInitBeforeClearOk = 1
      DemTypeOfDTCSupported = DEM_DTC_TRANSLATION_ISO11992_4
      DemTypeOfFreezeFrameRecordNumeration = DEM_FF_RECNUM_CALCULATED
      DemVersionInfoApi = 1
      DemOperationCycle_0 (DemOperationCycle): DemOperationCycleType=DEM_OPCYC_IGNITION
    CommonPublishedInformation

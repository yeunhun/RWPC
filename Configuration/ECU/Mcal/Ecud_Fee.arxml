AUTOSAR XML (schema 4-0-3)
package /Fee
  module config Fee: implementation-config-variant=VARIANT-PRE-COMPILE, module-description=FeeImplementation
    FeeGeneral:
      FeeBlockMaxSize = 256
      FeeCleanupAndEraseApi = 0
      FeeClearApi = 0
      FeeDefaultCycleMode = MEMIF_MODE_FAST
      FeeDevErrorDetect = 1
      FeeErrorCalloutFunction = Det_ReportError
      FeeGetRemainingPagesApi = 0
      FeeInitiallyEraseEmptySectors = 1
      FeeNvmJobEndNotification = NvM_JobEndNotification
      FeeNvmJobErrorNotification = NvM_JobErrorNotification
      FeePollingMode = 1
      FeeSetCycleModeApi = 1
      FeeSetModeSupported = 1
      FeeUnmatchedBlockCheck = 0
      FeeVersionInfoApi = 1
      FeeVirtualPageSize = 4
      FeeIncludeFile = Det.h
      FeeMainFunctionPeriod = 1.0
      FeeUseConfig
        Config: FeeSectorStartAddress=0, FeeValidDataSize=512
    FeePublishedInformation: FeeBlockOverhead=20, FeeInstanceId=0, FeePageOverhead=16
    26 x FeeBlockConfiguration, all with FeeNumberOfWriteCycles=0, FeeDeviceIndex=FlsGeneral:
      FeeBlock_ConfigID: FeeBlockNumber=4, FeeBlockSize=4, FeeImmediateData=0
      FeeBlock_ConfigID_copy1: FeeBlockNumber=5, FeeBlockSize=4, FeeImmediateData=0
      FeeBlock_DemNonVolatileData: FeeBlockNumber=8, FeeBlockSize=12, FeeImmediateData=0
      FeeBlock_DemEventStatusNvRamBlock: FeeBlockNumber=12, FeeBlockSize=8, FeeImmediateData=0
      FeeBlock_DemEventStatusNvRamBlock_copy1: FeeBlockNumber=13, FeeBlockSize=8, FeeImmediateData=0
      FeeBlock_DemPrimaryEventMemory_0: FeeBlockNumber=16, FeeBlockSize=16, FeeImmediateData=0
      FeeBlock_DemPrimaryEventMemory_0_copy1: FeeBlockNumber=17, FeeBlockSize=16, FeeImmediateData=0
      FeeBlock_DemPrimaryEventMemory_1: FeeBlockNumber=20, FeeBlockSize=16, FeeImmediateData=0
      FeeBlock_DemPrimaryEventMemory_1_copy1: FeeBlockNumber=21, FeeBlockSize=16, FeeImmediateData=0
      FeeBlock_DemPrimaryEventMemory_2: FeeBlockNumber=24, FeeBlockSize=16, FeeImmediateData=0
      FeeBlock_DemPrimaryEventMemory_2_copy1: FeeBlockNumber=25, FeeBlockSize=16, FeeImmediateData=0
      FeeBlock_Option: FeeBlockSize=10, FeeBlockNumber=28, FeeImmediateData=0
      FeeBlock_Option_copy1: FeeBlockSize=10, FeeBlockNumber=29, FeeImmediateData=0
      FeeBlock_Function: FeeBlockSize=18, FeeBlockNumber=32, FeeImmediateData=0
      FeeBlock_Function_copy1: FeeBlockSize=18, FeeBlockNumber=33, FeeImmediateData=0
      FeeBlock_DTCInfo: FeeBlockSize=10, FeeBlockNumber=36, FeeImmediateData=0
      FeeBlock_DTCInfo_copy1: FeeBlockSize=10, FeeBlockNumber=37, FeeImmediateData=0
      FeeBlock_SerialNO: FeeBlockSize=26, FeeBlockNumber=40, FeeImmediateData=0
      FeeBlock_SerialNO_copy1: FeeBlockSize=26, FeeBlockNumber=41, FeeImmediateData=0
      FeeBlock_MDate: FeeBlockSize=10, FeeBlockNumber=44, FeeImmediateData=0
      FeeBlock_MDate_copy1: FeeBlockSize=10, FeeBlockNumber=45, FeeImmediateData=0
      FeeBlock_PartNO: FeeBlockSize=18, FeeBlockNumber=48, FeeImmediateData=0
      FeeBlock_PartNO_copy1: FeeBlockSize=18, FeeBlockNumber=49, FeeImmediateData=0
      FeeBlock_Dummy: FeeBlockSize=18, FeeBlockNumber=52, FeeImmediateData=0
      FeeBlock_Dummy_copy1: FeeBlockSize=18, FeeBlockNumber=53, FeeImmediateData=0
      FeeBlock_DemNonVolatileData_copy1: FeeBlockSize=12, FeeBlockNumber=9, FeeImmediateData=1

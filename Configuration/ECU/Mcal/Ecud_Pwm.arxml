AUTOSAR XML (schema 4-0-3)
package /Pwm
  module config Pwm: implementation-config-variant=VARIANT-POST-BUILD, module-description=PwmImplementation
    PwmChannelConfigSet_0 (PwmChannelConfigSet)
      5 x PwmChannel, all with PwmAlignment=PWM_LEFT_ALIGNED, PwmDutycycleDefault=16384, PwmPolarity=PWM_HIGH, PwmIdleState=PWM_LOW, PwmStartAtInit=0, PwmChannelClass=PWM_VARIABLE_PERIOD:
        PwmChannel_AMBER_IND_OUT: PwmChannelId=0, PwmTimer=TCPWM_0_44, PwmPeriodDefault=0.005, PwmDebugMode=PWM_DEBUG_MODE_HALT, PwmOutputAtInitSelect=HIGH, PwmMcuClockReferencePoint=McuClockReferencePoint_TCPWM0_CLOCKS44
        PwmChannel_GREEN_IND_OUT1: PwmChannelId=1, PwmTimer=TCPWM_0_45, PwmPeriodDefault=0.005, PwmDebugMode=PWM_DEBUG_MODE_CONTINUE, PwmMcuClockReferencePoint=McuClockReferencePoint_TCPWM0_CLOCKS45
        PwmChannel_GREEN_IND_OUT2: PwmChannelId=2, PwmTimer=TCPWM_0_54, PwmPeriodDefault=0.005, PwmDebugMode=PWM_DEBUG_MODE_CONTINUE, PwmMcuClockReferencePoint=McuClockReferencePoint_TCPWM0_CLOCKS54
        PwmChannel_GREEN_IND_OUT3: PwmChannelId=3, PwmTimer=TCPWM_0_53, PwmPeriodDefault=0.005, PwmDebugMode=PWM_DEBUG_MODE_CONTINUE, PwmMcuClockReferencePoint=McuClockReferencePoint_TCPWM0_CLOCKS53
        PwmChannel_FAN_OUT: PwmChannelId=4, PwmTimer=TCPWM_0_48, PwmPeriodDefault=0.00004, PwmDebugMode=PWM_DEBUG_MODE_CONTINUE, PwmMcuClockReferencePoint=McuClockReferencePoint_TCPWM0_CLOCKS48
    PwmConfigurationOfOptApiServices:
      PwmDeInitApi = 1
      PwmEnableDisableTriggerApi = 0
      PwmGetOutputState = 1
      PwmSetDutyCycle = 1
      PwmSetOutputOffset = 0
      PwmSetOutputState = 0
      PwmSetOutputToIdle = 1
      PwmSetPeriodAndDuty = 1
      PwmSetPrescaler = 0
      PwmSetTriggerDelay = 0
      PwmStopGroup = 0
      PwmVersionInfoApi = 1
    PwmGeneral:
      PwmDevErrorDetect = 1
      PwmDutycycleUpdatedEndperiod = 1
      PwmErrorCalloutFunction = Det_ReportError
      PwmIndex = 0
      PwmNotificationSupported = 1
      PwmPeriodUpdatedEndperiod = 1
      PwmIncludeFile = Det.h

AUTOSAR XML (schema 4-0-3)
package /Port
  module config Port: implementation-config-variant=VARIANT-POST-BUILD, module-description=PortImplementation
    5 x PortConfigSet, all with PortTriggerReference=PortTriggerConfigSet_0:
      PortConfigSet_Full
        14 x PortContainer, all with PortSmartioClockSource=PORT_SMART_CLK_SRC_CONST0, PortSmartioDataUnitBitSize=1, PortSmartioDataUnitData0Source=PORT_SMART_DU_DATA_CONST0, PortSmartioDataUnitData1Source=PORT_SMART_DU_DATA_CONST0, PortSmartioDataUnitOperation=PORT_SMART_DU_OPC_INCR, PortSmartioDataUnitSource=0, PortSmartioDataUnitTr0Source=PORT_SMART_DU_TR_CONST0, PortSmartioDataUnitTr1Source=PORT_SMART_DU_TR_CONST0, PortSmartioDataUnitTr2Source=PORT_SMART_DU_TR_CONST0, PortSmartioEnable=0, PortSmartioHoldOverrideEnable=0, PortSmartioPipelineEnable=1:
          PortContainer0: PortId=0, PortNumberOfPortPins=4
            4 x PortPin, all with PortPinDirectionChangeable=1, PortPinOutputInBufEnable=1, PortPinModeChangeable=1, PortPinLevelValue=PORT_PIN_LEVEL_LOW, PortPinSmartioBypassEnable=1, PortPinSmartioSyncIoEnable=0, PortPinSmartioSyncChipEnable=0, PortPinSmartioLutTr0Source=PORT_SMART_LUT_TR_DU, PortPinSmartioLutTr1Source=PORT_SMART_LUT_TR_LUT0, PortPinSmartioLutTr2Source=PORT_SMART_LUT_TR_LUT0, PortPinSmartioLut=0, PortPinSmartioLutOperation=PORT_SMART_LUT_OPC_COM_OUT_NO_FB, PortPinInputBufferMode=PORT_PIN_IN_MODE_CMOS, PortPinOutputSlowSlewRateEnable=0, PortPinOutputDriveStrength=PORT_PIN_OUT_STRENGTH_FULL, PortPinOutputDriveSelectTrim=PORT_PIN_OUT_TRIM_DEFAULT, Port5VPinInputBufferMode=PORT_PIN_5V_IN_MODE_CMOS_OR_TTL:
              PortPin_P000_0: PortPinId=0, PortPinName=P000_0, PortPinDirection=PORT_PIN_IN, PortPinInitialMode=SCB_0_SPI_MISO, PortPinOutputDrive=PORT_PIN_OUT_MODE_HIGHZ, PortPinMode=SCB_0_SPI_MISO
              PortPin_P000_1: PortPinId=1, PortPinName=P000_1, PortPinDirection=PORT_PIN_OUT, PortPinInitialMode=SCB_0_SPI_MOSI, PortPinOutputDrive=PORT_PIN_OUT_MODE_STRONG, PortPinMode=SCB_0_SPI_MOSI
              PortPin_P000_2: PortPinId=2, PortPinName=P000_2, PortPinDirection=PORT_PIN_OUT, PortPinInitialMode=SCB_0_SPI_CLK, PortPinMode=SCB_0_SPI_CLK, PortPinOutputDrive=PORT_PIN_OUT_MODE_STRONG
              PortPin_P000_3: PortPinId=3, PortPinName=P000_3, PortPinDirection=PORT_PIN_OUT, PortPinInitialMode=GPIO, PortPinMode=GPIO, PortPinOutputDrive=PORT_PIN_OUT_MODE_STRONG
          PortContainer2: PortId=2, PortNumberOfPortPins=2
            PortPin_P002_0 (PortPin):
              PortPinId = 16
              PortPinName = P002_0
              PortPinDirection = PORT_PIN_IN_OUT_DISABLED
              PortPinDirectionChangeable = 1
              PortPinOutputInBufEnable = 0
              PortPinInitialMode = AMUXA
              PortPinModeChangeable = 1
              PortPinMode = AMUXA
              PortPinLevelValue = PORT_PIN_LEVEL_LOW
              PortPinOutputDrive = PORT_PIN_OUT_MODE_HIGHZ
              PortPinSmartioBypassEnable = 1
              PortPinSmartioSyncIoEnable = 0
              PortPinSmartioSyncChipEnable = 0
              PortPinSmartioLutTr0Source = PORT_SMART_LUT_TR_DU
              PortPinSmartioLutTr1Source = PORT_SMART_LUT_TR_LUT0
              PortPinSmartioLutTr2Source = PORT_SMART_LUT_TR_LUT0
              PortPinSmartioLut = 0
              PortPinSmartioLutOperation = PORT_SMART_LUT_OPC_COM_OUT_NO_FB
              PortPinInputBufferMode = PORT_PIN_IN_MODE_CMOS
              PortPinOutputSlowSlewRateEnable = 0
              PortPinOutputDriveStrength = PORT_PIN_OUT_STRENGTH_FULL
              PortPinOutputDriveSelectTrim = PORT_PIN_OUT_TRIM_DEFAULT
              Port5VPinInputBufferMode = PORT_PIN_5V_IN_MODE_CMOS_OR_TTL
            PortPin_P002_1 (PortPin):
              PortPinId = 17
              PortPinName = P002_1
              PortPinDirection = PORT_PIN_IN
              PortPinDirectionChangeable = 1
              PortPinOutputInBufEnable = 1
              PortPinInitialMode = GPIO
              PortPinModeChangeable = 1
              PortPinMode = GPIO
              PortPinLevelValue = PORT_PIN_LEVEL_LOW
              PortPinOutputDrive = PORT_PIN_OUT_MODE_HIGHZ
              PortPinSmartioBypassEnable = 1
              PortPinSmartioSyncIoEnable = 0
              PortPinSmartioSyncChipEnable = 0
              PortPinSmartioLutTr0Source = PORT_SMART_LUT_TR_DU
              PortPinSmartioLutTr1Source = PORT_SMART_LUT_TR_LUT0
              PortPinSmartioLutTr2Source = PORT_SMART_LUT_TR_LUT0
              PortPinSmartioLut = 0
              PortPinSmartioLutOperation = PORT_SMART_LUT_OPC_COM_OUT_NO_FB
              PortPinInputBufferMode = PORT_PIN_IN_MODE_CMOS
              PortPinOutputSlowSlewRateEnable = 0
              PortPinOutputDriveStrength = PORT_PIN_OUT_STRENGTH_FULL
              PortPinOutputDriveSelectTrim = PORT_PIN_OUT_TRIM_DEFAULT
              Port5VPinInputBufferMode = PORT_PIN_5V_IN_MODE_CMOS_OR_TTL
          PortContainer5: PortId=5, PortNumberOfPortPins=2
            PortPin_P005_0 (PortPin):
              PortPinId = 40
              PortPinName = P005_0
              PortPinDirection = PORT_PIN_IN_OUT_DISABLED
              PortPinDirectionChangeable = 1
              PortPinOutputInBufEnable = 0
              PortPinInitialMode = AMUXA
              PortPinModeChangeable = 1
              PortPinMode = AMUXA
              PortPinLevelValue = PORT_PIN_LEVEL_LOW
              PortPinOutputDrive = PORT_PIN_OUT_MODE_HIGHZ
              PortPinSmartioBypassEnable = 1
              PortPinSmartioSyncIoEnable = 0
              PortPinSmartioSyncChipEnable = 0
              PortPinSmartioLutTr0Source = PORT_SMART_LUT_TR_DU
              PortPinSmartioLutTr1Source = PORT_SMART_LUT_TR_LUT0
              PortPinSmartioLutTr2Source = PORT_SMART_LUT_TR_LUT0
              PortPinSmartioLut = 0
              PortPinSmartioLutOperation = PORT_SMART_LUT_OPC_COM_OUT_NO_FB
              PortPinInputBufferMode = PORT_PIN_IN_MODE_CMOS
              PortPinOutputSlowSlewRateEnable = 0
              PortPinOutputDriveStrength = PORT_PIN_OUT_STRENGTH_FULL
              PortPinOutputDriveSelectTrim = PORT_PIN_OUT_TRIM_DEFAULT
              Port5VPinInputBufferMode = PORT_PIN_5V_IN_MODE_CMOS_OR_TTL
            PortPin_P005_1 (PortPin):
              PortPinId = 41
              PortPinName = P005_1
              PortPinDirection = PORT_PIN_IN_OUT_DISABLED
              PortPinDirectionChangeable = 1
              PortPinOutputInBufEnable = 0
              PortPinInitialMode = AMUXA
              PortPinModeChangeable = 1
              PortPinMode = AMUXA
              PortPinLevelValue = PORT_PIN_LEVEL_LOW
              PortPinOutputDrive = PORT_PIN_OUT_MODE_HIGHZ
              PortPinSmartioBypassEnable = 1
              PortPinSmartioSyncIoEnable = 0
              PortPinSmartioSyncChipEnable = 0
              PortPinSmartioLutTr0Source = PORT_SMART_LUT_TR_DU
              PortPinSmartioLutTr1Source = PORT_SMART_LUT_TR_LUT0
              PortPinSmartioLutTr2Source = PORT_SMART_LUT_TR_LUT0
              PortPinSmartioLut = 0
              PortPinSmartioLutOperation = PORT_SMART_LUT_OPC_COM_OUT_NO_FB
              PortPinInputBufferMode = PORT_PIN_IN_MODE_CMOS
              PortPinOutputSlowSlewRateEnable = 0
              PortPinOutputDriveStrength = PORT_PIN_OUT_STRENGTH_FULL
              PortPinOutputDriveSelectTrim = PORT_PIN_OUT_TRIM_DEFAULT
              Port5VPinInputBufferMode = PORT_PIN_5V_IN_MODE_CMOS_OR_TTL
          PortContainer6: PortId=6, PortNumberOfPortPins=7
            7 x PortPin, all with PortPinLevelValue=PORT_PIN_LEVEL_LOW, PortPinSmartioBypassEnable=1, PortPinSmartioSyncIoEnable=0, PortPinSmartioSyncChipEnable=0, PortPinSmartioLutTr0Source=PORT_SMART_LUT_TR_DU, PortPinSmartioLutTr1Source=PORT_SMART_LUT_TR_LUT0, PortPinSmartioLutTr2Source=PORT_SMART_LUT_TR_LUT0, PortPinSmartioLut=0, PortPinSmartioLutOperation=PORT_SMART_LUT_OPC_COM_OUT_NO_FB, PortPinInputBufferMode=PORT_PIN_IN_MODE_CMOS, PortPinOutputSlowSlewRateEnable=0, PortPinOutputDriveStrength=PORT_PIN_OUT_STRENGTH_FULL, PortPinOutputDriveSelectTrim=PORT_PIN_OUT_TRIM_DEFAULT, Port5VPinInputBufferMode=PORT_PIN_5V_IN_MODE_CMOS_OR_TTL:
              PortPin_P006_0: PortPinId=48, PortPinName=P006_0, PortPinDirection=PORT_PIN_IN, PortPinDirectionChangeable=1, PortPinOutputInBufEnable=1, PortPinInitialMode=GPIO, PortPinModeChangeable=1, PortPinMode=GPIO, PortPinOutputDrive=PORT_PIN_OUT_MODE_HIGHZ
              PortPin_P006_1: PortPinId=49, PortPinName=P006_1, PortPinDirection=PORT_PIN_IN_OUT_DISABLED, PortPinDirectionChangeable=1, PortPinOutputInBufEnable=0, PortPinInitialMode=AMUXA, PortPinModeChangeable=1, PortPinMode=AMUXA, PortPinOutputDrive=PORT_PIN_OUT_MODE_HIGHZ
              PortPin_P006_2: PortPinId=50, PortPinName=P006_2, PortPinDirection=PORT_PIN_OUT, PortPinDirectionChangeable=0, PortPinOutputInBufEnable=1, PortPinInitialMode=CANFD_0_TTCAN_TX_2, PortPinModeChangeable=0, PortPinOutputDrive=PORT_PIN_OUT_MODE_STRONG, PortPinMode=CANFD_0_TTCAN_TX_2
              PortPin_P006_3: PortPinId=51, PortPinName=P006_3, PortPinDirection=PORT_PIN_IN, PortPinDirectionChangeable=0, PortPinOutputInBufEnable=1, PortPinInitialMode=CANFD_0_TTCAN_RX_2, PortPinModeChangeable=0, PortPinOutputDrive=PORT_PIN_OUT_MODE_HIGHZ, PortPinMode=CANFD_0_TTCAN_RX_2
              PortPin_P006_4: PortPinId=52, PortPinName=P006_4, PortPinDirection=PORT_PIN_OUT, PortPinDirectionChangeable=1, PortPinOutputInBufEnable=1, PortPinInitialMode=GPIO, PortPinModeChangeable=0, PortPinOutputDrive=PORT_PIN_OUT_MODE_STRONG, PortPinMode=GPIO
              PortPin_P006_5: PortPinId=53, PortPinName=P006_5, PortPinDirection=PORT_PIN_IN, PortPinDirectionChangeable=1, PortPinOutputInBufEnable=1, PortPinInitialMode=GPIO, PortPinModeChangeable=1, PortPinMode=GPIO, PortPinOutputDrive=PORT_PIN_OUT_MODE_HIGHZ
              PortPin_P006_6: PortPinId=54, PortPinName=P006_6, PortPinDirection=PORT_PIN_IN, PortPinDirectionChangeable=1, PortPinOutputInBufEnable=1, PortPinInitialMode=GPIO, PortPinModeChangeable=1, PortPinMode=GPIO, PortPinOutputDrive=PORT_PIN_OUT_MODE_HIGHZ
          PortContainer7: PortId=7, PortNumberOfPortPins=3
            3 x PortPin, all with PortPinDirectionChangeable=1, PortPinOutputInBufEnable=1, PortPinInitialMode=GPIO, PortPinMode=GPIO, PortPinLevelValue=PORT_PIN_LEVEL_LOW, PortPinSmartioBypassEnable=1, PortPinSmartioSyncIoEnable=0, PortPinSmartioSyncChipEnable=0, PortPinSmartioLutTr0Source=PORT_SMART_LUT_TR_DU, PortPinSmartioLutTr1Source=PORT_SMART_LUT_TR_LUT0, PortPinSmartioLutTr2Source=PORT_SMART_LUT_TR_LUT0, PortPinSmartioLut=0, PortPinSmartioLutOperation=PORT_SMART_LUT_OPC_COM_OUT_NO_FB, PortPinInputBufferMode=PORT_PIN_IN_MODE_CMOS, PortPinOutputSlowSlewRateEnable=0, PortPinOutputDriveStrength=PORT_PIN_OUT_STRENGTH_FULL, PortPinOutputDriveSelectTrim=PORT_PIN_OUT_TRIM_DEFAULT, Port5VPinInputBufferMode=PORT_PIN_5V_IN_MODE_CMOS_OR_TTL:
              PortPin_P007_0: PortPinId=56, PortPinName=P007_0, PortPinDirection=PORT_PIN_IN, PortPinModeChangeable=1, PortPinOutputDrive=PORT_PIN_OUT_MODE_HIGHZ
              PortPin_P007_1: PortPinId=57, PortPinName=P007_1, PortPinDirection=PORT_PIN_IN, PortPinModeChangeable=1, PortPinOutputDrive=PORT_PIN_OUT_MODE_HIGHZ
              PortPin_P007_2: PortPinId=58, PortPinName=P007_2, PortPinDirection=PORT_PIN_OUT, PortPinModeChangeable=0, PortPinOutputDrive=PORT_PIN_OUT_MODE_STRONG
          PortContainer8: PortId=8, PortNumberOfPortPins=2
            PortPin_P008_0 (PortPin):
              PortPinId = 64
              PortPinName = P008_0
              PortPinDirection = PORT_PIN_OUT
              PortPinDirectionChangeable = 0
              PortPinOutputInBufEnable = 1
              PortPinInitialMode = CANFD_0_TTCAN_TX_0
              PortPinModeChangeable = 0
              PortPinLevelValue = PORT_PIN_LEVEL_LOW
              PortPinOutputDrive = PORT_PIN_OUT_MODE_STRONG
              PortPinSmartioBypassEnable = 1
              PortPinSmartioSyncIoEnable = 0
              PortPinSmartioSyncChipEnable = 0
              PortPinSmartioLutTr0Source = PORT_SMART_LUT_TR_DU
              PortPinSmartioLutTr1Source = PORT_SMART_LUT_TR_LUT0
              PortPinSmartioLutTr2Source = PORT_SMART_LUT_TR_LUT0
              PortPinSmartioLut = 0
              PortPinSmartioLutOperation = PORT_SMART_LUT_OPC_COM_OUT_NO_FB
              PortPinInputBufferMode = PORT_PIN_IN_MODE_CMOS
              PortPinOutputSlowSlewRateEnable = 0
              PortPinOutputDriveStrength = PORT_PIN_OUT_STRENGTH_FULL
              PortPinOutputDriveSelectTrim = PORT_PIN_OUT_TRIM_DEFAULT
              Port5VPinInputBufferMode = PORT_PIN_5V_IN_MODE_CMOS_OR_TTL
              PortPinMode = CANFD_0_TTCAN_TX_0
            PortPin_P008_1 (PortPin):
              PortPinId = 65
              PortPinName = P008_1
              PortPinDirection = PORT_PIN_IN
              PortPinDirectionChangeable = 0
              PortPinOutputInBufEnable = 1
              PortPinInitialMode = CANFD_0_TTCAN_RX_0
              PortPinModeChangeable = 0
              PortPinLevelValue = PORT_PIN_LEVEL_LOW
              PortPinOutputDrive = PORT_PIN_OUT_MODE_HIGHZ
              PortPinSmartioBypassEnable = 1
              PortPinSmartioSyncIoEnable = 0
              PortPinSmartioSyncChipEnable = 0
              PortPinSmartioLutTr0Source = PORT_SMART_LUT_TR_DU
              PortPinSmartioLutTr1Source = PORT_SMART_LUT_TR_LUT0
              PortPinSmartioLutTr2Source = PORT_SMART_LUT_TR_LUT0
              PortPinSmartioLut = 0
              PortPinSmartioLutOperation = PORT_SMART_LUT_OPC_COM_OUT_NO_FB
              PortPinInputBufferMode = PORT_PIN_IN_MODE_CMOS
              PortPinOutputSlowSlewRateEnable = 0
              PortPinOutputDriveStrength = PORT_PIN_OUT_STRENGTH_FULL
              PortPinOutputDriveSelectTrim = PORT_PIN_OUT_TRIM_DEFAULT
              Port5VPinInputBufferMode = PORT_PIN_5V_IN_MODE_CMOS_OR_TTL
              PortPinMode = CANFD_0_TTCAN_RX_0
          PortContainer11: PortId=11, PortNumberOfPortPins=3
            3 x PortPin, all with PortPinDirection=PORT_PIN_IN_OUT_DISABLED, PortPinDirectionChangeable=1, PortPinOutputInBufEnable=0, PortPinInitialMode=AMUXA, PortPinModeChangeable=1, PortPinMode=AMUXA, PortPinLevelValue=PORT_PIN_LEVEL_LOW, PortPinOutputDrive=PORT_PIN_OUT_MODE_HIGHZ, PortPinSmartioBypassEnable=1, PortPinSmartioSyncIoEnable=0, PortPinSmartioSyncChipEnable=0, PortPinSmartioLutTr0Source=PORT_SMART_LUT_TR_DU, PortPinSmartioLutTr1Source=PORT_SMART_LUT_TR_LUT0, PortPinSmartioLutTr2Source=PORT_SMART_LUT_TR_LUT0, PortPinSmartioLut=0, PortPinSmartioLutOperation=PORT_SMART_LUT_OPC_COM_OUT_NO_FB, PortPinInputBufferMode=PORT_PIN_IN_MODE_CMOS, PortPinOutputSlowSlewRateEnable=0, PortPinOutputDriveStrength=PORT_PIN_OUT_STRENGTH_FULL, PortPinOutputDriveSelectTrim=PORT_PIN_OUT_TRIM_DEFAULT, Port5VPinInputBufferMode=PORT_PIN_5V_IN_MODE_CMOS_OR_TTL:
              PortPin_P011_0: PortPinId=88, PortPinName=P011_0
              PortPin_P011_1: PortPinId=89, PortPinName=P011_1
              PortPin_P011_2: PortPinId=90, PortPinName=P011_2
          PortContainer12: PortId=12, PortNumberOfPortPins=2
            PortPin_P012_0 (PortPin):
              PortPinId = 96
              PortPinName = P012_0
              PortPinDirection = PORT_PIN_IN_OUT_DISABLED
              PortPinDirectionChangeable = 1
              PortPinOutputInBufEnable = 0
              PortPinInitialMode = AMUXA
              PortPinModeChangeable = 1
              PortPinMode = AMUXA
              PortPinLevelValue = PORT_PIN_LEVEL_LOW
              PortPinOutputDrive = PORT_PIN_OUT_MODE_HIGHZ
              PortPinSmartioBypassEnable = 1
              PortPinSmartioSyncIoEnable = 0
              PortPinSmartioSyncChipEnable = 0
              PortPinSmartioLutTr0Source = PORT_SMART_LUT_TR_DU
              PortPinSmartioLutTr1Source = PORT_SMART_LUT_TR_LUT0
              PortPinSmartioLutTr2Source = PORT_SMART_LUT_TR_LUT0
              PortPinSmartioLut = 0
              PortPinSmartioLutOperation = PORT_SMART_LUT_OPC_COM_OUT_NO_FB
              PortPinInputBufferMode = PORT_PIN_IN_MODE_CMOS
              PortPinOutputSlowSlewRateEnable = 0
              PortPinOutputDriveStrength = PORT_PIN_OUT_STRENGTH_FULL
              PortPinOutputDriveSelectTrim = PORT_PIN_OUT_TRIM_DEFAULT
              Port5VPinInputBufferMode = PORT_PIN_5V_IN_MODE_CMOS_OR_TTL
            PortPin_P012_1 (PortPin):
              PortPinId = 97
              PortPinName = P012_1
              PortPinDirection = PORT_PIN_IN
              PortPinDirectionChangeable = 1
              PortPinOutputInBufEnable = 1
              PortPinInitialMode = GPIO
              PortPinModeChangeable = 1
              PortPinMode = GPIO
              PortPinLevelValue = PORT_PIN_LEVEL_LOW
              PortPinOutputDrive = PORT_PIN_OUT_MODE_HIGHZ
              PortPinSmartioBypassEnable = 1
              PortPinSmartioSyncIoEnable = 0
              PortPinSmartioSyncChipEnable = 0
              PortPinSmartioLutTr0Source = PORT_SMART_LUT_TR_DU
              PortPinSmartioLutTr1Source = PORT_SMART_LUT_TR_LUT0
              PortPinSmartioLutTr2Source = PORT_SMART_LUT_TR_LUT0
              PortPinSmartioLut = 0
              PortPinSmartioLutOperation = PORT_SMART_LUT_OPC_COM_OUT_NO_FB
              PortPinInputBufferMode = PORT_PIN_IN_MODE_CMOS
              PortPinOutputSlowSlewRateEnable = 0
              PortPinOutputDriveStrength = PORT_PIN_OUT_STRENGTH_FULL
              PortPinOutputDriveSelectTrim = PORT_PIN_OUT_TRIM_DEFAULT
              Port5VPinInputBufferMode = PORT_PIN_5V_IN_MODE_CMOS_OR_TTL
          PortContainer13: PortId=13, PortNumberOfPortPins=4
            4 x PortPin, all with PortPinDirectionChangeable=1, PortPinModeChangeable=1, PortPinLevelValue=PORT_PIN_LEVEL_LOW, PortPinSmartioBypassEnable=1, PortPinSmartioSyncIoEnable=0, PortPinSmartioSyncChipEnable=0, PortPinSmartioLutTr0Source=PORT_SMART_LUT_TR_DU, PortPinSmartioLutTr1Source=PORT_SMART_LUT_TR_LUT0, PortPinSmartioLutTr2Source=PORT_SMART_LUT_TR_LUT0, PortPinSmartioLut=0, PortPinSmartioLutOperation=PORT_SMART_LUT_OPC_COM_OUT_NO_FB, PortPinInputBufferMode=PORT_PIN_IN_MODE_CMOS, PortPinOutputSlowSlewRateEnable=0, PortPinOutputDriveStrength=PORT_PIN_OUT_STRENGTH_FULL, PortPinOutputDriveSelectTrim=PORT_PIN_OUT_TRIM_DEFAULT, Port5VPinInputBufferMode=PORT_PIN_5V_IN_MODE_CMOS_OR_TTL:
              PortPin_P013_0: PortPinId=104, PortPinName=P013_0, PortPinDirection=PORT_PIN_IN_OUT_DISABLED, PortPinOutputInBufEnable=0, PortPinInitialMode=AMUXA, PortPinMode=AMUXA, PortPinOutputDrive=PORT_PIN_OUT_MODE_HIGHZ
              PortPin_P013_1: PortPinId=105, PortPinName=P013_1, PortPinDirection=PORT_PIN_OUT, PortPinOutputInBufEnable=1, PortPinInitialMode=TCPWM_0_LINE_44, PortPinMode=TCPWM_0_LINE_44, PortPinOutputDrive=PORT_PIN_OUT_MODE_STRONG
              PortPin_P013_2: PortPinId=106, PortPinName=P013_2, PortPinDirection=PORT_PIN_IN_OUT_DISABLED, PortPinOutputInBufEnable=0, PortPinInitialMode=AMUXA, PortPinMode=AMUXA, PortPinOutputDrive=PORT_PIN_OUT_MODE_HIGHZ
              PortPin_P013_3: PortPinId=107, PortPinName=P013_3, PortPinDirection=PORT_PIN_OUT, PortPinOutputInBufEnable=1, PortPinInitialMode=TCPWM_0_LINE_45, PortPinMode=TCPWM_0_LINE_45, PortPinOutputDrive=PORT_PIN_OUT_MODE_STRONG
          PortContainer14: PortId=14, PortNumberOfPortPins=3
            3 x PortPin, all with PortPinDirection=PORT_PIN_OUT, PortPinDirectionChangeable=1, PortPinOutputInBufEnable=1, PortPinModeChangeable=1, PortPinLevelValue=PORT_PIN_LEVEL_LOW, PortPinSmartioBypassEnable=1, PortPinSmartioSyncIoEnable=0, PortPinSmartioSyncChipEnable=0, PortPinSmartioLutTr0Source=PORT_SMART_LUT_TR_DU, PortPinSmartioLutTr1Source=PORT_SMART_LUT_TR_LUT0, PortPinSmartioLutTr2Source=PORT_SMART_LUT_TR_LUT0, PortPinSmartioLut=0, PortPinSmartioLutOperation=PORT_SMART_LUT_OPC_COM_OUT_NO_FB, PortPinInputBufferMode=PORT_PIN_IN_MODE_CMOS, PortPinOutputSlowSlewRateEnable=0, PortPinOutputDriveStrength=PORT_PIN_OUT_STRENGTH_FULL, PortPinOutputDriveSelectTrim=PORT_PIN_OUT_TRIM_DEFAULT, Port5VPinInputBufferMode=PORT_PIN_5V_IN_MODE_CMOS_OR_TTL:
              PortPin_P014_0: PortPinId=112, PortPinName=P014_0, PortPinInitialMode=TCPWM_0_LINE_48, PortPinMode=TCPWM_0_LINE_48, PortPinOutputDrive=PORT_PIN_OUT_MODE_STRONG
              PortPin_P014_1: PortPinId=113, PortPinName=P014_1, PortPinInitialMode=SCB_2_I2C_SDA, PortPinMode=SCB_2_I2C_SDA, PortPinOutputDrive=PORT_PIN_OUT_MODE_OD_LOW
              PortPin_P014_2: PortPinId=114, PortPinName=P014_2, PortPinInitialMode=SCB_2_I2C_SCL, PortPinMode=SCB_2_I2C_SCL, PortPinOutputDrive=PORT_PIN_OUT_MODE_OD_LOW
          PortContainer18: PortId=18, PortNumberOfPortPins=7
            7 x PortPin, all with PortPinDirectionChangeable=1, PortPinOutputInBufEnable=1, PortPinModeChangeable=1, PortPinLevelValue=PORT_PIN_LEVEL_LOW, PortPinSmartioBypassEnable=1, PortPinSmartioSyncIoEnable=0, PortPinSmartioSyncChipEnable=0, PortPinSmartioLutTr0Source=PORT_SMART_LUT_TR_DU, PortPinSmartioLutTr1Source=PORT_SMART_LUT_TR_LUT0, PortPinSmartioLutTr2Source=PORT_SMART_LUT_TR_LUT0, PortPinSmartioLut=0, PortPinSmartioLutOperation=PORT_SMART_LUT_OPC_COM_OUT_NO_FB, PortPinInputBufferMode=PORT_PIN_IN_MODE_CMOS, PortPinOutputSlowSlewRateEnable=0, PortPinOutputDriveStrength=PORT_PIN_OUT_STRENGTH_FULL, PortPinOutputDriveSelectTrim=PORT_PIN_OUT_TRIM_DEFAULT, Port5VPinInputBufferMode=PORT_PIN_5V_IN_MODE_CMOS_OR_TTL:
              PortPin_P018_0: PortPinId=144, PortPinName=P018_0, PortPinDirection=PORT_PIN_OUT, PortPinInitialMode=GPIO, PortPinMode=GPIO, PortPinOutputDrive=PORT_PIN_OUT_MODE_STRONG
              PortPin_P018_1: PortPinId=145, PortPinName=P018_1, PortPinDirection=PORT_PIN_IN, PortPinInitialMode=GPIO, PortPinMode=GPIO, PortPinOutputDrive=PORT_PIN_OUT_MODE_HIGHZ
              PortPin_P018_3: PortPinId=147, PortPinName=P018_3, PortPinDirection=PORT_PIN_OUT, PortPinInitialMode=TCPWM_0_LINE_54, PortPinMode=TCPWM_0_LINE_54, PortPinOutputDrive=PORT_PIN_OUT_MODE_STRONG
              PortPin_P018_4: PortPinId=148, PortPinName=P018_4, PortPinDirection=PORT_PIN_OUT, PortPinInitialMode=TCPWM_0_LINE_53, PortPinMode=TCPWM_0_LINE_53, PortPinOutputDrive=PORT_PIN_OUT_MODE_STRONG
              PortPin_P018_5: PortPinId=149, PortPinName=P018_5, PortPinDirection=PORT_PIN_IN, PortPinInitialMode=GPIO, PortPinMode=GPIO, PortPinOutputDrive=PORT_PIN_OUT_MODE_HIGHZ
              PortPin_P018_6: PortPinId=150, PortPinName=P018_6, PortPinDirection=PORT_PIN_IN, PortPinInitialMode=GPIO, PortPinMode=GPIO, PortPinOutputDrive=PORT_PIN_OUT_MODE_HIGHZ
              PortPin_P018_7: PortPinId=151, PortPinName=P018_7, PortPinDirection=PORT_PIN_IN, PortPinInitialMode=GPIO, PortPinMode=GPIO, PortPinOutputDrive=PORT_PIN_OUT_MODE_HIGHZ
          PortContainer21: PortId=21, PortNumberOfPortPins=4
            4 x PortPin, all with PortPinLevelValue=PORT_PIN_LEVEL_LOW, PortPinOutputDrive=PORT_PIN_OUT_MODE_HIGHZ, PortPinSmartioBypassEnable=1, PortPinSmartioSyncIoEnable=0, PortPinSmartioSyncChipEnable=0, PortPinSmartioLutTr0Source=PORT_SMART_LUT_TR_DU, PortPinSmartioLutTr1Source=PORT_SMART_LUT_TR_LUT0, PortPinSmartioLutTr2Source=PORT_SMART_LUT_TR_LUT0, PortPinSmartioLut=0, PortPinSmartioLutOperation=PORT_SMART_LUT_OPC_COM_OUT_NO_FB, PortPinInputBufferMode=PORT_PIN_IN_MODE_CMOS, PortPinOutputSlowSlewRateEnable=0, PortPinOutputDriveStrength=PORT_PIN_OUT_STRENGTH_FULL, PortPinOutputDriveSelectTrim=PORT_PIN_OUT_TRIM_DEFAULT, Port5VPinInputBufferMode=PORT_PIN_5V_IN_MODE_CMOS_OR_TTL:
              PortPin_P021_0: PortPinId=168, PortPinName=P021_0, PortPinDirection=PORT_PIN_IN, PortPinDirectionChangeable=1, PortPinOutputInBufEnable=1, PortPinInitialMode=GPIO, PortPinModeChangeable=1, PortPinMode=GPIO
              PortPin_P021_1: PortPinId=169, PortPinName=P021_1, PortPinDirection=PORT_PIN_IN_OUT_DISABLED, PortPinDirectionChangeable=1, PortPinOutputInBufEnable=0, PortPinInitialMode=AMUXA, PortPinModeChangeable=1, PortPinMode=AMUXA
              PortPin_P021_2: PortPinId=170, PortPinName=P021_2, PortPinDirection=PORT_PIN_IN_OUT_DISABLED, PortPinDirectionChangeable=0, PortPinOutputInBufEnable=0, PortPinInitialMode=AMUXA, PortPinModeChangeable=0, PortPinMode=GPIO
              PortPin_P021_3: PortPinId=171, PortPinName=P021_3, PortPinDirection=PORT_PIN_IN_OUT_DISABLED, PortPinDirectionChangeable=0, PortPinOutputInBufEnable=0, PortPinInitialMode=AMUXA, PortPinModeChangeable=0, PortPinMode=GPIO
          PortContainer22: PortId=22, PortNumberOfPortPins=1
            PortPin_P022_0 (PortPin):
              PortPinId = 176
              PortPinName = P022_0
              PortPinDirection = PORT_PIN_OUT
              PortPinDirectionChangeable = 1
              PortPinOutputInBufEnable = 1
              PortPinInitialMode = GPIO
              PortPinModeChangeable = 1
              PortPinMode = GPIO
              PortPinLevelValue = PORT_PIN_LEVEL_LOW
              PortPinOutputDrive = PORT_PIN_OUT_MODE_STRONG
              PortPinSmartioBypassEnable = 1
              PortPinSmartioSyncIoEnable = 0
              PortPinSmartioSyncChipEnable = 0
              PortPinSmartioLutTr0Source = PORT_SMART_LUT_TR_DU
              PortPinSmartioLutTr1Source = PORT_SMART_LUT_TR_LUT0
              PortPinSmartioLutTr2Source = PORT_SMART_LUT_TR_LUT0
              PortPinSmartioLut = 0
              PortPinSmartioLutOperation = PORT_SMART_LUT_OPC_COM_OUT_NO_FB
              PortPinInputBufferMode = PORT_PIN_IN_MODE_CMOS
              PortPinOutputSlowSlewRateEnable = 0
              PortPinOutputDriveStrength = PORT_PIN_OUT_STRENGTH_FULL
              PortPinOutputDriveSelectTrim = PORT_PIN_OUT_TRIM_DEFAULT
              Port5VPinInputBufferMode = PORT_PIN_5V_IN_MODE_CMOS_OR_TTL
          PortContainer23: PortId=23, PortNumberOfPortPins=5
            5 x PortPin, all with PortPinDirectionChangeable=1, PortPinOutputInBufEnable=1, PortPinModeChangeable=1, PortPinMode=GPIO, PortPinLevelValue=PORT_PIN_LEVEL_LOW, PortPinSmartioBypassEnable=1, PortPinSmartioSyncIoEnable=0, PortPinSmartioSyncChipEnable=0, PortPinSmartioLutTr0Source=PORT_SMART_LUT_TR_DU, PortPinSmartioLutTr1Source=PORT_SMART_LUT_TR_LUT0, PortPinSmartioLutTr2Source=PORT_SMART_LUT_TR_LUT0, PortPinSmartioLut=0, PortPinSmartioLutOperation=PORT_SMART_LUT_OPC_COM_OUT_NO_FB, PortPinInputBufferMode=PORT_PIN_IN_MODE_CMOS, PortPinOutputSlowSlewRateEnable=0, PortPinOutputDriveStrength=PORT_PIN_OUT_STRENGTH_FULL, PortPinOutputDriveSelectTrim=PORT_PIN_OUT_TRIM_DEFAULT, Port5VPinInputBufferMode=PORT_PIN_5V_IN_MODE_CMOS_OR_TTL:
              PortPin_P023_3: PortPinId=187, PortPinName=P023_3, PortPinDirection=PORT_PIN_OUT, PortPinInitialMode=GPIO, PortPinOutputDrive=PORT_PIN_OUT_MODE_STRONG
              PortPin_P023_4: PortPinId=188, PortPinName=P023_4, PortPinDirection=PORT_PIN_OUT, PortPinInitialMode=CPUSS_SWJ_SWO_TDO, PortPinOutputDrive=PORT_PIN_OUT_MODE_HIGHZ
              PortPin_P023_5: PortPinId=189, PortPinName=P023_5, PortPinDirection=PORT_PIN_IN, PortPinInitialMode=CPUSS_SWJ_SWCLK_TCLK, PortPinOutputDrive=PORT_PIN_OUT_MODE_HIGHZ
              PortPin_P023_6: PortPinId=190, PortPinName=P023_6, PortPinDirection=PORT_PIN_IN, PortPinInitialMode=CPUSS_SWJ_SWDIO_TMS, PortPinOutputDrive=PORT_PIN_OUT_MODE_HIGHZ
              PortPin_P023_7: PortPinId=191, PortPinName=P023_7, PortPinDirection=PORT_PIN_IN, PortPinInitialMode=CPUSS_SWJ_SWDOE_TDI, PortPinOutputDrive=PORT_PIN_OUT_MODE_HIGHZ
        PortAmuxSplitCell0 (PortAmuxSplitCell):
          PortAmuxSplitCellId = 0
          PortAmuxBusaSwitchSL = PORT_AMUX_SWITCH_OPEN
          PortAmuxBusaSwitchSR = PORT_AMUX_SWITCH_OPEN
          PortAmuxBusaSwitchS0 = PORT_AMUX_SWITCH_OPEN
          PortAmuxBusbSwitchSL = PORT_AMUX_SWITCH_OPEN
          PortAmuxBusbSwitchSR = PORT_AMUX_SWITCH_OPEN
          PortAmuxBusbSwitchS0 = PORT_AMUX_SWITCH_OPEN
      PortConfigSet_NFC_Default
        14 x PortContainer, all with PortSmartioClockSource=PORT_SMART_CLK_SRC_CONST0, PortSmartioDataUnitBitSize=1, PortSmartioDataUnitData0Source=PORT_SMART_DU_DATA_CONST0, PortSmartioDataUnitData1Source=PORT_SMART_DU_DATA_CONST0, PortSmartioDataUnitOperation=PORT_SMART_DU_OPC_INCR, PortSmartioDataUnitSource=0, PortSmartioDataUnitTr0Source=PORT_SMART_DU_TR_CONST0, PortSmartioDataUnitTr1Source=PORT_SMART_DU_TR_CONST0, PortSmartioDataUnitTr2Source=PORT_SMART_DU_TR_CONST0, PortSmartioEnable=0, PortSmartioHoldOverrideEnable=0, PortSmartioPipelineEnable=1:
          PortContainer0: PortId=0, PortNumberOfPortPins=4
            4 x PortPin, all with PortPinDirectionChangeable=1, PortPinOutputInBufEnable=1, PortPinModeChangeable=1, PortPinLevelValue=PORT_PIN_LEVEL_LOW, PortPinSmartioBypassEnable=1, PortPinSmartioSyncIoEnable=0, PortPinSmartioSyncChipEnable=0, PortPinSmartioLutTr0Source=PORT_SMART_LUT_TR_DU, PortPinSmartioLutTr1Source=PORT_SMART_LUT_TR_LUT0, PortPinSmartioLutTr2Source=PORT_SMART_LUT_TR_LUT0, PortPinSmartioLut=0, PortPinSmartioLutOperation=PORT_SMART_LUT_OPC_COM_OUT_NO_FB, PortPinInputBufferMode=PORT_PIN_IN_MODE_CMOS, PortPinOutputSlowSlewRateEnable=0, PortPinOutputDriveStrength=PORT_PIN_OUT_STRENGTH_FULL, PortPinOutputDriveSelectTrim=PORT_PIN_OUT_TRIM_DEFAULT, Port5VPinInputBufferMode=PORT_PIN_5V_IN_MODE_CMOS_OR_TTL:
              PortPin_P000_0: PortPinId=0, PortPinName=P000_0, PortPinDirection=PORT_PIN_IN, PortPinInitialMode=SCB_0_SPI_MISO, PortPinOutputDrive=PORT_PIN_OUT_MODE_HIGHZ, PortPinMode=SCB_0_SPI_MISO
              PortPin_P000_1: PortPinId=1, PortPinName=P000_1, PortPinDirection=PORT_PIN_OUT, PortPinInitialMode=SCB_0_SPI_MOSI, PortPinOutputDrive=PORT_PIN_OUT_MODE_STRONG, PortPinMode=SCB_0_SPI_MOSI
              PortPin_P000_2: PortPinId=2, PortPinName=P000_2, PortPinDirection=PORT_PIN_OUT, PortPinInitialMode=SCB_0_SPI_CLK, PortPinMode=SCB_0_SPI_CLK, PortPinOutputDrive=PORT_PIN_OUT_MODE_STRONG
              PortPin_P000_3: PortPinId=3, PortPinName=P000_3, PortPinDirection=PORT_PIN_OUT, PortPinInitialMode=GPIO, PortPinMode=GPIO, PortPinOutputDrive=PORT_PIN_OUT_MODE_STRONG
          PortContainer2: PortId=2, PortNumberOfPortPins=2
            PortPin_P002_0 (PortPin):
              PortPinId = 16
              PortPinName = P002_0
              PortPinDirection = PORT_PIN_IN_OUT_DISABLED
              PortPinDirectionChangeable = 1
              PortPinOutputInBufEnable = 0
              PortPinInitialMode = AMUXA
              PortPinModeChangeable = 1
              PortPinMode = AMUXA
              PortPinLevelValue = PORT_PIN_LEVEL_LOW
              PortPinOutputDrive = PORT_PIN_OUT_MODE_HIGHZ
              PortPinSmartioBypassEnable = 1
              PortPinSmartioSyncIoEnable = 0
              PortPinSmartioSyncChipEnable = 0
              PortPinSmartioLutTr0Source = PORT_SMART_LUT_TR_DU
              PortPinSmartioLutTr1Source = PORT_SMART_LUT_TR_LUT0
              PortPinSmartioLutTr2Source = PORT_SMART_LUT_TR_LUT0
              PortPinSmartioLut = 0
              PortPinSmartioLutOperation = PORT_SMART_LUT_OPC_COM_OUT_NO_FB
              PortPinInputBufferMode = PORT_PIN_IN_MODE_CMOS
              PortPinOutputSlowSlewRateEnable = 0
              PortPinOutputDriveStrength = PORT_PIN_OUT_STRENGTH_FULL
              PortPinOutputDriveSelectTrim = PORT_PIN_OUT_TRIM_DEFAULT
              Port5VPinInputBufferMode = PORT_PIN_5V_IN_MODE_CMOS_OR_TTL
            PortPin_P002_1 (PortPin):
              PortPinId = 17
              PortPinName = P002_1
              PortPinDirection = PORT_PIN_IN
              PortPinDirectionChangeable = 1
              PortPinOutputInBufEnable = 1
              PortPinInitialMode = GPIO
              PortPinModeChangeable = 1
              PortPinMode = GPIO
              PortPinLevelValue = PORT_PIN_LEVEL_LOW
              PortPinOutputDrive = PORT_PIN_OUT_MODE_HIGHZ
              PortPinSmartioBypassEnable = 1
              PortPinSmartioSyncIoEnable = 0
              PortPinSmartioSyncChipEnable = 0
              PortPinSmartioLutTr0Source = PORT_SMART_LUT_TR_DU
              PortPinSmartioLutTr1Source = PORT_SMART_LUT_TR_LUT0
              PortPinSmartioLutTr2Source = PORT_SMART_LUT_TR_LUT0
              PortPinSmartioLut = 0
              PortPinSmartioLutOperation = PORT_SMART_LUT_OPC_COM_OUT_NO_FB
              PortPinInputBufferMode = PORT_PIN_IN_MODE_CMOS
              PortPinOutputSlowSlewRateEnable = 0
              PortPinOutputDriveStrength = PORT_PIN_OUT_STRENGTH_FULL
              PortPinOutputDriveSelectTrim = PORT_PIN_OUT_TRIM_DEFAULT
              Port5VPinInputBufferMode = PORT_PIN_5V_IN_MODE_CMOS_OR_TTL
          PortContainer5: PortId=5, PortNumberOfPortPins=2
            PortPin_P005_0 (PortPin):
              PortPinId = 40
              PortPinName = P005_0
              PortPinDirection = PORT_PIN_IN_OUT_DISABLED
              PortPinDirectionChangeable = 1
              PortPinOutputInBufEnable = 0
              PortPinInitialMode = AMUXA
              PortPinModeChangeable = 1
              PortPinMode = AMUXA
              PortPinLevelValue = PORT_PIN_LEVEL_LOW
              PortPinOutputDrive = PORT_PIN_OUT_MODE_HIGHZ
              PortPinSmartioBypassEnable = 1
              PortPinSmartioSyncIoEnable = 0
              PortPinSmartioSyncChipEnable = 0
              PortPinSmartioLutTr0Source = PORT_SMART_LUT_TR_DU
              PortPinSmartioLutTr1Source = PORT_SMART_LUT_TR_LUT0
              PortPinSmartioLutTr2Source = PORT_SMART_LUT_TR_LUT0
              PortPinSmartioLut = 0
              PortPinSmartioLutOperation = PORT_SMART_LUT_OPC_COM_OUT_NO_FB
              PortPinInputBufferMode = PORT_PIN_IN_MODE_CMOS
              PortPinOutputSlowSlewRateEnable = 0
              PortPinOutputDriveStrength = PORT_PIN_OUT_STRENGTH_FULL
              PortPinOutputDriveSelectTrim = PORT_PIN_OUT_TRIM_DEFAULT
              Port5VPinInputBufferMode = PORT_PIN_5V_IN_MODE_CMOS_OR_TTL
            PortPin_P005_1 (PortPin):
              PortPinId = 41
              PortPinName = P005_1
              PortPinDirection = PORT_PIN_IN_OUT_DISABLED
              PortPinDirectionChangeable = 1
              PortPinOutputInBufEnable = 0
              PortPinInitialMode = AMUXA
              PortPinModeChangeable = 1
              PortPinMode = AMUXA
              PortPinLevelValue = PORT_PIN_LEVEL_LOW
              PortPinOutputDrive = PORT_PIN_OUT_MODE_HIGHZ
              PortPinSmartioBypassEnable = 1
              PortPinSmartioSyncIoEnable = 0
              PortPinSmartioSyncChipEnable = 0
              PortPinSmartioLutTr0Source = PORT_SMART_LUT_TR_DU
              PortPinSmartioLutTr1Source = PORT_SMART_LUT_TR_LUT0
              PortPinSmartioLutTr2Source = PORT_SMART_LUT_TR_LUT0
              PortPinSmartioLut = 0
              PortPinSmartioLutOperation = PORT_SMART_LUT_OPC_COM_OUT_NO_FB
              PortPinInputBufferMode = PORT_PIN_IN_MODE_CMOS
              PortPinOutputSlowSlewRateEnable = 0
              PortPinOutputDriveStrength = PORT_PIN_OUT_STRENGTH_FULL
              PortPinOutputDriveSelectTrim = PORT_PIN_OUT_TRIM_DEFAULT
              Port5VPinInputBufferMode = PORT_PIN_5V_IN_MODE_CMOS_OR_TTL
          PortContainer6: PortId=6, PortNumberOfPortPins=7
            7 x PortPin, all with PortPinLevelValue=PORT_PIN_LEVEL_LOW, PortPinSmartioBypassEnable=1, PortPinSmartioSyncIoEnable=0, PortPinSmartioSyncChipEnable=0, PortPinSmartioLutTr0Source=PORT_SMART_LUT_TR_DU, PortPinSmartioLutTr1Source=PORT_SMART_LUT_TR_LUT0, PortPinSmartioLutTr2Source=PORT_SMART_LUT_TR_LUT0, PortPinSmartioLut=0, PortPinSmartioLutOperation=PORT_SMART_LUT_OPC_COM_OUT_NO_FB, PortPinInputBufferMode=PORT_PIN_IN_MODE_CMOS, PortPinOutputSlowSlewRateEnable=0, PortPinOutputDriveStrength=PORT_PIN_OUT_STRENGTH_FULL, PortPinOutputDriveSelectTrim=PORT_PIN_OUT_TRIM_DEFAULT, Port5VPinInputBufferMode=PORT_PIN_5V_IN_MODE_CMOS_OR_TTL:
              PortPin_P006_0: PortPinId=48, PortPinName=P006_0, PortPinDirection=PORT_PIN_IN, PortPinDirectionChangeable=1, PortPinOutputInBufEnable=1, PortPinInitialMode=GPIO, PortPinModeChangeable=1, PortPinMode=GPIO, PortPinOutputDrive=PORT_PIN_OUT_MODE_HIGHZ
              PortPin_P006_1: PortPinId=49, PortPinName=P006_1, PortPinDirection=PORT_PIN_IN_OUT_DISABLED, PortPinDirectionChangeable=1, PortPinOutputInBufEnable=0, PortPinInitialMode=AMUXA, PortPinModeChangeable=1, PortPinMode=AMUXA, PortPinOutputDrive=PORT_PIN_OUT_MODE_HIGHZ
              PortPin_P006_2: PortPinId=50, PortPinName=P006_2, PortPinDirection=PORT_PIN_OUT, PortPinDirectionChangeable=0, PortPinOutputInBufEnable=1, PortPinInitialMode=CANFD_0_TTCAN_TX_2, PortPinModeChangeable=0, PortPinOutputDrive=PORT_PIN_OUT_MODE_STRONG, PortPinMode=CANFD_0_TTCAN_TX_2
              PortPin_P006_3: PortPinId=51, PortPinName=P006_3, PortPinDirection=PORT_PIN_IN, PortPinDirectionChangeable=0, PortPinOutputInBufEnable=1, PortPinInitialMode=CANFD_0_TTCAN_RX_2, PortPinModeChangeable=0, PortPinOutputDrive=PORT_PIN_OUT_MODE_HIGHZ, PortPinMode=CANFD_0_TTCAN_RX_2
              PortPin_P006_4: PortPinId=52, PortPinName=P006_4, PortPinDirection=PORT_PIN_OUT, PortPinDirectionChangeable=1, PortPinOutputInBufEnable=1, PortPinInitialMode=GPIO, PortPinModeChangeable=0, PortPinOutputDrive=PORT_PIN_OUT_MODE_STRONG, PortPinMode=GPIO
              PortPin_P006_5: PortPinId=53, PortPinName=P006_5, PortPinDirection=PORT_PIN_IN, PortPinDirectionChangeable=1, PortPinOutputInBufEnable=1, PortPinInitialMode=GPIO, PortPinModeChangeable=1, PortPinMode=GPIO, PortPinOutputDrive=PORT_PIN_OUT_MODE_HIGHZ
              PortPin_P006_6: PortPinId=54, PortPinName=P006_6, PortPinDirection=PORT_PIN_IN, PortPinDirectionChangeable=1, PortPinOutputInBufEnable=1, PortPinInitialMode=GPIO, PortPinModeChangeable=1, PortPinMode=GPIO, PortPinOutputDrive=PORT_PIN_OUT_MODE_HIGHZ
          PortContainer7: PortId=7, PortNumberOfPortPins=3
            3 x PortPin, all with PortPinDirectionChangeable=1, PortPinOutputInBufEnable=1, PortPinInitialMode=GPIO, PortPinMode=GPIO, PortPinLevelValue=PORT_PIN_LEVEL_LOW, PortPinSmartioBypassEnable=1, PortPinSmartioSyncIoEnable=0, PortPinSmartioSyncChipEnable=0, PortPinSmartioLutTr0Source=PORT_SMART_LUT_TR_DU, PortPinSmartioLutTr1Source=PORT_SMART_LUT_TR_LUT0, PortPinSmartioLutTr2Source=PORT_SMART_LUT_TR_LUT0, PortPinSmartioLut=0, PortPinSmartioLutOperation=PORT_SMART_LUT_OPC_COM_OUT_NO_FB, PortPinInputBufferMode=PORT_PIN_IN_MODE_CMOS, PortPinOutputSlowSlewRateEnable=0, PortPinOutputDriveStrength=PORT_PIN_OUT_STRENGTH_FULL, PortPinOutputDriveSelectTrim=PORT_PIN_OUT_TRIM_DEFAULT, Port5VPinInputBufferMode=PORT_PIN_5V_IN_MODE_CMOS_OR_TTL:
              PortPin_P007_0: PortPinId=56, PortPinName=P007_0, PortPinDirection=PORT_PIN_IN, PortPinModeChangeable=1, PortPinOutputDrive=PORT_PIN_OUT_MODE_HIGHZ
              PortPin_P007_1: PortPinId=57, PortPinName=P007_1, PortPinDirection=PORT_PIN_IN, PortPinModeChangeable=1, PortPinOutputDrive=PORT_PIN_OUT_MODE_HIGHZ
              PortPin_P007_2: PortPinId=58, PortPinName=P007_2, PortPinDirection=PORT_PIN_OUT, PortPinModeChangeable=0, PortPinOutputDrive=PORT_PIN_OUT_MODE_STRONG
          PortContainer8: PortId=8, PortNumberOfPortPins=2
            PortPin_P008_0 (PortPin):
              PortPinId = 64
              PortPinName = P008_0
              PortPinDirection = PORT_PIN_OUT
              PortPinDirectionChangeable = 0
              PortPinOutputInBufEnable = 1
              PortPinInitialMode = CANFD_0_TTCAN_TX_0
              PortPinModeChangeable = 0
              PortPinLevelValue = PORT_PIN_LEVEL_LOW
              PortPinOutputDrive = PORT_PIN_OUT_MODE_STRONG
              PortPinSmartioBypassEnable = 1
              PortPinSmartioSyncIoEnable = 0
              PortPinSmartioSyncChipEnable = 0
              PortPinSmartioLutTr0Source = PORT_SMART_LUT_TR_DU
              PortPinSmartioLutTr1Source = PORT_SMART_LUT_TR_LUT0
              PortPinSmartioLutTr2Source = PORT_SMART_LUT_TR_LUT0
              PortPinSmartioLut = 0
              PortPinSmartioLutOperation = PORT_SMART_LUT_OPC_COM_OUT_NO_FB
              PortPinInputBufferMode = PORT_PIN_IN_MODE_CMOS
              PortPinOutputSlowSlewRateEnable = 0
              PortPinOutputDriveStrength = PORT_PIN_OUT_STRENGTH_FULL
              PortPinOutputDriveSelectTrim = PORT_PIN_OUT_TRIM_DEFAULT
              Port5VPinInputBufferMode = PORT_PIN_5V_IN_MODE_CMOS_OR_TTL
              PortPinMode = CANFD_0_TTCAN_TX_0
            PortPin_P008_1 (PortPin):
              PortPinId = 65
              PortPinName = P008_1
              PortPinDirection = PORT_PIN_IN
              PortPinDirectionChangeable = 0
              PortPinOutputInBufEnable = 1
              PortPinInitialMode = CANFD_0_TTCAN_RX_0
              PortPinModeChangeable = 0
              PortPinLevelValue = PORT_PIN_LEVEL_LOW
              PortPinOutputDrive = PORT_PIN_OUT_MODE_HIGHZ
              PortPinSmartioBypassEnable = 1
              PortPinSmartioSyncIoEnable = 0
              PortPinSmartioSyncChipEnable = 0
              PortPinSmartioLutTr0Source = PORT_SMART_LUT_TR_DU
              PortPinSmartioLutTr1Source = PORT_SMART_LUT_TR_LUT0
              PortPinSmartioLutTr2Source = PORT_SMART_LUT_TR_LUT0
              PortPinSmartioLut = 0
              PortPinSmartioLutOperation = PORT_SMART_LUT_OPC_COM_OUT_NO_FB
              PortPinInputBufferMode = PORT_PIN_IN_MODE_CMOS
              PortPinOutputSlowSlewRateEnable = 0
              PortPinOutputDriveStrength = PORT_PIN_OUT_STRENGTH_FULL
              PortPinOutputDriveSelectTrim = PORT_PIN_OUT_TRIM_DEFAULT
              Port5VPinInputBufferMode = PORT_PIN_5V_IN_MODE_CMOS_OR_TTL
              PortPinMode = CANFD_0_TTCAN_RX_0
          PortContainer11: PortId=11, PortNumberOfPortPins=3
            3 x PortPin, all with PortPinDirection=PORT_PIN_IN_OUT_DISABLED, PortPinDirectionChangeable=1, PortPinOutputInBufEnable=0, PortPinInitialMode=AMUXA, PortPinModeChangeable=1, PortPinMode=AMUXA, PortPinLevelValue=PORT_PIN_LEVEL_LOW, PortPinOutputDrive=PORT_PIN_OUT_MODE_HIGHZ, PortPinSmartioBypassEnable=1, PortPinSmartioSyncIoEnable=0, PortPinSmartioSyncChipEnable=0, PortPinSmartioLutTr0Source=PORT_SMART_LUT_TR_DU, PortPinSmartioLutTr1Source=PORT_SMART_LUT_TR_LUT0, PortPinSmartioLutTr2Source=PORT_SMART_LUT_TR_LUT0, PortPinSmartioLut=0, PortPinSmartioLutOperation=PORT_SMART_LUT_OPC_COM_OUT_NO_FB, PortPinInputBufferMode=PORT_PIN_IN_MODE_CMOS, PortPinOutputSlowSlewRateEnable=0, PortPinOutputDriveStrength=PORT_PIN_OUT_STRENGTH_FULL, PortPinOutputDriveSelectTrim=PORT_PIN_OUT_TRIM_DEFAULT, Port5VPinInputBufferMode=PORT_PIN_5V_IN_MODE_CMOS_OR_TTL:
              PortPin_P011_0: PortPinId=88, PortPinName=P011_0
              PortPin_P011_1: PortPinId=89, PortPinName=P011_1
              PortPin_P011_2: PortPinId=90, PortPinName=P011_2
          PortContainer12: PortId=12, PortNumberOfPortPins=2
            PortPin_P012_0 (PortPin):
              PortPinId = 96
              PortPinName = P012_0
              PortPinDirection = PORT_PIN_IN_OUT_DISABLED
              PortPinDirectionChangeable = 1
              PortPinOutputInBufEnable = 0
              PortPinInitialMode = AMUXA
              PortPinModeChangeable = 1
              PortPinMode = AMUXA
              PortPinLevelValue = PORT_PIN_LEVEL_LOW
              PortPinOutputDrive = PORT_PIN_OUT_MODE_HIGHZ
              PortPinSmartioBypassEnable = 1
              PortPinSmartioSyncIoEnable = 0
              PortPinSmartioSyncChipEnable = 0
              PortPinSmartioLutTr0Source = PORT_SMART_LUT_TR_DU
              PortPinSmartioLutTr1Source = PORT_SMART_LUT_TR_LUT0
              PortPinSmartioLutTr2Source = PORT_SMART_LUT_TR_LUT0
              PortPinSmartioLut = 0
              PortPinSmartioLutOperation = PORT_SMART_LUT_OPC_COM_OUT_NO_FB
              PortPinInputBufferMode = PORT_PIN_IN_MODE_CMOS
              PortPinOutputSlowSlewRateEnable = 0
              PortPinOutputDriveStrength = PORT_PIN_OUT_STRENGTH_FULL
              PortPinOutputDriveSelectTrim = PORT_PIN_OUT_TRIM_DEFAULT
              Port5VPinInputBufferMode = PORT_PIN_5V_IN_MODE_CMOS_OR_TTL
            PortPin_P012_1 (PortPin):
              PortPinId = 97
              PortPinName = P012_1
              PortPinDirection = PORT_PIN_IN
              PortPinDirectionChangeable = 1
              PortPinOutputInBufEnable = 1
              PortPinInitialMode = GPIO
              PortPinModeChangeable = 1
              PortPinMode = GPIO
              PortPinLevelValue = PORT_PIN_LEVEL_LOW
              PortPinOutputDrive = PORT_PIN_OUT_MODE_HIGHZ
              PortPinSmartioBypassEnable = 1
              PortPinSmartioSyncIoEnable = 0
              PortPinSmartioSyncChipEnable = 0
              PortPinSmartioLutTr0Source = PORT_SMART_LUT_TR_DU
              PortPinSmartioLutTr1Source = PORT_SMART_LUT_TR_LUT0
              PortPinSmartioLutTr2Source = PORT_SMART_LUT_TR_LUT0
              PortPinSmartioLut = 0
              PortPinSmartioLutOperation = PORT_SMART_LUT_OPC_COM_OUT_NO_FB
              PortPinInputBufferMode = PORT_PIN_IN_MODE_CMOS
              PortPinOutputSlowSlewRateEnable = 0
              PortPinOutputDriveStrength = PORT_PIN_OUT_STRENGTH_FULL
              PortPinOutputDriveSelectTrim = PORT_PIN_OUT_TRIM_DEFAULT
              Port5VPinInputBufferMode = PORT_PIN_5V_IN_MODE_CMOS_OR_TTL
          PortContainer13: PortId=13, PortNumberOfPortPins=4
            4 x PortPin, all with PortPinDirectionChangeable=1, PortPinModeChangeable=1, PortPinLevelValue=PORT_PIN_LEVEL_LOW, PortPinSmartioBypassEnable=1, PortPinSmartioSyncIoEnable=0, PortPinSmartioSyncChipEnable=0, PortPinSmartioLutTr0Source=PORT_SMART_LUT_TR_DU, PortPinSmartioLutTr1Source=PORT_SMART_LUT_TR_LUT0, PortPinSmartioLutTr2Source=PORT_SMART_LUT_TR_LUT0, PortPinSmartioLut=0, PortPinSmartioLutOperation=PORT_SMART_LUT_OPC_COM_OUT_NO_FB, PortPinInputBufferMode=PORT_PIN_IN_MODE_CMOS, PortPinOutputSlowSlewRateEnable=0, PortPinOutputDriveStrength=PORT_PIN_OUT_STRENGTH_FULL, PortPinOutputDriveSelectTrim=PORT_PIN_OUT_TRIM_DEFAULT, Port5VPinInputBufferMode=PORT_PIN_5V_IN_MODE_CMOS_OR_TTL:
              PortPin_P013_0: PortPinId=104, PortPinName=P013_0, PortPinDirection=PORT_PIN_IN_OUT_DISABLED, PortPinOutputInBufEnable=0, PortPinInitialMode=AMUXA, PortPinMode=AMUXA, PortPinOutputDrive=PORT_PIN_OUT_MODE_HIGHZ
              PortPin_P013_1: PortPinId=105, PortPinName=P013_1, PortPinDirection=PORT_PIN_OUT, PortPinOutputInBufEnable=1, PortPinInitialMode=TCPWM_0_LINE_44, PortPinMode=TCPWM_0_LINE_44, PortPinOutputDrive=PORT_PIN_OUT_MODE_STRONG
              PortPin_P013_2: PortPinId=106, PortPinName=P013_2, PortPinDirection=PORT_PIN_IN_OUT_DISABLED, PortPinOutputInBufEnable=0, PortPinInitialMode=AMUXA, PortPinMode=AMUXA, PortPinOutputDrive=PORT_PIN_OUT_MODE_HIGHZ
              PortPin_P013_3: PortPinId=107, PortPinName=P013_3, PortPinDirection=PORT_PIN_OUT, PortPinOutputInBufEnable=1, PortPinInitialMode=TCPWM_0_LINE_45, PortPinMode=TCPWM_0_LINE_45, PortPinOutputDrive=PORT_PIN_OUT_MODE_STRONG
          PortContainer14: PortId=14, PortNumberOfPortPins=3
            3 x PortPin, all with PortPinDirection=PORT_PIN_OUT, PortPinDirectionChangeable=1, PortPinOutputInBufEnable=1, PortPinModeChangeable=1, PortPinLevelValue=PORT_PIN_LEVEL_LOW, PortPinSmartioBypassEnable=1, PortPinSmartioSyncIoEnable=0, PortPinSmartioSyncChipEnable=0, PortPinSmartioLutTr0Source=PORT_SMART_LUT_TR_DU, PortPinSmartioLutTr1Source=PORT_SMART_LUT_TR_LUT0, PortPinSmartioLutTr2Source=PORT_SMART_LUT_TR_LUT0, PortPinSmartioLut=0, PortPinSmartioLutOperation=PORT_SMART_LUT_OPC_COM_OUT_NO_FB, PortPinInputBufferMode=PORT_PIN_IN_MODE_CMOS, PortPinOutputSlowSlewRateEnable=0, PortPinOutputDriveStrength=PORT_PIN_OUT_STRENGTH_FULL, PortPinOutputDriveSelectTrim=PORT_PIN_OUT_TRIM_DEFAULT, Port5VPinInputBufferMode=PORT_PIN_5V_IN_MODE_CMOS_OR_TTL:
              PortPin_P014_0: PortPinId=112, PortPinName=P014_0, PortPinInitialMode=TCPWM_0_LINE_48, PortPinMode=TCPWM_0_LINE_48, PortPinOutputDrive=PORT_PIN_OUT_MODE_STRONG
              PortPin_P014_1: PortPinId=113, PortPinName=P014_1, PortPinInitialMode=SCB_2_I2C_SDA, PortPinMode=SCB_2_I2C_SDA, PortPinOutputDrive=PORT_PIN_OUT_MODE_OD_LOW
              PortPin_P014_2: PortPinId=114, PortPinName=P014_2, PortPinInitialMode=SCB_2_I2C_SCL, PortPinMode=SCB_2_I2C_SCL, PortPinOutputDrive=PORT_PIN_OUT_MODE_OD_LOW
          PortContainer18: PortId=18, PortNumberOfPortPins=7
            7 x PortPin, all with PortPinDirectionChangeable=1, PortPinModeChangeable=1, PortPinLevelValue=PORT_PIN_LEVEL_LOW, PortPinSmartioBypassEnable=1, PortPinSmartioSyncIoEnable=0, PortPinSmartioSyncChipEnable=0, PortPinSmartioLutTr0Source=PORT_SMART_LUT_TR_DU, PortPinSmartioLutTr1Source=PORT_SMART_LUT_TR_LUT0, PortPinSmartioLutTr2Source=PORT_SMART_LUT_TR_LUT0, PortPinSmartioLut=0, PortPinSmartioLutOperation=PORT_SMART_LUT_OPC_COM_OUT_NO_FB, PortPinInputBufferMode=PORT_PIN_IN_MODE_CMOS, PortPinOutputSlowSlewRateEnable=0, PortPinOutputDriveStrength=PORT_PIN_OUT_STRENGTH_FULL, PortPinOutputDriveSelectTrim=PORT_PIN_OUT_TRIM_DEFAULT, Port5VPinInputBufferMode=PORT_PIN_5V_IN_MODE_CMOS_OR_TTL:
              PortPin_P018_0: PortPinId=144, PortPinName=P018_0, PortPinDirection=PORT_PIN_OUT, PortPinOutputInBufEnable=1, PortPinInitialMode=GPIO, PortPinMode=GPIO, PortPinOutputDrive=PORT_PIN_OUT_MODE_STRONG
              PortPin_P018_1: PortPinId=145, PortPinName=P018_1, PortPinDirection=PORT_PIN_IN, PortPinOutputInBufEnable=1, PortPinInitialMode=GPIO, PortPinMode=GPIO, PortPinOutputDrive=PORT_PIN_OUT_MODE_HIGHZ
              PortPin_P018_3: PortPinId=147, PortPinName=P018_3, PortPinDirection=PORT_PIN_IN_OUT_DISABLED, PortPinOutputInBufEnable=0, PortPinInitialMode=AMUXA, PortPinMode=AMUXA, PortPinOutputDrive=PORT_PIN_OUT_MODE_HIGHZ
              PortPin_P018_4: PortPinId=148, PortPinName=P018_4, PortPinDirection=PORT_PIN_IN_OUT_DISABLED, PortPinOutputInBufEnable=0, PortPinInitialMode=AMUXA, PortPinMode=AMUXA, PortPinOutputDrive=PORT_PIN_OUT_MODE_HIGHZ
              PortPin_P018_5: PortPinId=149, PortPinName=P018_5, PortPinDirection=PORT_PIN_IN_OUT_DISABLED, PortPinOutputInBufEnable=0, PortPinInitialMode=AMUXA, PortPinMode=AMUXA, PortPinOutputDrive=PORT_PIN_OUT_MODE_HIGHZ
              PortPin_P018_6: PortPinId=150, PortPinName=P018_6, PortPinDirection=PORT_PIN_IN_OUT_DISABLED, PortPinOutputInBufEnable=0, PortPinInitialMode=AMUXA, PortPinMode=AMUXA, PortPinOutputDrive=PORT_PIN_OUT_MODE_HIGHZ
              PortPin_P018_7: PortPinId=151, PortPinName=P018_7, PortPinDirection=PORT_PIN_IN, PortPinOutputInBufEnable=1, PortPinInitialMode=GPIO, PortPinMode=GPIO, PortPinOutputDrive=PORT_PIN_OUT_MODE_HIGHZ
          PortContainer21: PortId=21, PortNumberOfPortPins=4
            4 x PortPin, all with PortPinLevelValue=PORT_PIN_LEVEL_LOW, PortPinOutputDrive=PORT_PIN_OUT_MODE_HIGHZ, PortPinSmartioBypassEnable=1, PortPinSmartioSyncIoEnable=0, PortPinSmartioSyncChipEnable=0, PortPinSmartioLutTr0Source=PORT_SMART_LUT_TR_DU, PortPinSmartioLutTr1Source=PORT_SMART_LUT_TR_LUT0, PortPinSmartioLutTr2Source=PORT_SMART_LUT_TR_LUT0, PortPinSmartioLut=0, PortPinSmartioLutOperation=PORT_SMART_LUT_OPC_COM_OUT_NO_FB, PortPinInputBufferMode=PORT_PIN_IN_MODE_CMOS, PortPinOutputSlowSlewRateEnable=0, PortPinOutputDriveStrength=PORT_PIN_OUT_STRENGTH_FULL, PortPinOutputDriveSelectTrim=PORT_PIN_OUT_TRIM_DEFAULT, Port5VPinInputBufferMode=PORT_PIN_5V_IN_MODE_CMOS_OR_TTL:
              PortPin_P021_0: PortPinId=168, PortPinName=P021_0, PortPinDirection=PORT_PIN_IN, PortPinDirectionChangeable=1, PortPinOutputInBufEnable=1, PortPinInitialMode=GPIO, PortPinModeChangeable=1, PortPinMode=GPIO
              PortPin_P021_1: PortPinId=169, PortPinName=P021_1, PortPinDirection=PORT_PIN_IN_OUT_DISABLED, PortPinDirectionChangeable=1, PortPinOutputInBufEnable=0, PortPinInitialMode=AMUXA, PortPinModeChangeable=1, PortPinMode=AMUXA
              PortPin_P021_2: PortPinId=170, PortPinName=P021_2, PortPinDirection=PORT_PIN_IN_OUT_DISABLED, PortPinDirectionChangeable=0, PortPinOutputInBufEnable=0, PortPinInitialMode=AMUXA, PortPinModeChangeable=0, PortPinMode=GPIO
              PortPin_P021_3: PortPinId=171, PortPinName=P021_3, PortPinDirection=PORT_PIN_IN_OUT_DISABLED, PortPinDirectionChangeable=0, PortPinOutputInBufEnable=0, PortPinInitialMode=AMUXA, PortPinModeChangeable=0, PortPinMode=GPIO
          PortContainer22: PortId=22, PortNumberOfPortPins=1
            PortPin_P022_0 (PortPin):
              PortPinId = 176
              PortPinName = P022_0
              PortPinDirection = PORT_PIN_OUT
              PortPinDirectionChangeable = 1
              PortPinOutputInBufEnable = 1
              PortPinInitialMode = GPIO
              PortPinModeChangeable = 1
              PortPinMode = GPIO
              PortPinLevelValue = PORT_PIN_LEVEL_LOW
              PortPinOutputDrive = PORT_PIN_OUT_MODE_STRONG
              PortPinSmartioBypassEnable = 1
              PortPinSmartioSyncIoEnable = 0
              PortPinSmartioSyncChipEnable = 0
              PortPinSmartioLutTr0Source = PORT_SMART_LUT_TR_DU
              PortPinSmartioLutTr1Source = PORT_SMART_LUT_TR_LUT0
              PortPinSmartioLutTr2Source = PORT_SMART_LUT_TR_LUT0
              PortPinSmartioLut = 0
              PortPinSmartioLutOperation = PORT_SMART_LUT_OPC_COM_OUT_NO_FB
              PortPinInputBufferMode = PORT_PIN_IN_MODE_CMOS
              PortPinOutputSlowSlewRateEnable = 0
              PortPinOutputDriveStrength = PORT_PIN_OUT_STRENGTH_FULL
              PortPinOutputDriveSelectTrim = PORT_PIN_OUT_TRIM_DEFAULT
              Port5VPinInputBufferMode = PORT_PIN_5V_IN_MODE_CMOS_OR_TTL
          PortContainer23: PortId=23, PortNumberOfPortPins=5
            5 x PortPin, all with PortPinDirectionChangeable=1, PortPinOutputInBufEnable=1, PortPinModeChangeable=1, PortPinMode=GPIO, PortPinLevelValue=PORT_PIN_LEVEL_LOW, PortPinSmartioBypassEnable=1, PortPinSmartioSyncIoEnable=0, PortPinSmartioSyncChipEnable=0, PortPinSmartioLutTr0Source=PORT_SMART_LUT_TR_DU, PortPinSmartioLutTr1Source=PORT_SMART_LUT_TR_LUT0, PortPinSmartioLutTr2Source=PORT_SMART_LUT_TR_LUT0, PortPinSmartioLut=0, PortPinSmartioLutOperation=PORT_SMART_LUT_OPC_COM_OUT_NO_FB, PortPinInputBufferMode=PORT_PIN_IN_MODE_CMOS, PortPinOutputSlowSlewRateEnable=0, PortPinOutputDriveStrength=PORT_PIN_OUT_STRENGTH_FULL, PortPinOutputDriveSelectTrim=PORT_PIN_OUT_TRIM_DEFAULT, Port5VPinInputBufferMode=PORT_PIN_5V_IN_MODE_CMOS_OR_TTL:
              PortPin_P023_3: PortPinId=187, PortPinName=P023_3, PortPinDirection=PORT_PIN_OUT, PortPinInitialMode=GPIO, PortPinOutputDrive=PORT_PIN_OUT_MODE_STRONG
              PortPin_P023_4: PortPinId=188, PortPinName=P023_4, PortPinDirection=PORT_PIN_OUT, PortPinInitialMode=CPUSS_SWJ_SWO_TDO, PortPinOutputDrive=PORT_PIN_OUT_MODE_HIGHZ
              PortPin_P023_5: PortPinId=189, PortPinName=P023_5, PortPinDirection=PORT_PIN_IN, PortPinInitialMode=CPUSS_SWJ_SWCLK_TCLK, PortPinOutputDrive=PORT_PIN_OUT_MODE_HIGHZ
              PortPin_P023_6: PortPinId=190, PortPinName=P023_6, PortPinDirection=PORT_PIN_IN, PortPinInitialMode=CPUSS_SWJ_SWDIO_TMS, PortPinOutputDrive=PORT_PIN_OUT_MODE_HIGHZ
              PortPin_P023_7: PortPinId=191, PortPinName=P023_7, PortPinDirection=PORT_PIN_IN, PortPinInitialMode=CPUSS_SWJ_SWDOE_TDI, PortPinOutputDrive=PORT_PIN_OUT_MODE_HIGHZ
        PortAmuxSplitCell0 (PortAmuxSplitCell):
          PortAmuxSplitCellId = 0
          PortAmuxBusaSwitchSL = PORT_AMUX_SWITCH_OPEN
          PortAmuxBusaSwitchSR = PORT_AMUX_SWITCH_OPEN
          PortAmuxBusaSwitchS0 = PORT_AMUX_SWITCH_OPEN
          PortAmuxBusbSwitchSL = PORT_AMUX_SWITCH_OPEN
          PortAmuxBusbSwitchSR = PORT_AMUX_SWITCH_OPEN
          PortAmuxBusbSwitchS0 = PORT_AMUX_SWITCH_OPEN
      PortConfigSet_NFC_Ani
        14 x PortContainer, all with PortSmartioClockSource=PORT_SMART_CLK_SRC_CONST0, PortSmartioDataUnitBitSize=1, PortSmartioDataUnitData0Source=PORT_SMART_DU_DATA_CONST0, PortSmartioDataUnitData1Source=PORT_SMART_DU_DATA_CONST0, PortSmartioDataUnitOperation=PORT_SMART_DU_OPC_INCR, PortSmartioDataUnitSource=0, PortSmartioDataUnitTr0Source=PORT_SMART_DU_TR_CONST0, PortSmartioDataUnitTr1Source=PORT_SMART_DU_TR_CONST0, PortSmartioDataUnitTr2Source=PORT_SMART_DU_TR_CONST0, PortSmartioEnable=0, PortSmartioHoldOverrideEnable=0, PortSmartioPipelineEnable=1:
          PortContainer0: PortId=0, PortNumberOfPortPins=4
            4 x PortPin, all with PortPinDirectionChangeable=1, PortPinOutputInBufEnable=1, PortPinModeChangeable=1, PortPinLevelValue=PORT_PIN_LEVEL_LOW, PortPinSmartioBypassEnable=1, PortPinSmartioSyncIoEnable=0, PortPinSmartioSyncChipEnable=0, PortPinSmartioLutTr0Source=PORT_SMART_LUT_TR_DU, PortPinSmartioLutTr1Source=PORT_SMART_LUT_TR_LUT0, PortPinSmartioLutTr2Source=PORT_SMART_LUT_TR_LUT0, PortPinSmartioLut=0, PortPinSmartioLutOperation=PORT_SMART_LUT_OPC_COM_OUT_NO_FB, PortPinInputBufferMode=PORT_PIN_IN_MODE_CMOS, PortPinOutputSlowSlewRateEnable=0, PortPinOutputDriveStrength=PORT_PIN_OUT_STRENGTH_FULL, PortPinOutputDriveSelectTrim=PORT_PIN_OUT_TRIM_DEFAULT, Port5VPinInputBufferMode=PORT_PIN_5V_IN_MODE_CMOS_OR_TTL:
              PortPin_P000_0: PortPinId=0, PortPinName=P000_0, PortPinDirection=PORT_PIN_IN, PortPinInitialMode=SCB_0_SPI_MISO, PortPinOutputDrive=PORT_PIN_OUT_MODE_HIGHZ, PortPinMode=SCB_0_SPI_MISO
              PortPin_P000_1: PortPinId=1, PortPinName=P000_1, PortPinDirection=PORT_PIN_OUT, PortPinInitialMode=SCB_0_SPI_MOSI, PortPinOutputDrive=PORT_PIN_OUT_MODE_STRONG, PortPinMode=SCB_0_SPI_MOSI
              PortPin_P000_2: PortPinId=2, PortPinName=P000_2, PortPinDirection=PORT_PIN_OUT, PortPinInitialMode=SCB_0_SPI_CLK, PortPinMode=SCB_0_SPI_CLK, PortPinOutputDrive=PORT_PIN_OUT_MODE_STRONG
              PortPin_P000_3: PortPinId=3, PortPinName=P000_3, PortPinDirection=PORT_PIN_OUT, PortPinInitialMode=GPIO, PortPinMode=GPIO, PortPinOutputDrive=PORT_PIN_OUT_MODE_STRONG
          PortContainer2: PortId=2, PortNumberOfPortPins=2
            PortPin_P002_0 (PortPin):
              PortPinId = 16
              PortPinName = P002_0
              PortPinDirection = PORT_PIN_IN_OUT_DISABLED
              PortPinDirectionChangeable = 1
              PortPinOutputInBufEnable = 0
              PortPinInitialMode = AMUXA
              PortPinModeChangeable = 1
              PortPinMode = AMUXA
              PortPinLevelValue = PORT_PIN_LEVEL_LOW
              PortPinOutputDrive = PORT_PIN_OUT_MODE_HIGHZ
              PortPinSmartioBypassEnable = 1
              PortPinSmartioSyncIoEnable = 0
              PortPinSmartioSyncChipEnable = 0
              PortPinSmartioLutTr0Source = PORT_SMART_LUT_TR_DU
              PortPinSmartioLutTr1Source = PORT_SMART_LUT_TR_LUT0
              PortPinSmartioLutTr2Source = PORT_SMART_LUT_TR_LUT0
              PortPinSmartioLut = 0
              PortPinSmartioLutOperation = PORT_SMART_LUT_OPC_COM_OUT_NO_FB
              PortPinInputBufferMode = PORT_PIN_IN_MODE_CMOS
              PortPinOutputSlowSlewRateEnable = 0
              PortPinOutputDriveStrength = PORT_PIN_OUT_STRENGTH_FULL
              PortPinOutputDriveSelectTrim = PORT_PIN_OUT_TRIM_DEFAULT
              Port5VPinInputBufferMode = PORT_PIN_5V_IN_MODE_CMOS_OR_TTL
            PortPin_P002_1 (PortPin):
              PortPinId = 17
              PortPinName = P002_1
              PortPinDirection = PORT_PIN_IN
              PortPinDirectionChangeable = 1
              PortPinOutputInBufEnable = 1
              PortPinInitialMode = GPIO
              PortPinModeChangeable = 1
              PortPinMode = GPIO
              PortPinLevelValue = PORT_PIN_LEVEL_LOW
              PortPinOutputDrive = PORT_PIN_OUT_MODE_HIGHZ
              PortPinSmartioBypassEnable = 1
              PortPinSmartioSyncIoEnable = 0
              PortPinSmartioSyncChipEnable = 0
              PortPinSmartioLutTr0Source = PORT_SMART_LUT_TR_DU
              PortPinSmartioLutTr1Source = PORT_SMART_LUT_TR_LUT0
              PortPinSmartioLutTr2Source = PORT_SMART_LUT_TR_LUT0
              PortPinSmartioLut = 0
              PortPinSmartioLutOperation = PORT_SMART_LUT_OPC_COM_OUT_NO_FB
              PortPinInputBufferMode = PORT_PIN_IN_MODE_CMOS
              PortPinOutputSlowSlewRateEnable = 0
              PortPinOutputDriveStrength = PORT_PIN_OUT_STRENGTH_FULL
              PortPinOutputDriveSelectTrim = PORT_PIN_OUT_TRIM_DEFAULT
              Port5VPinInputBufferMode = PORT_PIN_5V_IN_MODE_CMOS_OR_TTL
          PortContainer5: PortId=5, PortNumberOfPortPins=2
            PortPin_P005_0 (PortPin):
              PortPinId = 40
              PortPinName = P005_0
              PortPinDirection = PORT_PIN_IN_OUT_DISABLED
              PortPinDirectionChangeable = 1
              PortPinOutputInBufEnable = 0
              PortPinInitialMode = AMUXA
              PortPinModeChangeable = 1
              PortPinMode = AMUXA
              PortPinLevelValue = PORT_PIN_LEVEL_LOW
              PortPinOutputDrive = PORT_PIN_OUT_MODE_HIGHZ
              PortPinSmartioBypassEnable = 1
              PortPinSmartioSyncIoEnable = 0
              PortPinSmartioSyncChipEnable = 0
              PortPinSmartioLutTr0Source = PORT_SMART_LUT_TR_DU
              PortPinSmartioLutTr1Source = PORT_SMART_LUT_TR_LUT0
              PortPinSmartioLutTr2Source = PORT_SMART_LUT_TR_LUT0
              PortPinSmartioLut = 0
              PortPinSmartioLutOperation = PORT_SMART_LUT_OPC_COM_OUT_NO_FB
              PortPinInputBufferMode = PORT_PIN_IN_MODE_CMOS
              PortPinOutputSlowSlewRateEnable = 0
              PortPinOutputDriveStrength = PORT_PIN_OUT_STRENGTH_FULL
              PortPinOutputDriveSelectTrim = PORT_PIN_OUT_TRIM_DEFAULT
              Port5VPinInputBufferMode = PORT_PIN_5V_IN_MODE_CMOS_OR_TTL
            PortPin_P005_1 (PortPin):
              PortPinId = 41
              PortPinName = P005_1
              PortPinDirection = PORT_PIN_IN_OUT_DISABLED
              PortPinDirectionChangeable = 1
              PortPinOutputInBufEnable = 0
              PortPinInitialMode = AMUXA
              PortPinModeChangeable = 1
              PortPinMode = AMUXA
              PortPinLevelValue = PORT_PIN_LEVEL_LOW
              PortPinOutputDrive = PORT_PIN_OUT_MODE_HIGHZ
              PortPinSmartioBypassEnable = 1
              PortPinSmartioSyncIoEnable = 0
              PortPinSmartioSyncChipEnable = 0
              PortPinSmartioLutTr0Source = PORT_SMART_LUT_TR_DU
              PortPinSmartioLutTr1Source = PORT_SMART_LUT_TR_LUT0
              PortPinSmartioLutTr2Source = PORT_SMART_LUT_TR_LUT0
              PortPinSmartioLut = 0
              PortPinSmartioLutOperation = PORT_SMART_LUT_OPC_COM_OUT_NO_FB
              PortPinInputBufferMode = PORT_PIN_IN_MODE_CMOS
              PortPinOutputSlowSlewRateEnable = 0
              PortPinOutputDriveStrength = PORT_PIN_OUT_STRENGTH_FULL
              PortPinOutputDriveSelectTrim = PORT_PIN_OUT_TRIM_DEFAULT
              Port5VPinInputBufferMode = PORT_PIN_5V_IN_MODE_CMOS_OR_TTL
          PortContainer6: PortId=6, PortNumberOfPortPins=7
            7 x PortPin, all with PortPinLevelValue=PORT_PIN_LEVEL_LOW, PortPinSmartioBypassEnable=1, PortPinSmartioSyncIoEnable=0, PortPinSmartioSyncChipEnable=0, PortPinSmartioLutTr0Source=PORT_SMART_LUT_TR_DU, PortPinSmartioLutTr1Source=PORT_SMART_LUT_TR_LUT0, PortPinSmartioLutTr2Source=PORT_SMART_LUT_TR_LUT0, PortPinSmartioLut=0, PortPinSmartioLutOperation=PORT_SMART_LUT_OPC_COM_OUT_NO_FB, PortPinInputBufferMode=PORT_PIN_IN_MODE_CMOS, PortPinOutputSlowSlewRateEnable=0, PortPinOutputDriveStrength=PORT_PIN_OUT_STRENGTH_FULL, PortPinOutputDriveSelectTrim=PORT_PIN_OUT_TRIM_DEFAULT, Port5VPinInputBufferMode=PORT_PIN_5V_IN_MODE_CMOS_OR_TTL:
              PortPin_P006_0: PortPinId=48, PortPinName=P006_0, PortPinDirection=PORT_PIN_IN, PortPinDirectionChangeable=1, PortPinOutputInBufEnable=1, PortPinInitialMode=GPIO, PortPinModeChangeable=1, PortPinMode=GPIO, PortPinOutputDrive=PORT_PIN_OUT_MODE_HIGHZ
              PortPin_P006_1: PortPinId=49, PortPinName=P006_1, PortPinDirection=PORT_PIN_IN_OUT_DISABLED, PortPinDirectionChangeable=1, PortPinOutputInBufEnable=0, PortPinInitialMode=AMUXA, PortPinModeChangeable=1, PortPinMode=AMUXA, PortPinOutputDrive=PORT_PIN_OUT_MODE_HIGHZ
              PortPin_P006_2: PortPinId=50, PortPinName=P006_2, PortPinDirection=PORT_PIN_OUT, PortPinDirectionChangeable=0, PortPinOutputInBufEnable=1, PortPinInitialMode=CANFD_0_TTCAN_TX_2, PortPinModeChangeable=0, PortPinOutputDrive=PORT_PIN_OUT_MODE_STRONG, PortPinMode=CANFD_0_TTCAN_TX_2
              PortPin_P006_3: PortPinId=51, PortPinName=P006_3, PortPinDirection=PORT_PIN_IN, PortPinDirectionChangeable=0, PortPinOutputInBufEnable=1, PortPinInitialMode=CANFD_0_TTCAN_RX_2, PortPinModeChangeable=0, PortPinOutputDrive=PORT_PIN_OUT_MODE_HIGHZ, PortPinMode=CANFD_0_TTCAN_RX_2
              PortPin_P006_4: PortPinId=52, PortPinName=P006_4, PortPinDirection=PORT_PIN_OUT, PortPinDirectionChangeable=1, PortPinOutputInBufEnable=1, PortPinInitialMode=GPIO, PortPinModeChangeable=0, PortPinOutputDrive=PORT_PIN_OUT_MODE_STRONG, PortPinMode=GPIO
              PortPin_P006_5: PortPinId=53, PortPinName=P006_5, PortPinDirection=PORT_PIN_IN, PortPinDirectionChangeable=1, PortPinOutputInBufEnable=1, PortPinInitialMode=GPIO, PortPinModeChangeable=1, PortPinMode=GPIO, PortPinOutputDrive=PORT_PIN_OUT_MODE_HIGHZ
              PortPin_P006_6: PortPinId=54, PortPinName=P006_6, PortPinDirection=PORT_PIN_IN, PortPinDirectionChangeable=1, PortPinOutputInBufEnable=1, PortPinInitialMode=GPIO, PortPinModeChangeable=1, PortPinMode=GPIO, PortPinOutputDrive=PORT_PIN_OUT_MODE_HIGHZ
          PortContainer7: PortId=7, PortNumberOfPortPins=3
            3 x PortPin, all with PortPinDirectionChangeable=1, PortPinOutputInBufEnable=1, PortPinInitialMode=GPIO, PortPinMode=GPIO, PortPinLevelValue=PORT_PIN_LEVEL_LOW, PortPinSmartioBypassEnable=1, PortPinSmartioSyncIoEnable=0, PortPinSmartioSyncChipEnable=0, PortPinSmartioLutTr0Source=PORT_SMART_LUT_TR_DU, PortPinSmartioLutTr1Source=PORT_SMART_LUT_TR_LUT0, PortPinSmartioLutTr2Source=PORT_SMART_LUT_TR_LUT0, PortPinSmartioLut=0, PortPinSmartioLutOperation=PORT_SMART_LUT_OPC_COM_OUT_NO_FB, PortPinInputBufferMode=PORT_PIN_IN_MODE_CMOS, PortPinOutputSlowSlewRateEnable=0, PortPinOutputDriveStrength=PORT_PIN_OUT_STRENGTH_FULL, PortPinOutputDriveSelectTrim=PORT_PIN_OUT_TRIM_DEFAULT, Port5VPinInputBufferMode=PORT_PIN_5V_IN_MODE_CMOS_OR_TTL:
              PortPin_P007_0: PortPinId=56, PortPinName=P007_0, PortPinDirection=PORT_PIN_IN, PortPinModeChangeable=1, PortPinOutputDrive=PORT_PIN_OUT_MODE_HIGHZ
              PortPin_P007_1: PortPinId=57, PortPinName=P007_1, PortPinDirection=PORT_PIN_IN, PortPinModeChangeable=1, PortPinOutputDrive=PORT_PIN_OUT_MODE_HIGHZ
              PortPin_P007_2: PortPinId=58, PortPinName=P007_2, PortPinDirection=PORT_PIN_OUT, PortPinModeChangeable=0, PortPinOutputDrive=PORT_PIN_OUT_MODE_STRONG
          PortContainer8: PortId=8, PortNumberOfPortPins=2
            PortPin_P008_0 (PortPin):
              PortPinId = 64
              PortPinName = P008_0
              PortPinDirection = PORT_PIN_OUT
              PortPinDirectionChangeable = 0
              PortPinOutputInBufEnable = 1
              PortPinInitialMode = CANFD_0_TTCAN_TX_0
              PortPinModeChangeable = 0
              PortPinLevelValue = PORT_PIN_LEVEL_LOW
              PortPinOutputDrive = PORT_PIN_OUT_MODE_STRONG
              PortPinSmartioBypassEnable = 1
              PortPinSmartioSyncIoEnable = 0
              PortPinSmartioSyncChipEnable = 0
              PortPinSmartioLutTr0Source = PORT_SMART_LUT_TR_DU
              PortPinSmartioLutTr1Source = PORT_SMART_LUT_TR_LUT0
              PortPinSmartioLutTr2Source = PORT_SMART_LUT_TR_LUT0
              PortPinSmartioLut = 0
              PortPinSmartioLutOperation = PORT_SMART_LUT_OPC_COM_OUT_NO_FB
              PortPinInputBufferMode = PORT_PIN_IN_MODE_CMOS
              PortPinOutputSlowSlewRateEnable = 0
              PortPinOutputDriveStrength = PORT_PIN_OUT_STRENGTH_FULL
              PortPinOutputDriveSelectTrim = PORT_PIN_OUT_TRIM_DEFAULT
              Port5VPinInputBufferMode = PORT_PIN_5V_IN_MODE_CMOS_OR_TTL
              PortPinMode = CANFD_0_TTCAN_TX_0
            PortPin_P008_1 (PortPin):
              PortPinId = 65
              PortPinName = P008_1
              PortPinDirection = PORT_PIN_IN
              PortPinDirectionChangeable = 0
              PortPinOutputInBufEnable = 1
              PortPinInitialMode = CANFD_0_TTCAN_RX_0
              PortPinModeChangeable = 0
              PortPinLevelValue = PORT_PIN_LEVEL_LOW
              PortPinOutputDrive = PORT_PIN_OUT_MODE_HIGHZ
              PortPinSmartioBypassEnable = 1
              PortPinSmartioSyncIoEnable = 0
              PortPinSmartioSyncChipEnable = 0
              PortPinSmartioLutTr0Source = PORT_SMART_LUT_TR_DU
              PortPinSmartioLutTr1Source = PORT_SMART_LUT_TR_LUT0
              PortPinSmartioLutTr2Source = PORT_SMART_LUT_TR_LUT0
              PortPinSmartioLut = 0
              PortPinSmartioLutOperation = PORT_SMART_LUT_OPC_COM_OUT_NO_FB
              PortPinInputBufferMode = PORT_PIN_IN_MODE_CMOS
              PortPinOutputSlowSlewRateEnable = 0
              PortPinOutputDriveStrength = PORT_PIN_OUT_STRENGTH_FULL
              PortPinOutputDriveSelectTrim = PORT_PIN_OUT_TRIM_DEFAULT
              Port5VPinInputBufferMode = PORT_PIN_5V_IN_MODE_CMOS_OR_TTL
              PortPinMode = CANFD_0_TTCAN_RX_0
          PortContainer11: PortId=11, PortNumberOfPortPins=3
            3 x PortPin, all with PortPinDirection=PORT_PIN_IN_OUT_DISABLED, PortPinDirectionChangeable=1, PortPinOutputInBufEnable=0, PortPinInitialMode=AMUXA, PortPinModeChangeable=1, PortPinMode=AMUXA, PortPinLevelValue=PORT_PIN_LEVEL_LOW, PortPinOutputDrive=PORT_PIN_OUT_MODE_HIGHZ, PortPinSmartioBypassEnable=1, PortPinSmartioSyncIoEnable=0, PortPinSmartioSyncChipEnable=0, PortPinSmartioLutTr0Source=PORT_SMART_LUT_TR_DU, PortPinSmartioLutTr1Source=PORT_SMART_LUT_TR_LUT0, PortPinSmartioLutTr2Source=PORT_SMART_LUT_TR_LUT0, PortPinSmartioLut=0, PortPinSmartioLutOperation=PORT_SMART_LUT_OPC_COM_OUT_NO_FB, PortPinInputBufferMode=PORT_PIN_IN_MODE_CMOS, PortPinOutputSlowSlewRateEnable=0, PortPinOutputDriveStrength=PORT_PIN_OUT_STRENGTH_FULL, PortPinOutputDriveSelectTrim=PORT_PIN_OUT_TRIM_DEFAULT, Port5VPinInputBufferMode=PORT_PIN_5V_IN_MODE_CMOS_OR_TTL:
              PortPin_P011_0: PortPinId=88, PortPinName=P011_0
              PortPin_P011_1: PortPinId=89, PortPinName=P011_1
              PortPin_P011_2: PortPinId=90, PortPinName=P011_2
          PortContainer12: PortId=12, PortNumberOfPortPins=2
            PortPin_P012_0 (PortPin):
              PortPinId = 96
              PortPinName = P012_0
              PortPinDirection = PORT_PIN_IN_OUT_DISABLED
              PortPinDirectionChangeable = 1
              PortPinOutputInBufEnable = 0
              PortPinInitialMode = AMUXA
              PortPinModeChangeable = 1
              PortPinMode = AMUXA
              PortPinLevelValue = PORT_PIN_LEVEL_LOW
              PortPinOutputDrive = PORT_PIN_OUT_MODE_HIGHZ
              PortPinSmartioBypassEnable = 1
              PortPinSmartioSyncIoEnable = 0
              PortPinSmartioSyncChipEnable = 0
              PortPinSmartioLutTr0Source = PORT_SMART_LUT_TR_DU
              PortPinSmartioLutTr1Source = PORT_SMART_LUT_TR_LUT0
              PortPinSmartioLutTr2Source = PORT_SMART_LUT_TR_LUT0
              PortPinSmartioLut = 0
              PortPinSmartioLutOperation = PORT_SMART_LUT_OPC_COM_OUT_NO_FB
              PortPinInputBufferMode = PORT_PIN_IN_MODE_CMOS
              PortPinOutputSlowSlewRateEnable = 0
              PortPinOutputDriveStrength = PORT_PIN_OUT_STRENGTH_FULL
              PortPinOutputDriveSelectTrim = PORT_PIN_OUT_TRIM_DEFAULT
              Port5VPinInputBufferMode = PORT_PIN_5V_IN_MODE_CMOS_OR_TTL
            PortPin_P012_1 (PortPin):
              PortPinId = 97
              PortPinName = P012_1
              PortPinDirection = PORT_PIN_IN
              PortPinDirectionChangeable = 1
              PortPinOutputInBufEnable = 1
              PortPinInitialMode = GPIO
              PortPinModeChangeable = 1
              PortPinMode = GPIO
              PortPinLevelValue = PORT_PIN_LEVEL_LOW
              PortPinOutputDrive = PORT_PIN_OUT_MODE_HIGHZ
              PortPinSmartioBypassEnable = 1
              PortPinSmartioSyncIoEnable = 0
              PortPinSmartioSyncChipEnable = 0
              PortPinSmartioLutTr0Source = PORT_SMART_LUT_TR_DU
              PortPinSmartioLutTr1Source = PORT_SMART_LUT_TR_LUT0
              PortPinSmartioLutTr2Source = PORT_SMART_LUT_TR_LUT0
              PortPinSmartioLut = 0
              PortPinSmartioLutOperation = PORT_SMART_LUT_OPC_COM_OUT_NO_FB
              PortPinInputBufferMode = PORT_PIN_IN_MODE_CMOS
              PortPinOutputSlowSlewRateEnable = 0
              PortPinOutputDriveStrength = PORT_PIN_OUT_STRENGTH_FULL
              PortPinOutputDriveSelectTrim = PORT_PIN_OUT_TRIM_DEFAULT
              Port5VPinInputBufferMode = PORT_PIN_5V_IN_MODE_CMOS_OR_TTL
          PortContainer13: PortId=13, PortNumberOfPortPins=4
            4 x PortPin, all with PortPinDirectionChangeable=1, PortPinModeChangeable=1, PortPinLevelValue=PORT_PIN_LEVEL_LOW, PortPinSmartioBypassEnable=1, PortPinSmartioSyncIoEnable=0, PortPinSmartioSyncChipEnable=0, PortPinSmartioLutTr0Source=PORT_SMART_LUT_TR_DU, PortPinSmartioLutTr1Source=PORT_SMART_LUT_TR_LUT0, PortPinSmartioLutTr2Source=PORT_SMART_LUT_TR_LUT0, PortPinSmartioLut=0, PortPinSmartioLutOperation=PORT_SMART_LUT_OPC_COM_OUT_NO_FB, PortPinInputBufferMode=PORT_PIN_IN_MODE_CMOS, PortPinOutputSlowSlewRateEnable=0, PortPinOutputDriveStrength=PORT_PIN_OUT_STRENGTH_FULL, PortPinOutputDriveSelectTrim=PORT_PIN_OUT_TRIM_DEFAULT, Port5VPinInputBufferMode=PORT_PIN_5V_IN_MODE_CMOS_OR_TTL:
              PortPin_P013_0: PortPinId=104, PortPinName=P013_0, PortPinDirection=PORT_PIN_IN_OUT_DISABLED, PortPinOutputInBufEnable=0, PortPinInitialMode=AMUXA, PortPinMode=AMUXA, PortPinOutputDrive=PORT_PIN_OUT_MODE_HIGHZ
              PortPin_P013_1: PortPinId=105, PortPinName=P013_1, PortPinDirection=PORT_PIN_OUT, PortPinOutputInBufEnable=1, PortPinInitialMode=TCPWM_0_LINE_44, PortPinMode=TCPWM_0_LINE_44, PortPinOutputDrive=PORT_PIN_OUT_MODE_STRONG
              PortPin_P013_2: PortPinId=106, PortPinName=P013_2, PortPinDirection=PORT_PIN_IN_OUT_DISABLED, PortPinOutputInBufEnable=0, PortPinInitialMode=AMUXA, PortPinMode=AMUXA, PortPinOutputDrive=PORT_PIN_OUT_MODE_HIGHZ
              PortPin_P013_3: PortPinId=107, PortPinName=P013_3, PortPinDirection=PORT_PIN_OUT, PortPinOutputInBufEnable=1, PortPinInitialMode=TCPWM_0_LINE_45, PortPinMode=TCPWM_0_LINE_45, PortPinOutputDrive=PORT_PIN_OUT_MODE_STRONG
          PortContainer14: PortId=14, PortNumberOfPortPins=3
            3 x PortPin, all with PortPinDirection=PORT_PIN_OUT, PortPinDirectionChangeable=1, PortPinOutputInBufEnable=1, PortPinModeChangeable=1, PortPinLevelValue=PORT_PIN_LEVEL_LOW, PortPinSmartioBypassEnable=1, PortPinSmartioSyncIoEnable=0, PortPinSmartioSyncChipEnable=0, PortPinSmartioLutTr0Source=PORT_SMART_LUT_TR_DU, PortPinSmartioLutTr1Source=PORT_SMART_LUT_TR_LUT0, PortPinSmartioLutTr2Source=PORT_SMART_LUT_TR_LUT0, PortPinSmartioLut=0, PortPinSmartioLutOperation=PORT_SMART_LUT_OPC_COM_OUT_NO_FB, PortPinInputBufferMode=PORT_PIN_IN_MODE_CMOS, PortPinOutputSlowSlewRateEnable=0, PortPinOutputDriveStrength=PORT_PIN_OUT_STRENGTH_FULL, PortPinOutputDriveSelectTrim=PORT_PIN_OUT_TRIM_DEFAULT, Port5VPinInputBufferMode=PORT_PIN_5V_IN_MODE_CMOS_OR_TTL:
              PortPin_P014_0: PortPinId=112, PortPinName=P014_0, PortPinInitialMode=TCPWM_0_LINE_48, PortPinMode=TCPWM_0_LINE_48, PortPinOutputDrive=PORT_PIN_OUT_MODE_STRONG
              PortPin_P014_1: PortPinId=113, PortPinName=P014_1, PortPinInitialMode=SCB_2_I2C_SDA, PortPinMode=SCB_2_I2C_SDA, PortPinOutputDrive=PORT_PIN_OUT_MODE_OD_LOW
              PortPin_P014_2: PortPinId=114, PortPinName=P014_2, PortPinInitialMode=SCB_2_I2C_SCL, PortPinMode=SCB_2_I2C_SCL, PortPinOutputDrive=PORT_PIN_OUT_MODE_OD_LOW
          PortContainer18: PortId=18, PortNumberOfPortPins=7
            7 x PortPin, all with PortPinDirectionChangeable=1, PortPinModeChangeable=1, PortPinLevelValue=PORT_PIN_LEVEL_LOW, PortPinSmartioBypassEnable=1, PortPinSmartioSyncIoEnable=0, PortPinSmartioSyncChipEnable=0, PortPinSmartioLutTr0Source=PORT_SMART_LUT_TR_DU, PortPinSmartioLutTr1Source=PORT_SMART_LUT_TR_LUT0, PortPinSmartioLutTr2Source=PORT_SMART_LUT_TR_LUT0, PortPinSmartioLut=0, PortPinSmartioLutOperation=PORT_SMART_LUT_OPC_COM_OUT_NO_FB, PortPinInputBufferMode=PORT_PIN_IN_MODE_CMOS, PortPinOutputSlowSlewRateEnable=0, PortPinOutputDriveStrength=PORT_PIN_OUT_STRENGTH_FULL, PortPinOutputDriveSelectTrim=PORT_PIN_OUT_TRIM_DEFAULT, Port5VPinInputBufferMode=PORT_PIN_5V_IN_MODE_CMOS_OR_TTL:
              PortPin_P018_0: PortPinId=144, PortPinName=P018_0, PortPinDirection=PORT_PIN_OUT, PortPinOutputInBufEnable=1, PortPinInitialMode=GPIO, PortPinMode=GPIO, PortPinOutputDrive=PORT_PIN_OUT_MODE_STRONG
              PortPin_P018_1: PortPinId=145, PortPinName=P018_1, PortPinDirection=PORT_PIN_IN, PortPinOutputInBufEnable=1, PortPinInitialMode=GPIO, PortPinMode=GPIO, PortPinOutputDrive=PORT_PIN_OUT_MODE_HIGHZ
              PortPin_P018_3: PortPinId=147, PortPinName=P018_3, PortPinDirection=PORT_PIN_OUT, PortPinOutputInBufEnable=1, PortPinInitialMode=TCPWM_0_LINE_54, PortPinMode=TCPWM_0_LINE_54, PortPinOutputDrive=PORT_PIN_OUT_MODE_STRONG
              PortPin_P018_4: PortPinId=148, PortPinName=P018_4, PortPinDirection=PORT_PIN_OUT, PortPinOutputInBufEnable=1, PortPinInitialMode=TCPWM_0_LINE_53, PortPinMode=TCPWM_0_LINE_53, PortPinOutputDrive=PORT_PIN_OUT_MODE_STRONG
              PortPin_P018_5: PortPinId=149, PortPinName=P018_5, PortPinDirection=PORT_PIN_IN_OUT_DISABLED, PortPinOutputInBufEnable=0, PortPinInitialMode=AMUXA, PortPinMode=AMUXA, PortPinOutputDrive=PORT_PIN_OUT_MODE_HIGHZ
              PortPin_P018_6: PortPinId=150, PortPinName=P018_6, PortPinDirection=PORT_PIN_IN_OUT_DISABLED, PortPinOutputInBufEnable=0, PortPinInitialMode=AMUXA, PortPinMode=AMUXA, PortPinOutputDrive=PORT_PIN_OUT_MODE_HIGHZ
              PortPin_P018_7: PortPinId=151, PortPinName=P018_7, PortPinDirection=PORT_PIN_IN, PortPinOutputInBufEnable=1, PortPinInitialMode=GPIO, PortPinMode=GPIO, PortPinOutputDrive=PORT_PIN_OUT_MODE_HIGHZ
          PortContainer21: PortId=21, PortNumberOfPortPins=4
            4 x PortPin, all with PortPinLevelValue=PORT_PIN_LEVEL_LOW, PortPinOutputDrive=PORT_PIN_OUT_MODE_HIGHZ, PortPinSmartioBypassEnable=1, PortPinSmartioSyncIoEnable=0, PortPinSmartioSyncChipEnable=0, PortPinSmartioLutTr0Source=PORT_SMART_LUT_TR_DU, PortPinSmartioLutTr1Source=PORT_SMART_LUT_TR_LUT0, PortPinSmartioLutTr2Source=PORT_SMART_LUT_TR_LUT0, PortPinSmartioLut=0, PortPinSmartioLutOperation=PORT_SMART_LUT_OPC_COM_OUT_NO_FB, PortPinInputBufferMode=PORT_PIN_IN_MODE_CMOS, PortPinOutputSlowSlewRateEnable=0, PortPinOutputDriveStrength=PORT_PIN_OUT_STRENGTH_FULL, PortPinOutputDriveSelectTrim=PORT_PIN_OUT_TRIM_DEFAULT, Port5VPinInputBufferMode=PORT_PIN_5V_IN_MODE_CMOS_OR_TTL:
              PortPin_P021_0: PortPinId=168, PortPinName=P021_0, PortPinDirection=PORT_PIN_IN, PortPinDirectionChangeable=1, PortPinOutputInBufEnable=1, PortPinInitialMode=GPIO, PortPinModeChangeable=1, PortPinMode=GPIO
              PortPin_P021_1: PortPinId=169, PortPinName=P021_1, PortPinDirection=PORT_PIN_IN_OUT_DISABLED, PortPinDirectionChangeable=1, PortPinOutputInBufEnable=0, PortPinInitialMode=AMUXA, PortPinModeChangeable=1, PortPinMode=AMUXA
              PortPin_P021_2: PortPinId=170, PortPinName=P021_2, PortPinDirection=PORT_PIN_IN_OUT_DISABLED, PortPinDirectionChangeable=0, PortPinOutputInBufEnable=0, PortPinInitialMode=AMUXA, PortPinModeChangeable=0, PortPinMode=GPIO
              PortPin_P021_3: PortPinId=171, PortPinName=P021_3, PortPinDirection=PORT_PIN_IN_OUT_DISABLED, PortPinDirectionChangeable=0, PortPinOutputInBufEnable=0, PortPinInitialMode=AMUXA, PortPinModeChangeable=0, PortPinMode=GPIO
          PortContainer22: PortId=22, PortNumberOfPortPins=1
            PortPin_P022_0 (PortPin):
              PortPinId = 176
              PortPinName = P022_0
              PortPinDirection = PORT_PIN_OUT
              PortPinDirectionChangeable = 1
              PortPinOutputInBufEnable = 1
              PortPinInitialMode = GPIO
              PortPinModeChangeable = 1
              PortPinMode = GPIO
              PortPinLevelValue = PORT_PIN_LEVEL_LOW
              PortPinOutputDrive = PORT_PIN_OUT_MODE_STRONG
              PortPinSmartioBypassEnable = 1
              PortPinSmartioSyncIoEnable = 0
              PortPinSmartioSyncChipEnable = 0
              PortPinSmartioLutTr0Source = PORT_SMART_LUT_TR_DU
              PortPinSmartioLutTr1Source = PORT_SMART_LUT_TR_LUT0
              PortPinSmartioLutTr2Source = PORT_SMART_LUT_TR_LUT0
              PortPinSmartioLut = 0
              PortPinSmartioLutOperation = PORT_SMART_LUT_OPC_COM_OUT_NO_FB
              PortPinInputBufferMode = PORT_PIN_IN_MODE_CMOS
              PortPinOutputSlowSlewRateEnable = 0
              PortPinOutputDriveStrength = PORT_PIN_OUT_STRENGTH_FULL
              PortPinOutputDriveSelectTrim = PORT_PIN_OUT_TRIM_DEFAULT
              Port5VPinInputBufferMode = PORT_PIN_5V_IN_MODE_CMOS_OR_TTL
          PortContainer23: PortId=23, PortNumberOfPortPins=5
            5 x PortPin, all with PortPinDirectionChangeable=1, PortPinOutputInBufEnable=1, PortPinModeChangeable=1, PortPinMode=GPIO, PortPinLevelValue=PORT_PIN_LEVEL_LOW, PortPinSmartioBypassEnable=1, PortPinSmartioSyncIoEnable=0, PortPinSmartioSyncChipEnable=0, PortPinSmartioLutTr0Source=PORT_SMART_LUT_TR_DU, PortPinSmartioLutTr1Source=PORT_SMART_LUT_TR_LUT0, PortPinSmartioLutTr2Source=PORT_SMART_LUT_TR_LUT0, PortPinSmartioLut=0, PortPinSmartioLutOperation=PORT_SMART_LUT_OPC_COM_OUT_NO_FB, PortPinInputBufferMode=PORT_PIN_IN_MODE_CMOS, PortPinOutputSlowSlewRateEnable=0, PortPinOutputDriveStrength=PORT_PIN_OUT_STRENGTH_FULL, PortPinOutputDriveSelectTrim=PORT_PIN_OUT_TRIM_DEFAULT, Port5VPinInputBufferMode=PORT_PIN_5V_IN_MODE_CMOS_OR_TTL:
              PortPin_P023_3: PortPinId=187, PortPinName=P023_3, PortPinDirection=PORT_PIN_OUT, PortPinInitialMode=GPIO, PortPinOutputDrive=PORT_PIN_OUT_MODE_STRONG
              PortPin_P023_4: PortPinId=188, PortPinName=P023_4, PortPinDirection=PORT_PIN_OUT, PortPinInitialMode=CPUSS_SWJ_SWO_TDO, PortPinOutputDrive=PORT_PIN_OUT_MODE_HIGHZ
              PortPin_P023_5: PortPinId=189, PortPinName=P023_5, PortPinDirection=PORT_PIN_IN, PortPinInitialMode=CPUSS_SWJ_SWCLK_TCLK, PortPinOutputDrive=PORT_PIN_OUT_MODE_HIGHZ
              PortPin_P023_6: PortPinId=190, PortPinName=P023_6, PortPinDirection=PORT_PIN_IN, PortPinInitialMode=CPUSS_SWJ_SWDIO_TMS, PortPinOutputDrive=PORT_PIN_OUT_MODE_HIGHZ
              PortPin_P023_7: PortPinId=191, PortPinName=P023_7, PortPinDirection=PORT_PIN_IN, PortPinInitialMode=CPUSS_SWJ_SWDOE_TDI, PortPinOutputDrive=PORT_PIN_OUT_MODE_HIGHZ
        PortAmuxSplitCell0 (PortAmuxSplitCell):
          PortAmuxSplitCellId = 0
          PortAmuxBusaSwitchSL = PORT_AMUX_SWITCH_OPEN
          PortAmuxBusaSwitchSR = PORT_AMUX_SWITCH_OPEN
          PortAmuxBusaSwitchS0 = PORT_AMUX_SWITCH_OPEN
          PortAmuxBusbSwitchSL = PORT_AMUX_SWITCH_OPEN
          PortAmuxBusbSwitchSR = PORT_AMUX_SWITCH_OPEN
          PortAmuxBusbSwitchS0 = PORT_AMUX_SWITCH_OPEN
      PortConfigSet_NoneNFC_Default
        14 x PortContainer, all with PortSmartioClockSource=PORT_SMART_CLK_SRC_CONST0, PortSmartioDataUnitBitSize=1, PortSmartioDataUnitData0Source=PORT_SMART_DU_DATA_CONST0, PortSmartioDataUnitData1Source=PORT_SMART_DU_DATA_CONST0, PortSmartioDataUnitOperation=PORT_SMART_DU_OPC_INCR, PortSmartioDataUnitSource=0, PortSmartioDataUnitTr0Source=PORT_SMART_DU_TR_CONST0, PortSmartioDataUnitTr1Source=PORT_SMART_DU_TR_CONST0, PortSmartioDataUnitTr2Source=PORT_SMART_DU_TR_CONST0, PortSmartioEnable=0, PortSmartioHoldOverrideEnable=0, PortSmartioPipelineEnable=1:
          PortContainer0: PortId=0, PortNumberOfPortPins=4
            4 x PortPin, all with PortPinDirection=PORT_PIN_IN_OUT_DISABLED, PortPinDirectionChangeable=1, PortPinOutputInBufEnable=0, PortPinInitialMode=AMUXA, PortPinModeChangeable=1, PortPinLevelValue=PORT_PIN_LEVEL_LOW, PortPinOutputDrive=PORT_PIN_OUT_MODE_HIGHZ, PortPinSmartioBypassEnable=1, PortPinSmartioSyncIoEnable=0, PortPinSmartioSyncChipEnable=0, PortPinSmartioLutTr0Source=PORT_SMART_LUT_TR_DU, PortPinSmartioLutTr1Source=PORT_SMART_LUT_TR_LUT0, PortPinSmartioLutTr2Source=PORT_SMART_LUT_TR_LUT0, PortPinSmartioLut=0, PortPinSmartioLutOperation=PORT_SMART_LUT_OPC_COM_OUT_NO_FB, PortPinInputBufferMode=PORT_PIN_IN_MODE_CMOS, PortPinOutputSlowSlewRateEnable=0, PortPinOutputDriveStrength=PORT_PIN_OUT_STRENGTH_FULL, PortPinOutputDriveSelectTrim=PORT_PIN_OUT_TRIM_DEFAULT, Port5VPinInputBufferMode=PORT_PIN_5V_IN_MODE_CMOS_OR_TTL, PortPinMode=AMUXA:
              PortPin_P000_{0..3}: PortPinId={0..3}, PortPinName=P000_{0..3}
          PortContainer2: PortId=2, PortNumberOfPortPins=2
            PortPin_P002_0 (PortPin):
              PortPinId = 16
              PortPinName = P002_0
              PortPinDirection = PORT_PIN_IN_OUT_DISABLED
              PortPinDirectionChangeable = 1
              PortPinOutputInBufEnable = 0
              PortPinInitialMode = AMUXA
              PortPinModeChangeable = 1
              PortPinMode = AMUXA
              PortPinLevelValue = PORT_PIN_LEVEL_LOW
              PortPinOutputDrive = PORT_PIN_OUT_MODE_HIGHZ
              PortPinSmartioBypassEnable = 1
              PortPinSmartioSyncIoEnable = 0
              PortPinSmartioSyncChipEnable = 0
              PortPinSmartioLutTr0Source = PORT_SMART_LUT_TR_DU
              PortPinSmartioLutTr1Source = PORT_SMART_LUT_TR_LUT0
              PortPinSmartioLutTr2Source = PORT_SMART_LUT_TR_LUT0
              PortPinSmartioLut = 0
              PortPinSmartioLutOperation = PORT_SMART_LUT_OPC_COM_OUT_NO_FB
              PortPinInputBufferMode = PORT_PIN_IN_MODE_CMOS
              PortPinOutputSlowSlewRateEnable = 0
              PortPinOutputDriveStrength = PORT_PIN_OUT_STRENGTH_FULL
              PortPinOutputDriveSelectTrim = PORT_PIN_OUT_TRIM_DEFAULT
              Port5VPinInputBufferMode = PORT_PIN_5V_IN_MODE_CMOS_OR_TTL
            PortPin_P002_1 (PortPin):
              PortPinId = 17
              PortPinName = P002_1
              PortPinDirection = PORT_PIN_IN_OUT_DISABLED
              PortPinDirectionChangeable = 1
              PortPinOutputInBufEnable = 0
              PortPinInitialMode = AMUXA
              PortPinModeChangeable = 1
              PortPinMode = AMUXA
              PortPinLevelValue = PORT_PIN_LEVEL_LOW
              PortPinOutputDrive = PORT_PIN_OUT_MODE_HIGHZ
              PortPinSmartioBypassEnable = 1
              PortPinSmartioSyncIoEnable = 0
              PortPinSmartioSyncChipEnable = 0
              PortPinSmartioLutTr0Source = PORT_SMART_LUT_TR_DU
              PortPinSmartioLutTr1Source = PORT_SMART_LUT_TR_LUT0
              PortPinSmartioLutTr2Source = PORT_SMART_LUT_TR_LUT0
              PortPinSmartioLut = 0
              PortPinSmartioLutOperation = PORT_SMART_LUT_OPC_COM_OUT_NO_FB
              PortPinInputBufferMode = PORT_PIN_IN_MODE_CMOS
              PortPinOutputSlowSlewRateEnable = 0
              PortPinOutputDriveStrength = PORT_PIN_OUT_STRENGTH_FULL
              PortPinOutputDriveSelectTrim = PORT_PIN_OUT_TRIM_DEFAULT
              Port5VPinInputBufferMode = PORT_PIN_5V_IN_MODE_CMOS_OR_TTL
          PortContainer5: PortId=5, PortNumberOfPortPins=2
            PortPin_P005_0 (PortPin):
              PortPinId = 40
              PortPinName = P005_0
              PortPinDirection = PORT_PIN_IN_OUT_DISABLED
              PortPinDirectionChangeable = 1
              PortPinOutputInBufEnable = 0
              PortPinInitialMode = AMUXA
              PortPinModeChangeable = 1
              PortPinMode = AMUXA
              PortPinLevelValue = PORT_PIN_LEVEL_LOW
              PortPinOutputDrive = PORT_PIN_OUT_MODE_HIGHZ
              PortPinSmartioBypassEnable = 1
              PortPinSmartioSyncIoEnable = 0
              PortPinSmartioSyncChipEnable = 0
              PortPinSmartioLutTr0Source = PORT_SMART_LUT_TR_DU
              PortPinSmartioLutTr1Source = PORT_SMART_LUT_TR_LUT0
              PortPinSmartioLutTr2Source = PORT_SMART_LUT_TR_LUT0
              PortPinSmartioLut = 0
              PortPinSmartioLutOperation = PORT_SMART_LUT_OPC_COM_OUT_NO_FB
              PortPinInputBufferMode = PORT_PIN_IN_MODE_CMOS
              PortPinOutputSlowSlewRateEnable = 0
              PortPinOutputDriveStrength = PORT_PIN_OUT_STRENGTH_FULL
              PortPinOutputDriveSelectTrim = PORT_PIN_OUT_TRIM_DEFAULT
              Port5VPinInputBufferMode = PORT_PIN_5V_IN_MODE_CMOS_OR_TTL
            PortPin_P005_1 (PortPin):
              PortPinId = 41
              PortPinName = P005_1
              PortPinDirection = PORT_PIN_IN_OUT_DISABLED
              PortPinDirectionChangeable = 1
              PortPinOutputInBufEnable = 0
              PortPinInitialMode = AMUXA
              PortPinModeChangeable = 1
              PortPinMode = AMUXA
              PortPinLevelValue = PORT_PIN_LEVEL_LOW
              PortPinOutputDrive = PORT_PIN_OUT_MODE_HIGHZ
              PortPinSmartioBypassEnable = 1
              PortPinSmartioSyncIoEnable = 0
              PortPinSmartioSyncChipEnable = 0
              PortPinSmartioLutTr0Source = PORT_SMART_LUT_TR_DU
              PortPinSmartioLutTr1Source = PORT_SMART_LUT_TR_LUT0
              PortPinSmartioLutTr2Source = PORT_SMART_LUT_TR_LUT0
              PortPinSmartioLut = 0
              PortPinSmartioLutOperation = PORT_SMART_LUT_OPC_COM_OUT_NO_FB
              PortPinInputBufferMode = PORT_PIN_IN_MODE_CMOS
              PortPinOutputSlowSlewRateEnable = 0
              PortPinOutputDriveStrength = PORT_PIN_OUT_STRENGTH_FULL
              PortPinOutputDriveSelectTrim = PORT_PIN_OUT_TRIM_DEFAULT
              Port5VPinInputBufferMode = PORT_PIN_5V_IN_MODE_CMOS_OR_TTL
          PortContainer6: PortId=6, PortNumberOfPortPins=7
            7 x PortPin, all with PortPinLevelValue=PORT_PIN_LEVEL_LOW, PortPinSmartioBypassEnable=1, PortPinSmartioSyncIoEnable=0, PortPinSmartioSyncChipEnable=0, PortPinSmartioLutTr0Source=PORT_SMART_LUT_TR_DU, PortPinSmartioLutTr1Source=PORT_SMART_LUT_TR_LUT0, PortPinSmartioLutTr2Source=PORT_SMART_LUT_TR_LUT0, PortPinSmartioLut=0, PortPinSmartioLutOperation=PORT_SMART_LUT_OPC_COM_OUT_NO_FB, PortPinInputBufferMode=PORT_PIN_IN_MODE_CMOS, PortPinOutputSlowSlewRateEnable=0, PortPinOutputDriveStrength=PORT_PIN_OUT_STRENGTH_FULL, PortPinOutputDriveSelectTrim=PORT_PIN_OUT_TRIM_DEFAULT, Port5VPinInputBufferMode=PORT_PIN_5V_IN_MODE_CMOS_OR_TTL:
              PortPin_P006_0: PortPinId=48, PortPinName=P006_0, PortPinDirection=PORT_PIN_IN, PortPinDirectionChangeable=1, PortPinOutputInBufEnable=1, PortPinInitialMode=GPIO, PortPinModeChangeable=1, PortPinMode=GPIO, PortPinOutputDrive=PORT_PIN_OUT_MODE_HIGHZ
              PortPin_P006_1: PortPinId=49, PortPinName=P006_1, PortPinDirection=PORT_PIN_IN_OUT_DISABLED, PortPinDirectionChangeable=1, PortPinOutputInBufEnable=0, PortPinInitialMode=AMUXA, PortPinModeChangeable=1, PortPinMode=AMUXA, PortPinOutputDrive=PORT_PIN_OUT_MODE_HIGHZ
              PortPin_P006_2: PortPinId=50, PortPinName=P006_2, PortPinDirection=PORT_PIN_OUT, PortPinDirectionChangeable=0, PortPinOutputInBufEnable=1, PortPinInitialMode=CANFD_0_TTCAN_TX_2, PortPinModeChangeable=0, PortPinOutputDrive=PORT_PIN_OUT_MODE_STRONG, PortPinMode=CANFD_0_TTCAN_TX_2
              PortPin_P006_3: PortPinId=51, PortPinName=P006_3, PortPinDirection=PORT_PIN_IN, PortPinDirectionChangeable=0, PortPinOutputInBufEnable=1, PortPinInitialMode=CANFD_0_TTCAN_RX_2, PortPinModeChangeable=0, PortPinOutputDrive=PORT_PIN_OUT_MODE_HIGHZ, PortPinMode=CANFD_0_TTCAN_RX_2
              PortPin_P006_4: PortPinId=52, PortPinName=P006_4, PortPinDirection=PORT_PIN_OUT, PortPinDirectionChangeable=1, PortPinOutputInBufEnable=1, PortPinInitialMode=GPIO, PortPinModeChangeable=0, PortPinOutputDrive=PORT_PIN_OUT_MODE_STRONG, PortPinMode=GPIO
              PortPin_P006_5: PortPinId=53, PortPinName=P006_5, PortPinDirection=PORT_PIN_IN, PortPinDirectionChangeable=1, PortPinOutputInBufEnable=1, PortPinInitialMode=GPIO, PortPinModeChangeable=1, PortPinMode=GPIO, PortPinOutputDrive=PORT_PIN_OUT_MODE_HIGHZ
              PortPin_P006_6: PortPinId=54, PortPinName=P006_6, PortPinDirection=PORT_PIN_IN, PortPinDirectionChangeable=1, PortPinOutputInBufEnable=1, PortPinInitialMode=GPIO, PortPinModeChangeable=1, PortPinMode=GPIO, PortPinOutputDrive=PORT_PIN_OUT_MODE_HIGHZ
          PortContainer7: PortId=7, PortNumberOfPortPins=3
            3 x PortPin, all with PortPinDirectionChangeable=1, PortPinLevelValue=PORT_PIN_LEVEL_LOW, PortPinOutputDrive=PORT_PIN_OUT_MODE_HIGHZ, PortPinSmartioBypassEnable=1, PortPinSmartioSyncIoEnable=0, PortPinSmartioSyncChipEnable=0, PortPinSmartioLutTr0Source=PORT_SMART_LUT_TR_DU, PortPinSmartioLutTr1Source=PORT_SMART_LUT_TR_LUT0, PortPinSmartioLutTr2Source=PORT_SMART_LUT_TR_LUT0, PortPinSmartioLut=0, PortPinSmartioLutOperation=PORT_SMART_LUT_OPC_COM_OUT_NO_FB, PortPinInputBufferMode=PORT_PIN_IN_MODE_CMOS, PortPinOutputSlowSlewRateEnable=0, PortPinOutputDriveStrength=PORT_PIN_OUT_STRENGTH_FULL, PortPinOutputDriveSelectTrim=PORT_PIN_OUT_TRIM_DEFAULT, Port5VPinInputBufferMode=PORT_PIN_5V_IN_MODE_CMOS_OR_TTL:
              PortPin_P007_0: PortPinId=56, PortPinName=P007_0, PortPinDirection=PORT_PIN_IN, PortPinOutputInBufEnable=1, PortPinInitialMode=GPIO, PortPinModeChangeable=1, PortPinMode=GPIO
              PortPin_P007_1: PortPinId=57, PortPinName=P007_1, PortPinDirection=PORT_PIN_IN_OUT_DISABLED, PortPinOutputInBufEnable=0, PortPinInitialMode=AMUXA, PortPinModeChangeable=1, PortPinMode=AMUXA
              PortPin_P007_2: PortPinId=58, PortPinName=P007_2, PortPinDirection=PORT_PIN_IN_OUT_DISABLED, PortPinOutputInBufEnable=0, PortPinInitialMode=AMUXA, PortPinModeChangeable=0, PortPinMode=AMUXA
          PortContainer8: PortId=8, PortNumberOfPortPins=2
            PortPin_P008_0 (PortPin):
              PortPinId = 64
              PortPinName = P008_0
              PortPinDirection = PORT_PIN_IN_OUT_DISABLED
              PortPinDirectionChangeable = 1
              PortPinOutputInBufEnable = 0
              PortPinInitialMode = AMUXA
              PortPinModeChangeable = 1
              PortPinLevelValue = PORT_PIN_LEVEL_LOW
              PortPinOutputDrive = PORT_PIN_OUT_MODE_HIGHZ
              PortPinSmartioBypassEnable = 1
              PortPinSmartioSyncIoEnable = 0
              PortPinSmartioSyncChipEnable = 0
              PortPinSmartioLutTr0Source = PORT_SMART_LUT_TR_DU
              PortPinSmartioLutTr1Source = PORT_SMART_LUT_TR_LUT0
              PortPinSmartioLutTr2Source = PORT_SMART_LUT_TR_LUT0
              PortPinSmartioLut = 0
              PortPinSmartioLutOperation = PORT_SMART_LUT_OPC_COM_OUT_NO_FB
              PortPinInputBufferMode = PORT_PIN_IN_MODE_CMOS
              PortPinOutputSlowSlewRateEnable = 0
              PortPinOutputDriveStrength = PORT_PIN_OUT_STRENGTH_FULL
              PortPinOutputDriveSelectTrim = PORT_PIN_OUT_TRIM_DEFAULT
              Port5VPinInputBufferMode = PORT_PIN_5V_IN_MODE_CMOS_OR_TTL
              PortPinMode = AMUXA
            PortPin_P008_1 (PortPin):
              PortPinId = 65
              PortPinName = P008_1
              PortPinDirection = PORT_PIN_IN_OUT_DISABLED
              PortPinDirectionChangeable = 1
              PortPinOutputInBufEnable = 0
              PortPinInitialMode = AMUXA
              PortPinModeChangeable = 1
              PortPinLevelValue = PORT_PIN_LEVEL_LOW
              PortPinOutputDrive = PORT_PIN_OUT_MODE_HIGHZ
              PortPinSmartioBypassEnable = 1
              PortPinSmartioSyncIoEnable = 0
              PortPinSmartioSyncChipEnable = 0
              PortPinSmartioLutTr0Source = PORT_SMART_LUT_TR_DU
              PortPinSmartioLutTr1Source = PORT_SMART_LUT_TR_LUT0
              PortPinSmartioLutTr2Source = PORT_SMART_LUT_TR_LUT0
              PortPinSmartioLut = 0
              PortPinSmartioLutOperation = PORT_SMART_LUT_OPC_COM_OUT_NO_FB
              PortPinInputBufferMode = PORT_PIN_IN_MODE_CMOS
              PortPinOutputSlowSlewRateEnable = 0
              PortPinOutputDriveStrength = PORT_PIN_OUT_STRENGTH_FULL
              PortPinOutputDriveSelectTrim = PORT_PIN_OUT_TRIM_DEFAULT
              Port5VPinInputBufferMode = PORT_PIN_5V_IN_MODE_CMOS_OR_TTL
              PortPinMode = AMUXA
          PortContainer11: PortId=11, PortNumberOfPortPins=3
            3 x PortPin, all with PortPinDirection=PORT_PIN_IN_OUT_DISABLED, PortPinDirectionChangeable=1, PortPinOutputInBufEnable=0, PortPinInitialMode=AMUXA, PortPinModeChangeable=1, PortPinMode=AMUXA, PortPinLevelValue=PORT_PIN_LEVEL_LOW, PortPinOutputDrive=PORT_PIN_OUT_MODE_HIGHZ, PortPinSmartioBypassEnable=1, PortPinSmartioSyncIoEnable=0, PortPinSmartioSyncChipEnable=0, PortPinSmartioLutTr0Source=PORT_SMART_LUT_TR_DU, PortPinSmartioLutTr1Source=PORT_SMART_LUT_TR_LUT0, PortPinSmartioLutTr2Source=PORT_SMART_LUT_TR_LUT0, PortPinSmartioLut=0, PortPinSmartioLutOperation=PORT_SMART_LUT_OPC_COM_OUT_NO_FB, PortPinInputBufferMode=PORT_PIN_IN_MODE_CMOS, PortPinOutputSlowSlewRateEnable=0, PortPinOutputDriveStrength=PORT_PIN_OUT_STRENGTH_FULL, PortPinOutputDriveSelectTrim=PORT_PIN_OUT_TRIM_DEFAULT, Port5VPinInputBufferMode=PORT_PIN_5V_IN_MODE_CMOS_OR_TTL:
              PortPin_P011_0: PortPinId=88, PortPinName=P011_0
              PortPin_P011_1: PortPinId=89, PortPinName=P011_1
              PortPin_P011_2: PortPinId=90, PortPinName=P011_2
          PortContainer12: PortId=12, PortNumberOfPortPins=2
            PortPin_P012_0 (PortPin):
              PortPinId = 96
              PortPinName = P012_0
              PortPinDirection = PORT_PIN_IN_OUT_DISABLED
              PortPinDirectionChangeable = 1
              PortPinOutputInBufEnable = 0
              PortPinInitialMode = AMUXA
              PortPinModeChangeable = 1
              PortPinMode = AMUXA
              PortPinLevelValue = PORT_PIN_LEVEL_LOW
              PortPinOutputDrive = PORT_PIN_OUT_MODE_HIGHZ
              PortPinSmartioBypassEnable = 1
              PortPinSmartioSyncIoEnable = 0
              PortPinSmartioSyncChipEnable = 0
              PortPinSmartioLutTr0Source = PORT_SMART_LUT_TR_DU
              PortPinSmartioLutTr1Source = PORT_SMART_LUT_TR_LUT0
              PortPinSmartioLutTr2Source = PORT_SMART_LUT_TR_LUT0
              PortPinSmartioLut = 0
              PortPinSmartioLutOperation = PORT_SMART_LUT_OPC_COM_OUT_NO_FB
              PortPinInputBufferMode = PORT_PIN_IN_MODE_CMOS
              PortPinOutputSlowSlewRateEnable = 0
              PortPinOutputDriveStrength = PORT_PIN_OUT_STRENGTH_FULL
              PortPinOutputDriveSelectTrim = PORT_PIN_OUT_TRIM_DEFAULT
              Port5VPinInputBufferMode = PORT_PIN_5V_IN_MODE_CMOS_OR_TTL
            PortPin_P012_1 (PortPin):
              PortPinId = 97
              PortPinName = P012_1
              PortPinDirection = PORT_PIN_IN
              PortPinDirectionChangeable = 1
              PortPinOutputInBufEnable = 1
              PortPinInitialMode = GPIO
              PortPinModeChangeable = 1
              PortPinMode = GPIO
              PortPinLevelValue = PORT_PIN_LEVEL_LOW
              PortPinOutputDrive = PORT_PIN_OUT_MODE_HIGHZ
              PortPinSmartioBypassEnable = 1
              PortPinSmartioSyncIoEnable = 0
              PortPinSmartioSyncChipEnable = 0
              PortPinSmartioLutTr0Source = PORT_SMART_LUT_TR_DU
              PortPinSmartioLutTr1Source = PORT_SMART_LUT_TR_LUT0
              PortPinSmartioLutTr2Source = PORT_SMART_LUT_TR_LUT0
              PortPinSmartioLut = 0
              PortPinSmartioLutOperation = PORT_SMART_LUT_OPC_COM_OUT_NO_FB
              PortPinInputBufferMode = PORT_PIN_IN_MODE_CMOS
              PortPinOutputSlowSlewRateEnable = 0
              PortPinOutputDriveStrength = PORT_PIN_OUT_STRENGTH_FULL
              PortPinOutputDriveSelectTrim = PORT_PIN_OUT_TRIM_DEFAULT
              Port5VPinInputBufferMode = PORT_PIN_5V_IN_MODE_CMOS_OR_TTL
          PortContainer13: PortId=13, PortNumberOfPortPins=4
            4 x PortPin, all with PortPinDirectionChangeable=1, PortPinModeChangeable=1, PortPinLevelValue=PORT_PIN_LEVEL_LOW, PortPinSmartioBypassEnable=1, PortPinSmartioSyncIoEnable=0, PortPinSmartioSyncChipEnable=0, PortPinSmartioLutTr0Source=PORT_SMART_LUT_TR_DU, PortPinSmartioLutTr1Source=PORT_SMART_LUT_TR_LUT0, PortPinSmartioLutTr2Source=PORT_SMART_LUT_TR_LUT0, PortPinSmartioLut=0, PortPinSmartioLutOperation=PORT_SMART_LUT_OPC_COM_OUT_NO_FB, PortPinInputBufferMode=PORT_PIN_IN_MODE_CMOS, PortPinOutputSlowSlewRateEnable=0, PortPinOutputDriveStrength=PORT_PIN_OUT_STRENGTH_FULL, PortPinOutputDriveSelectTrim=PORT_PIN_OUT_TRIM_DEFAULT, Port5VPinInputBufferMode=PORT_PIN_5V_IN_MODE_CMOS_OR_TTL:
              PortPin_P013_0: PortPinId=104, PortPinName=P013_0, PortPinDirection=PORT_PIN_IN_OUT_DISABLED, PortPinOutputInBufEnable=0, PortPinInitialMode=AMUXA, PortPinMode=AMUXA, PortPinOutputDrive=PORT_PIN_OUT_MODE_HIGHZ
              PortPin_P013_1: PortPinId=105, PortPinName=P013_1, PortPinDirection=PORT_PIN_OUT, PortPinOutputInBufEnable=1, PortPinInitialMode=TCPWM_0_LINE_44, PortPinMode=TCPWM_0_LINE_44, PortPinOutputDrive=PORT_PIN_OUT_MODE_STRONG
              PortPin_P013_2: PortPinId=106, PortPinName=P013_2, PortPinDirection=PORT_PIN_IN_OUT_DISABLED, PortPinOutputInBufEnable=0, PortPinInitialMode=AMUXA, PortPinMode=AMUXA, PortPinOutputDrive=PORT_PIN_OUT_MODE_HIGHZ
              PortPin_P013_3: PortPinId=107, PortPinName=P013_3, PortPinDirection=PORT_PIN_OUT, PortPinOutputInBufEnable=1, PortPinInitialMode=TCPWM_0_LINE_45, PortPinMode=TCPWM_0_LINE_45, PortPinOutputDrive=PORT_PIN_OUT_MODE_STRONG
          PortContainer14: PortId=14, PortNumberOfPortPins=3
            3 x PortPin, all with PortPinDirection=PORT_PIN_OUT, PortPinDirectionChangeable=1, PortPinOutputInBufEnable=1, PortPinModeChangeable=1, PortPinLevelValue=PORT_PIN_LEVEL_LOW, PortPinSmartioBypassEnable=1, PortPinSmartioSyncIoEnable=0, PortPinSmartioSyncChipEnable=0, PortPinSmartioLutTr0Source=PORT_SMART_LUT_TR_DU, PortPinSmartioLutTr1Source=PORT_SMART_LUT_TR_LUT0, PortPinSmartioLutTr2Source=PORT_SMART_LUT_TR_LUT0, PortPinSmartioLut=0, PortPinSmartioLutOperation=PORT_SMART_LUT_OPC_COM_OUT_NO_FB, PortPinInputBufferMode=PORT_PIN_IN_MODE_CMOS, PortPinOutputSlowSlewRateEnable=0, PortPinOutputDriveStrength=PORT_PIN_OUT_STRENGTH_FULL, PortPinOutputDriveSelectTrim=PORT_PIN_OUT_TRIM_DEFAULT, Port5VPinInputBufferMode=PORT_PIN_5V_IN_MODE_CMOS_OR_TTL:
              PortPin_P014_0: PortPinId=112, PortPinName=P014_0, PortPinInitialMode=TCPWM_0_LINE_48, PortPinMode=TCPWM_0_LINE_48, PortPinOutputDrive=PORT_PIN_OUT_MODE_STRONG
              PortPin_P014_1: PortPinId=113, PortPinName=P014_1, PortPinInitialMode=SCB_2_I2C_SDA, PortPinMode=SCB_2_I2C_SDA, PortPinOutputDrive=PORT_PIN_OUT_MODE_OD_LOW
              PortPin_P014_2: PortPinId=114, PortPinName=P014_2, PortPinInitialMode=SCB_2_I2C_SCL, PortPinMode=SCB_2_I2C_SCL, PortPinOutputDrive=PORT_PIN_OUT_MODE_OD_LOW
          PortContainer18: PortId=18, PortNumberOfPortPins=7
            7 x PortPin, all with PortPinDirectionChangeable=1, PortPinModeChangeable=1, PortPinLevelValue=PORT_PIN_LEVEL_LOW, PortPinSmartioBypassEnable=1, PortPinSmartioSyncIoEnable=0, PortPinSmartioSyncChipEnable=0, PortPinSmartioLutTr0Source=PORT_SMART_LUT_TR_DU, PortPinSmartioLutTr1Source=PORT_SMART_LUT_TR_LUT0, PortPinSmartioLutTr2Source=PORT_SMART_LUT_TR_LUT0, PortPinSmartioLut=0, PortPinSmartioLutOperation=PORT_SMART_LUT_OPC_COM_OUT_NO_FB, PortPinInputBufferMode=PORT_PIN_IN_MODE_CMOS, PortPinOutputSlowSlewRateEnable=0, PortPinOutputDriveStrength=PORT_PIN_OUT_STRENGTH_FULL, PortPinOutputDriveSelectTrim=PORT_PIN_OUT_TRIM_DEFAULT, Port5VPinInputBufferMode=PORT_PIN_5V_IN_MODE_CMOS_OR_TTL:
              PortPin_P018_0: PortPinId=144, PortPinName=P018_0, PortPinDirection=PORT_PIN_OUT, PortPinOutputInBufEnable=1, PortPinInitialMode=GPIO, PortPinMode=GPIO, PortPinOutputDrive=PORT_PIN_OUT_MODE_STRONG
              PortPin_P018_1: PortPinId=145, PortPinName=P018_1, PortPinDirection=PORT_PIN_IN, PortPinOutputInBufEnable=1, PortPinInitialMode=GPIO, PortPinMode=GPIO, PortPinOutputDrive=PORT_PIN_OUT_MODE_HIGHZ
              PortPin_P018_3: PortPinId=147, PortPinName=P018_3, PortPinDirection=PORT_PIN_IN_OUT_DISABLED, PortPinOutputInBufEnable=0, PortPinInitialMode=AMUXA, PortPinMode=AMUXA, PortPinOutputDrive=PORT_PIN_OUT_MODE_HIGHZ
              PortPin_P018_4: PortPinId=148, PortPinName=P018_4, PortPinDirection=PORT_PIN_IN_OUT_DISABLED, PortPinOutputInBufEnable=0, PortPinInitialMode=AMUXA, PortPinMode=AMUXA, PortPinOutputDrive=PORT_PIN_OUT_MODE_HIGHZ
              PortPin_P018_5: PortPinId=149, PortPinName=P018_5, PortPinDirection=PORT_PIN_IN, PortPinOutputInBufEnable=1, PortPinInitialMode=GPIO, PortPinMode=GPIO, PortPinOutputDrive=PORT_PIN_OUT_MODE_HIGHZ
              PortPin_P018_6: PortPinId=150, PortPinName=P018_6, PortPinDirection=PORT_PIN_IN, PortPinOutputInBufEnable=1, PortPinInitialMode=GPIO, PortPinMode=GPIO, PortPinOutputDrive=PORT_PIN_OUT_MODE_HIGHZ
              PortPin_P018_7: PortPinId=151, PortPinName=P018_7, PortPinDirection=PORT_PIN_IN, PortPinOutputInBufEnable=1, PortPinInitialMode=GPIO, PortPinMode=GPIO, PortPinOutputDrive=PORT_PIN_OUT_MODE_HIGHZ
          PortContainer21: PortId=21, PortNumberOfPortPins=4
            4 x PortPin, all with PortPinLevelValue=PORT_PIN_LEVEL_LOW, PortPinOutputDrive=PORT_PIN_OUT_MODE_HIGHZ, PortPinSmartioBypassEnable=1, PortPinSmartioSyncIoEnable=0, PortPinSmartioSyncChipEnable=0, PortPinSmartioLutTr0Source=PORT_SMART_LUT_TR_DU, PortPinSmartioLutTr1Source=PORT_SMART_LUT_TR_LUT0, PortPinSmartioLutTr2Source=PORT_SMART_LUT_TR_LUT0, PortPinSmartioLut=0, PortPinSmartioLutOperation=PORT_SMART_LUT_OPC_COM_OUT_NO_FB, PortPinInputBufferMode=PORT_PIN_IN_MODE_CMOS, PortPinOutputSlowSlewRateEnable=0, PortPinOutputDriveStrength=PORT_PIN_OUT_STRENGTH_FULL, PortPinOutputDriveSelectTrim=PORT_PIN_OUT_TRIM_DEFAULT, Port5VPinInputBufferMode=PORT_PIN_5V_IN_MODE_CMOS_OR_TTL:
              PortPin_P021_0: PortPinId=168, PortPinName=P021_0, PortPinDirection=PORT_PIN_IN, PortPinDirectionChangeable=1, PortPinOutputInBufEnable=1, PortPinInitialMode=GPIO, PortPinModeChangeable=1, PortPinMode=GPIO
              PortPin_P021_1: PortPinId=169, PortPinName=P021_1, PortPinDirection=PORT_PIN_IN_OUT_DISABLED, PortPinDirectionChangeable=1, PortPinOutputInBufEnable=0, PortPinInitialMode=AMUXA, PortPinModeChangeable=1, PortPinMode=AMUXA
              PortPin_P021_2: PortPinId=170, PortPinName=P021_2, PortPinDirection=PORT_PIN_IN_OUT_DISABLED, PortPinDirectionChangeable=0, PortPinOutputInBufEnable=0, PortPinInitialMode=AMUXA, PortPinModeChangeable=0, PortPinMode=GPIO
              PortPin_P021_3: PortPinId=171, PortPinName=P021_3, PortPinDirection=PORT_PIN_IN_OUT_DISABLED, PortPinDirectionChangeable=0, PortPinOutputInBufEnable=0, PortPinInitialMode=AMUXA, PortPinModeChangeable=0, PortPinMode=GPIO
          PortContainer22: PortId=22, PortNumberOfPortPins=1
            PortPin_P022_0 (PortPin):
              PortPinId = 176
              PortPinName = P022_0
              PortPinDirection = PORT_PIN_OUT
              PortPinDirectionChangeable = 1
              PortPinOutputInBufEnable = 1
              PortPinInitialMode = GPIO
              PortPinModeChangeable = 1
              PortPinMode = GPIO
              PortPinLevelValue = PORT_PIN_LEVEL_LOW
              PortPinOutputDrive = PORT_PIN_OUT_MODE_STRONG
              PortPinSmartioBypassEnable = 1
              PortPinSmartioSyncIoEnable = 0
              PortPinSmartioSyncChipEnable = 0
              PortPinSmartioLutTr0Source = PORT_SMART_LUT_TR_DU
              PortPinSmartioLutTr1Source = PORT_SMART_LUT_TR_LUT0
              PortPinSmartioLutTr2Source = PORT_SMART_LUT_TR_LUT0
              PortPinSmartioLut = 0
              PortPinSmartioLutOperation = PORT_SMART_LUT_OPC_COM_OUT_NO_FB
              PortPinInputBufferMode = PORT_PIN_IN_MODE_CMOS
              PortPinOutputSlowSlewRateEnable = 0
              PortPinOutputDriveStrength = PORT_PIN_OUT_STRENGTH_FULL
              PortPinOutputDriveSelectTrim = PORT_PIN_OUT_TRIM_DEFAULT
              Port5VPinInputBufferMode = PORT_PIN_5V_IN_MODE_CMOS_OR_TTL
          PortContainer23: PortId=23, PortNumberOfPortPins=5
            5 x PortPin, all with PortPinDirectionChangeable=1, PortPinOutputInBufEnable=1, PortPinModeChangeable=1, PortPinMode=GPIO, PortPinLevelValue=PORT_PIN_LEVEL_LOW, PortPinSmartioBypassEnable=1, PortPinSmartioSyncIoEnable=0, PortPinSmartioSyncChipEnable=0, PortPinSmartioLutTr0Source=PORT_SMART_LUT_TR_DU, PortPinSmartioLutTr1Source=PORT_SMART_LUT_TR_LUT0, PortPinSmartioLutTr2Source=PORT_SMART_LUT_TR_LUT0, PortPinSmartioLut=0, PortPinSmartioLutOperation=PORT_SMART_LUT_OPC_COM_OUT_NO_FB, PortPinInputBufferMode=PORT_PIN_IN_MODE_CMOS, PortPinOutputSlowSlewRateEnable=0, PortPinOutputDriveStrength=PORT_PIN_OUT_STRENGTH_FULL, PortPinOutputDriveSelectTrim=PORT_PIN_OUT_TRIM_DEFAULT, Port5VPinInputBufferMode=PORT_PIN_5V_IN_MODE_CMOS_OR_TTL:
              PortPin_P023_3: PortPinId=187, PortPinName=P023_3, PortPinDirection=PORT_PIN_OUT, PortPinInitialMode=GPIO, PortPinOutputDrive=PORT_PIN_OUT_MODE_STRONG
              PortPin_P023_4: PortPinId=188, PortPinName=P023_4, PortPinDirection=PORT_PIN_OUT, PortPinInitialMode=CPUSS_SWJ_SWO_TDO, PortPinOutputDrive=PORT_PIN_OUT_MODE_HIGHZ
              PortPin_P023_5: PortPinId=189, PortPinName=P023_5, PortPinDirection=PORT_PIN_IN, PortPinInitialMode=CPUSS_SWJ_SWCLK_TCLK, PortPinOutputDrive=PORT_PIN_OUT_MODE_HIGHZ
              PortPin_P023_6: PortPinId=190, PortPinName=P023_6, PortPinDirection=PORT_PIN_IN, PortPinInitialMode=CPUSS_SWJ_SWDIO_TMS, PortPinOutputDrive=PORT_PIN_OUT_MODE_HIGHZ
              PortPin_P023_7: PortPinId=191, PortPinName=P023_7, PortPinDirection=PORT_PIN_IN, PortPinInitialMode=CPUSS_SWJ_SWDOE_TDI, PortPinOutputDrive=PORT_PIN_OUT_MODE_HIGHZ
        PortAmuxSplitCell0 (PortAmuxSplitCell):
          PortAmuxSplitCellId = 0
          PortAmuxBusaSwitchSL = PORT_AMUX_SWITCH_OPEN
          PortAmuxBusaSwitchSR = PORT_AMUX_SWITCH_OPEN
          PortAmuxBusaSwitchS0 = PORT_AMUX_SWITCH_OPEN
          PortAmuxBusbSwitchSL = PORT_AMUX_SWITCH_OPEN
          PortAmuxBusbSwitchSR = PORT_AMUX_SWITCH_OPEN
          PortAmuxBusbSwitchS0 = PORT_AMUX_SWITCH_OPEN
      PortConfigSet_NoneNFC_Ani
        14 x PortContainer, all with PortSmartioClockSource=PORT_SMART_CLK_SRC_CONST0, PortSmartioDataUnitBitSize=1, PortSmartioDataUnitData0Source=PORT_SMART_DU_DATA_CONST0, PortSmartioDataUnitData1Source=PORT_SMART_DU_DATA_CONST0, PortSmartioDataUnitOperation=PORT_SMART_DU_OPC_INCR, PortSmartioDataUnitSource=0, PortSmartioDataUnitTr0Source=PORT_SMART_DU_TR_CONST0, PortSmartioDataUnitTr1Source=PORT_SMART_DU_TR_CONST0, PortSmartioDataUnitTr2Source=PORT_SMART_DU_TR_CONST0, PortSmartioEnable=0, PortSmartioHoldOverrideEnable=0, PortSmartioPipelineEnable=1:
          PortContainer0: PortId=0, PortNumberOfPortPins=4
            4 x PortPin, all with PortPinDirection=PORT_PIN_IN_OUT_DISABLED, PortPinDirectionChangeable=1, PortPinOutputInBufEnable=0, PortPinInitialMode=AMUXA, PortPinModeChangeable=1, PortPinLevelValue=PORT_PIN_LEVEL_LOW, PortPinOutputDrive=PORT_PIN_OUT_MODE_HIGHZ, PortPinSmartioBypassEnable=1, PortPinSmartioSyncIoEnable=0, PortPinSmartioSyncChipEnable=0, PortPinSmartioLutTr0Source=PORT_SMART_LUT_TR_DU, PortPinSmartioLutTr1Source=PORT_SMART_LUT_TR_LUT0, PortPinSmartioLutTr2Source=PORT_SMART_LUT_TR_LUT0, PortPinSmartioLut=0, PortPinSmartioLutOperation=PORT_SMART_LUT_OPC_COM_OUT_NO_FB, PortPinInputBufferMode=PORT_PIN_IN_MODE_CMOS, PortPinOutputSlowSlewRateEnable=0, PortPinOutputDriveStrength=PORT_PIN_OUT_STRENGTH_FULL, PortPinOutputDriveSelectTrim=PORT_PIN_OUT_TRIM_DEFAULT, Port5VPinInputBufferMode=PORT_PIN_5V_IN_MODE_CMOS_OR_TTL, PortPinMode=AMUXA:
              PortPin_P000_{0..3}: PortPinId={0..3}, PortPinName=P000_{0..3}
          PortContainer2: PortId=2, PortNumberOfPortPins=2
            PortPin_P002_0 (PortPin):
              PortPinId = 16
              PortPinName = P002_0
              PortPinDirection = PORT_PIN_IN_OUT_DISABLED
              PortPinDirectionChangeable = 1
              PortPinOutputInBufEnable = 0
              PortPinInitialMode = AMUXA
              PortPinModeChangeable = 1
              PortPinMode = AMUXA
              PortPinLevelValue = PORT_PIN_LEVEL_LOW
              PortPinOutputDrive = PORT_PIN_OUT_MODE_HIGHZ
              PortPinSmartioBypassEnable = 1
              PortPinSmartioSyncIoEnable = 0
              PortPinSmartioSyncChipEnable = 0
              PortPinSmartioLutTr0Source = PORT_SMART_LUT_TR_DU
              PortPinSmartioLutTr1Source = PORT_SMART_LUT_TR_LUT0
              PortPinSmartioLutTr2Source = PORT_SMART_LUT_TR_LUT0
              PortPinSmartioLut = 0
              PortPinSmartioLutOperation = PORT_SMART_LUT_OPC_COM_OUT_NO_FB
              PortPinInputBufferMode = PORT_PIN_IN_MODE_CMOS
              PortPinOutputSlowSlewRateEnable = 0
              PortPinOutputDriveStrength = PORT_PIN_OUT_STRENGTH_FULL
              PortPinOutputDriveSelectTrim = PORT_PIN_OUT_TRIM_DEFAULT
              Port5VPinInputBufferMode = PORT_PIN_5V_IN_MODE_CMOS_OR_TTL
            PortPin_P002_1 (PortPin):
              PortPinId = 17
              PortPinName = P002_1
              PortPinDirection = PORT_PIN_IN_OUT_DISABLED
              PortPinDirectionChangeable = 1
              PortPinOutputInBufEnable = 0
              PortPinInitialMode = AMUXA
              PortPinModeChangeable = 1
              PortPinMode = AMUXA
              PortPinLevelValue = PORT_PIN_LEVEL_LOW
              PortPinOutputDrive = PORT_PIN_OUT_MODE_HIGHZ
              PortPinSmartioBypassEnable = 1
              PortPinSmartioSyncIoEnable = 0
              PortPinSmartioSyncChipEnable = 0
              PortPinSmartioLutTr0Source = PORT_SMART_LUT_TR_DU
              PortPinSmartioLutTr1Source = PORT_SMART_LUT_TR_LUT0
              PortPinSmartioLutTr2Source = PORT_SMART_LUT_TR_LUT0
              PortPinSmartioLut = 0
              PortPinSmartioLutOperation = PORT_SMART_LUT_OPC_COM_OUT_NO_FB
              PortPinInputBufferMode = PORT_PIN_IN_MODE_CMOS
              PortPinOutputSlowSlewRateEnable = 0
              PortPinOutputDriveStrength = PORT_PIN_OUT_STRENGTH_FULL
              PortPinOutputDriveSelectTrim = PORT_PIN_OUT_TRIM_DEFAULT
              Port5VPinInputBufferMode = PORT_PIN_5V_IN_MODE_CMOS_OR_TTL
          PortContainer5: PortId=5, PortNumberOfPortPins=2
            PortPin_P005_0 (PortPin):
              PortPinId = 40
              PortPinName = P005_0
              PortPinDirection = PORT_PIN_IN_OUT_DISABLED
              PortPinDirectionChangeable = 1
              PortPinOutputInBufEnable = 0
              PortPinInitialMode = AMUXA
              PortPinModeChangeable = 1
              PortPinMode = AMUXA
              PortPinLevelValue = PORT_PIN_LEVEL_LOW
              PortPinOutputDrive = PORT_PIN_OUT_MODE_HIGHZ
              PortPinSmartioBypassEnable = 1
              PortPinSmartioSyncIoEnable = 0
              PortPinSmartioSyncChipEnable = 0
              PortPinSmartioLutTr0Source = PORT_SMART_LUT_TR_DU
              PortPinSmartioLutTr1Source = PORT_SMART_LUT_TR_LUT0
              PortPinSmartioLutTr2Source = PORT_SMART_LUT_TR_LUT0
              PortPinSmartioLut = 0
              PortPinSmartioLutOperation = PORT_SMART_LUT_OPC_COM_OUT_NO_FB
              PortPinInputBufferMode = PORT_PIN_IN_MODE_CMOS
              PortPinOutputSlowSlewRateEnable = 0
              PortPinOutputDriveStrength = PORT_PIN_OUT_STRENGTH_FULL
              PortPinOutputDriveSelectTrim = PORT_PIN_OUT_TRIM_DEFAULT
              Port5VPinInputBufferMode = PORT_PIN_5V_IN_MODE_CMOS_OR_TTL
            PortPin_P005_1 (PortPin):
              PortPinId = 41
              PortPinName = P005_1
              PortPinDirection = PORT_PIN_IN_OUT_DISABLED
              PortPinDirectionChangeable = 1
              PortPinOutputInBufEnable = 0
              PortPinInitialMode = AMUXA
              PortPinModeChangeable = 1
              PortPinMode = AMUXA
              PortPinLevelValue = PORT_PIN_LEVEL_LOW
              PortPinOutputDrive = PORT_PIN_OUT_MODE_HIGHZ
              PortPinSmartioBypassEnable = 1
              PortPinSmartioSyncIoEnable = 0
              PortPinSmartioSyncChipEnable = 0
              PortPinSmartioLutTr0Source = PORT_SMART_LUT_TR_DU
              PortPinSmartioLutTr1Source = PORT_SMART_LUT_TR_LUT0
              PortPinSmartioLutTr2Source = PORT_SMART_LUT_TR_LUT0
              PortPinSmartioLut = 0
              PortPinSmartioLutOperation = PORT_SMART_LUT_OPC_COM_OUT_NO_FB
              PortPinInputBufferMode = PORT_PIN_IN_MODE_CMOS
              PortPinOutputSlowSlewRateEnable = 0
              PortPinOutputDriveStrength = PORT_PIN_OUT_STRENGTH_FULL
              PortPinOutputDriveSelectTrim = PORT_PIN_OUT_TRIM_DEFAULT
              Port5VPinInputBufferMode = PORT_PIN_5V_IN_MODE_CMOS_OR_TTL
          PortContainer6: PortId=6, PortNumberOfPortPins=7
            7 x PortPin, all with PortPinLevelValue=PORT_PIN_LEVEL_LOW, PortPinSmartioBypassEnable=1, PortPinSmartioSyncIoEnable=0, PortPinSmartioSyncChipEnable=0, PortPinSmartioLutTr0Source=PORT_SMART_LUT_TR_DU, PortPinSmartioLutTr1Source=PORT_SMART_LUT_TR_LUT0, PortPinSmartioLutTr2Source=PORT_SMART_LUT_TR_LUT0, PortPinSmartioLut=0, PortPinSmartioLutOperation=PORT_SMART_LUT_OPC_COM_OUT_NO_FB, PortPinInputBufferMode=PORT_PIN_IN_MODE_CMOS, PortPinOutputSlowSlewRateEnable=0, PortPinOutputDriveStrength=PORT_PIN_OUT_STRENGTH_FULL, PortPinOutputDriveSelectTrim=PORT_PIN_OUT_TRIM_DEFAULT, Port5VPinInputBufferMode=PORT_PIN_5V_IN_MODE_CMOS_OR_TTL:
              PortPin_P006_0: PortPinId=48, PortPinName=P006_0, PortPinDirection=PORT_PIN_IN, PortPinDirectionChangeable=1, PortPinOutputInBufEnable=1, PortPinInitialMode=GPIO, PortPinModeChangeable=1, PortPinMode=GPIO, PortPinOutputDrive=PORT_PIN_OUT_MODE_HIGHZ
              PortPin_P006_1: PortPinId=49, PortPinName=P006_1, PortPinDirection=PORT_PIN_IN_OUT_DISABLED, PortPinDirectionChangeable=1, PortPinOutputInBufEnable=0, PortPinInitialMode=AMUXA, PortPinModeChangeable=1, PortPinMode=AMUXA, PortPinOutputDrive=PORT_PIN_OUT_MODE_HIGHZ
              PortPin_P006_2: PortPinId=50, PortPinName=P006_2, PortPinDirection=PORT_PIN_OUT, PortPinDirectionChangeable=0, PortPinOutputInBufEnable=1, PortPinInitialMode=CANFD_0_TTCAN_TX_2, PortPinModeChangeable=0, PortPinOutputDrive=PORT_PIN_OUT_MODE_STRONG, PortPinMode=CANFD_0_TTCAN_TX_2
              PortPin_P006_3: PortPinId=51, PortPinName=P006_3, PortPinDirection=PORT_PIN_IN, PortPinDirectionChangeable=0, PortPinOutputInBufEnable=1, PortPinInitialMode=CANFD_0_TTCAN_RX_2, PortPinModeChangeable=0, PortPinOutputDrive=PORT_PIN_OUT_MODE_HIGHZ, PortPinMode=CANFD_0_TTCAN_RX_2
              PortPin_P006_4: PortPinId=52, PortPinName=P006_4, PortPinDirection=PORT_PIN_OUT, PortPinDirectionChangeable=1, PortPinOutputInBufEnable=1, PortPinInitialMode=GPIO, PortPinModeChangeable=0, PortPinOutputDrive=PORT_PIN_OUT_MODE_STRONG, PortPinMode=GPIO
              PortPin_P006_5: PortPinId=53, PortPinName=P006_5, PortPinDirection=PORT_PIN_IN, PortPinDirectionChangeable=1, PortPinOutputInBufEnable=1, PortPinInitialMode=GPIO, PortPinModeChangeable=1, PortPinMode=GPIO, PortPinOutputDrive=PORT_PIN_OUT_MODE_HIGHZ
              PortPin_P006_6: PortPinId=54, PortPinName=P006_6, PortPinDirection=PORT_PIN_IN, PortPinDirectionChangeable=1, PortPinOutputInBufEnable=1, PortPinInitialMode=GPIO, PortPinModeChangeable=1, PortPinMode=GPIO, PortPinOutputDrive=PORT_PIN_OUT_MODE_HIGHZ
          PortContainer7: PortId=7, PortNumberOfPortPins=3
            3 x PortPin, all with PortPinDirectionChangeable=1, PortPinModeChangeable=1, PortPinLevelValue=PORT_PIN_LEVEL_LOW, PortPinOutputDrive=PORT_PIN_OUT_MODE_HIGHZ, PortPinSmartioBypassEnable=1, PortPinSmartioSyncIoEnable=0, PortPinSmartioSyncChipEnable=0, PortPinSmartioLutTr0Source=PORT_SMART_LUT_TR_DU, PortPinSmartioLutTr1Source=PORT_SMART_LUT_TR_LUT0, PortPinSmartioLutTr2Source=PORT_SMART_LUT_TR_LUT0, PortPinSmartioLut=0, PortPinSmartioLutOperation=PORT_SMART_LUT_OPC_COM_OUT_NO_FB, PortPinInputBufferMode=PORT_PIN_IN_MODE_CMOS, PortPinOutputSlowSlewRateEnable=0, PortPinOutputDriveStrength=PORT_PIN_OUT_STRENGTH_FULL, PortPinOutputDriveSelectTrim=PORT_PIN_OUT_TRIM_DEFAULT, Port5VPinInputBufferMode=PORT_PIN_5V_IN_MODE_CMOS_OR_TTL:
              PortPin_P007_0: PortPinId=56, PortPinName=P007_0, PortPinDirection=PORT_PIN_IN, PortPinOutputInBufEnable=1, PortPinInitialMode=GPIO, PortPinMode=GPIO
              PortPin_P007_1: PortPinId=57, PortPinName=P007_1, PortPinDirection=PORT_PIN_IN_OUT_DISABLED, PortPinOutputInBufEnable=0, PortPinInitialMode=AMUXA, PortPinMode=AMUXA
              PortPin_P007_2: PortPinId=58, PortPinName=P007_2, PortPinDirection=PORT_PIN_IN_OUT_DISABLED, PortPinOutputInBufEnable=0, PortPinInitialMode=AMUXA, PortPinMode=AMUXA
          PortContainer8: PortId=8, PortNumberOfPortPins=2
            PortPin_P008_0 (PortPin):
              PortPinId = 64
              PortPinName = P008_0
              PortPinDirection = PORT_PIN_IN_OUT_DISABLED
              PortPinDirectionChangeable = 1
              PortPinOutputInBufEnable = 0
              PortPinInitialMode = AMUXA
              PortPinModeChangeable = 1
              PortPinLevelValue = PORT_PIN_LEVEL_LOW
              PortPinOutputDrive = PORT_PIN_OUT_MODE_HIGHZ
              PortPinSmartioBypassEnable = 1
              PortPinSmartioSyncIoEnable = 0
              PortPinSmartioSyncChipEnable = 0
              PortPinSmartioLutTr0Source = PORT_SMART_LUT_TR_DU
              PortPinSmartioLutTr1Source = PORT_SMART_LUT_TR_LUT0
              PortPinSmartioLutTr2Source = PORT_SMART_LUT_TR_LUT0
              PortPinSmartioLut = 0
              PortPinSmartioLutOperation = PORT_SMART_LUT_OPC_COM_OUT_NO_FB
              PortPinInputBufferMode = PORT_PIN_IN_MODE_CMOS
              PortPinOutputSlowSlewRateEnable = 0
              PortPinOutputDriveStrength = PORT_PIN_OUT_STRENGTH_FULL
              PortPinOutputDriveSelectTrim = PORT_PIN_OUT_TRIM_DEFAULT
              Port5VPinInputBufferMode = PORT_PIN_5V_IN_MODE_CMOS_OR_TTL
              PortPinMode = AMUXA
            PortPin_P008_1 (PortPin):
              PortPinId = 65
              PortPinName = P008_1
              PortPinDirection = PORT_PIN_IN_OUT_DISABLED
              PortPinDirectionChangeable = 1
              PortPinOutputInBufEnable = 0
              PortPinInitialMode = AMUXA
              PortPinModeChangeable = 1
              PortPinLevelValue = PORT_PIN_LEVEL_LOW
              PortPinOutputDrive = PORT_PIN_OUT_MODE_HIGHZ
              PortPinSmartioBypassEnable = 1
              PortPinSmartioSyncIoEnable = 0
              PortPinSmartioSyncChipEnable = 0
              PortPinSmartioLutTr0Source = PORT_SMART_LUT_TR_DU
              PortPinSmartioLutTr1Source = PORT_SMART_LUT_TR_LUT0
              PortPinSmartioLutTr2Source = PORT_SMART_LUT_TR_LUT0
              PortPinSmartioLut = 0
              PortPinSmartioLutOperation = PORT_SMART_LUT_OPC_COM_OUT_NO_FB
              PortPinInputBufferMode = PORT_PIN_IN_MODE_CMOS
              PortPinOutputSlowSlewRateEnable = 0
              PortPinOutputDriveStrength = PORT_PIN_OUT_STRENGTH_FULL
              PortPinOutputDriveSelectTrim = PORT_PIN_OUT_TRIM_DEFAULT
              Port5VPinInputBufferMode = PORT_PIN_5V_IN_MODE_CMOS_OR_TTL
              PortPinMode = AMUXA
          PortContainer11: PortId=11, PortNumberOfPortPins=3
            3 x PortPin, all with PortPinDirection=PORT_PIN_IN_OUT_DISABLED, PortPinDirectionChangeable=1, PortPinOutputInBufEnable=0, PortPinInitialMode=AMUXA, PortPinModeChangeable=1, PortPinMode=AMUXA, PortPinLevelValue=PORT_PIN_LEVEL_LOW, PortPinOutputDrive=PORT_PIN_OUT_MODE_HIGHZ, PortPinSmartioBypassEnable=1, PortPinSmartioSyncIoEnable=0, PortPinSmartioSyncChipEnable=0, PortPinSmartioLutTr0Source=PORT_SMART_LUT_TR_DU, PortPinSmartioLutTr1Source=PORT_SMART_LUT_TR_LUT0, PortPinSmartioLutTr2Source=PORT_SMART_LUT_TR_LUT0, PortPinSmartioLut=0, PortPinSmartioLutOperation=PORT_SMART_LUT_OPC_COM_OUT_NO_FB, PortPinInputBufferMode=PORT_PIN_IN_MODE_CMOS, PortPinOutputSlowSlewRateEnable=0, PortPinOutputDriveStrength=PORT_PIN_OUT_STRENGTH_FULL, PortPinOutputDriveSelectTrim=PORT_PIN_OUT_TRIM_DEFAULT, Port5VPinInputBufferMode=PORT_PIN_5V_IN_MODE_CMOS_OR_TTL:
              PortPin_P011_0: PortPinId=88, PortPinName=P011_0
              PortPin_P011_1: PortPinId=89, PortPinName=P011_1
              PortPin_P011_2: PortPinId=90, PortPinName=P011_2
          PortContainer12: PortId=12, PortNumberOfPortPins=2
            PortPin_P012_0 (PortPin):
              PortPinId = 96
              PortPinName = P012_0
              PortPinDirection = PORT_PIN_IN_OUT_DISABLED
              PortPinDirectionChangeable = 1
              PortPinOutputInBufEnable = 0
              PortPinInitialMode = AMUXA
              PortPinModeChangeable = 1
              PortPinMode = AMUXA
              PortPinLevelValue = PORT_PIN_LEVEL_LOW
              PortPinOutputDrive = PORT_PIN_OUT_MODE_HIGHZ
              PortPinSmartioBypassEnable = 1
              PortPinSmartioSyncIoEnable = 0
              PortPinSmartioSyncChipEnable = 0
              PortPinSmartioLutTr0Source = PORT_SMART_LUT_TR_DU
              PortPinSmartioLutTr1Source = PORT_SMART_LUT_TR_LUT0
              PortPinSmartioLutTr2Source = PORT_SMART_LUT_TR_LUT0
              PortPinSmartioLut = 0
              PortPinSmartioLutOperation = PORT_SMART_LUT_OPC_COM_OUT_NO_FB
              PortPinInputBufferMode = PORT_PIN_IN_MODE_CMOS
              PortPinOutputSlowSlewRateEnable = 0
              PortPinOutputDriveStrength = PORT_PIN_OUT_STRENGTH_FULL
              PortPinOutputDriveSelectTrim = PORT_PIN_OUT_TRIM_DEFAULT
              Port5VPinInputBufferMode = PORT_PIN_5V_IN_MODE_CMOS_OR_TTL
            PortPin_P012_1 (PortPin):
              PortPinId = 97
              PortPinName = P012_1
              PortPinDirection = PORT_PIN_IN
              PortPinDirectionChangeable = 1
              PortPinOutputInBufEnable = 1
              PortPinInitialMode = GPIO
              PortPinModeChangeable = 1
              PortPinMode = GPIO
              PortPinLevelValue = PORT_PIN_LEVEL_LOW
              PortPinOutputDrive = PORT_PIN_OUT_MODE_HIGHZ
              PortPinSmartioBypassEnable = 1
              PortPinSmartioSyncIoEnable = 0
              PortPinSmartioSyncChipEnable = 0
              PortPinSmartioLutTr0Source = PORT_SMART_LUT_TR_DU
              PortPinSmartioLutTr1Source = PORT_SMART_LUT_TR_LUT0
              PortPinSmartioLutTr2Source = PORT_SMART_LUT_TR_LUT0
              PortPinSmartioLut = 0
              PortPinSmartioLutOperation = PORT_SMART_LUT_OPC_COM_OUT_NO_FB
              PortPinInputBufferMode = PORT_PIN_IN_MODE_CMOS
              PortPinOutputSlowSlewRateEnable = 0
              PortPinOutputDriveStrength = PORT_PIN_OUT_STRENGTH_FULL
              PortPinOutputDriveSelectTrim = PORT_PIN_OUT_TRIM_DEFAULT
              Port5VPinInputBufferMode = PORT_PIN_5V_IN_MODE_CMOS_OR_TTL
          PortContainer13: PortId=13, PortNumberOfPortPins=4
            4 x PortPin, all with PortPinDirectionChangeable=1, PortPinModeChangeable=1, PortPinLevelValue=PORT_PIN_LEVEL_LOW, PortPinSmartioBypassEnable=1, PortPinSmartioSyncIoEnable=0, PortPinSmartioSyncChipEnable=0, PortPinSmartioLutTr0Source=PORT_SMART_LUT_TR_DU, PortPinSmartioLutTr1Source=PORT_SMART_LUT_TR_LUT0, PortPinSmartioLutTr2Source=PORT_SMART_LUT_TR_LUT0, PortPinSmartioLut=0, PortPinSmartioLutOperation=PORT_SMART_LUT_OPC_COM_OUT_NO_FB, PortPinInputBufferMode=PORT_PIN_IN_MODE_CMOS, PortPinOutputSlowSlewRateEnable=0, PortPinOutputDriveStrength=PORT_PIN_OUT_STRENGTH_FULL, PortPinOutputDriveSelectTrim=PORT_PIN_OUT_TRIM_DEFAULT, Port5VPinInputBufferMode=PORT_PIN_5V_IN_MODE_CMOS_OR_TTL:
              PortPin_P013_0: PortPinId=104, PortPinName=P013_0, PortPinDirection=PORT_PIN_IN_OUT_DISABLED, PortPinOutputInBufEnable=0, PortPinInitialMode=AMUXA, PortPinMode=AMUXA, PortPinOutputDrive=PORT_PIN_OUT_MODE_HIGHZ
              PortPin_P013_1: PortPinId=105, PortPinName=P013_1, PortPinDirection=PORT_PIN_OUT, PortPinOutputInBufEnable=1, PortPinInitialMode=TCPWM_0_LINE_44, PortPinMode=TCPWM_0_LINE_44, PortPinOutputDrive=PORT_PIN_OUT_MODE_STRONG
              PortPin_P013_2: PortPinId=106, PortPinName=P013_2, PortPinDirection=PORT_PIN_IN_OUT_DISABLED, PortPinOutputInBufEnable=0, PortPinInitialMode=AMUXA, PortPinMode=AMUXA, PortPinOutputDrive=PORT_PIN_OUT_MODE_HIGHZ
              PortPin_P013_3: PortPinId=107, PortPinName=P013_3, PortPinDirection=PORT_PIN_OUT, PortPinOutputInBufEnable=1, PortPinInitialMode=TCPWM_0_LINE_45, PortPinMode=TCPWM_0_LINE_45, PortPinOutputDrive=PORT_PIN_OUT_MODE_STRONG
          PortContainer14: PortId=14, PortNumberOfPortPins=3
            3 x PortPin, all with PortPinDirection=PORT_PIN_OUT, PortPinDirectionChangeable=1, PortPinOutputInBufEnable=1, PortPinModeChangeable=1, PortPinLevelValue=PORT_PIN_LEVEL_LOW, PortPinSmartioBypassEnable=1, PortPinSmartioSyncIoEnable=0, PortPinSmartioSyncChipEnable=0, PortPinSmartioLutTr0Source=PORT_SMART_LUT_TR_DU, PortPinSmartioLutTr1Source=PORT_SMART_LUT_TR_LUT0, PortPinSmartioLutTr2Source=PORT_SMART_LUT_TR_LUT0, PortPinSmartioLut=0, PortPinSmartioLutOperation=PORT_SMART_LUT_OPC_COM_OUT_NO_FB, PortPinInputBufferMode=PORT_PIN_IN_MODE_CMOS, PortPinOutputSlowSlewRateEnable=0, PortPinOutputDriveStrength=PORT_PIN_OUT_STRENGTH_FULL, PortPinOutputDriveSelectTrim=PORT_PIN_OUT_TRIM_DEFAULT, Port5VPinInputBufferMode=PORT_PIN_5V_IN_MODE_CMOS_OR_TTL:
              PortPin_P014_0: PortPinId=112, PortPinName=P014_0, PortPinInitialMode=TCPWM_0_LINE_48, PortPinMode=TCPWM_0_LINE_48, PortPinOutputDrive=PORT_PIN_OUT_MODE_STRONG
              PortPin_P014_1: PortPinId=113, PortPinName=P014_1, PortPinInitialMode=SCB_2_I2C_SDA, PortPinMode=SCB_2_I2C_SDA, PortPinOutputDrive=PORT_PIN_OUT_MODE_OD_LOW
              PortPin_P014_2: PortPinId=114, PortPinName=P014_2, PortPinInitialMode=SCB_2_I2C_SCL, PortPinMode=SCB_2_I2C_SCL, PortPinOutputDrive=PORT_PIN_OUT_MODE_OD_LOW
          PortContainer18: PortId=18, PortNumberOfPortPins=7
            7 x PortPin, all with PortPinDirectionChangeable=1, PortPinModeChangeable=1, PortPinLevelValue=PORT_PIN_LEVEL_LOW, PortPinSmartioBypassEnable=1, PortPinSmartioSyncIoEnable=0, PortPinSmartioSyncChipEnable=0, PortPinSmartioLutTr0Source=PORT_SMART_LUT_TR_DU, PortPinSmartioLutTr1Source=PORT_SMART_LUT_TR_LUT0, PortPinSmartioLutTr2Source=PORT_SMART_LUT_TR_LUT0, PortPinSmartioLut=0, PortPinSmartioLutOperation=PORT_SMART_LUT_OPC_COM_OUT_NO_FB, PortPinInputBufferMode=PORT_PIN_IN_MODE_CMOS, PortPinOutputSlowSlewRateEnable=0, PortPinOutputDriveStrength=PORT_PIN_OUT_STRENGTH_FULL, PortPinOutputDriveSelectTrim=PORT_PIN_OUT_TRIM_DEFAULT, Port5VPinInputBufferMode=PORT_PIN_5V_IN_MODE_CMOS_OR_TTL:
              PortPin_P018_0: PortPinId=144, PortPinName=P018_0, PortPinDirection=PORT_PIN_OUT, PortPinOutputInBufEnable=1, PortPinInitialMode=GPIO, PortPinMode=GPIO, PortPinOutputDrive=PORT_PIN_OUT_MODE_STRONG
              PortPin_P018_1: PortPinId=145, PortPinName=P018_1, PortPinDirection=PORT_PIN_IN, PortPinOutputInBufEnable=1, PortPinInitialMode=GPIO, PortPinMode=GPIO, PortPinOutputDrive=PORT_PIN_OUT_MODE_HIGHZ
              PortPin_P018_3: PortPinId=147, PortPinName=P018_3, PortPinDirection=PORT_PIN_OUT, PortPinOutputInBufEnable=1, PortPinInitialMode=TCPWM_0_LINE_54, PortPinMode=TCPWM_0_LINE_54, PortPinOutputDrive=PORT_PIN_OUT_MODE_STRONG
              PortPin_P018_4: PortPinId=148, PortPinName=P018_4, PortPinDirection=PORT_PIN_OUT, PortPinOutputInBufEnable=1, PortPinInitialMode=TCPWM_0_LINE_53, PortPinMode=TCPWM_0_LINE_53, PortPinOutputDrive=PORT_PIN_OUT_MODE_STRONG
              PortPin_P018_5: PortPinId=149, PortPinName=P018_5, PortPinDirection=PORT_PIN_IN_OUT_DISABLED, PortPinOutputInBufEnable=0, PortPinInitialMode=AMUXA, PortPinMode=AMUXA, PortPinOutputDrive=PORT_PIN_OUT_MODE_HIGHZ
              PortPin_P018_6: PortPinId=150, PortPinName=P018_6, PortPinDirection=PORT_PIN_IN_OUT_DISABLED, PortPinOutputInBufEnable=0, PortPinInitialMode=AMUXA, PortPinMode=AMUXA, PortPinOutputDrive=PORT_PIN_OUT_MODE_HIGHZ
              PortPin_P018_7: PortPinId=151, PortPinName=P018_7, PortPinDirection=PORT_PIN_IN, PortPinOutputInBufEnable=1, PortPinInitialMode=GPIO, PortPinMode=GPIO, PortPinOutputDrive=PORT_PIN_OUT_MODE_HIGHZ
          PortContainer21: PortId=21, PortNumberOfPortPins=4
            4 x PortPin, all with PortPinLevelValue=PORT_PIN_LEVEL_LOW, PortPinOutputDrive=PORT_PIN_OUT_MODE_HIGHZ, PortPinSmartioBypassEnable=1, PortPinSmartioSyncIoEnable=0, PortPinSmartioSyncChipEnable=0, PortPinSmartioLutTr0Source=PORT_SMART_LUT_TR_DU, PortPinSmartioLutTr1Source=PORT_SMART_LUT_TR_LUT0, PortPinSmartioLutTr2Source=PORT_SMART_LUT_TR_LUT0, PortPinSmartioLut=0, PortPinSmartioLutOperation=PORT_SMART_LUT_OPC_COM_OUT_NO_FB, PortPinInputBufferMode=PORT_PIN_IN_MODE_CMOS, PortPinOutputSlowSlewRateEnable=0, PortPinOutputDriveStrength=PORT_PIN_OUT_STRENGTH_FULL, PortPinOutputDriveSelectTrim=PORT_PIN_OUT_TRIM_DEFAULT, Port5VPinInputBufferMode=PORT_PIN_5V_IN_MODE_CMOS_OR_TTL:
              PortPin_P021_0: PortPinId=168, PortPinName=P021_0, PortPinDirection=PORT_PIN_IN, PortPinDirectionChangeable=1, PortPinOutputInBufEnable=1, PortPinInitialMode=GPIO, PortPinModeChangeable=1, PortPinMode=GPIO
              PortPin_P021_1: PortPinId=169, PortPinName=P021_1, PortPinDirection=PORT_PIN_IN_OUT_DISABLED, PortPinDirectionChangeable=1, PortPinOutputInBufEnable=0, PortPinInitialMode=AMUXA, PortPinModeChangeable=1, PortPinMode=AMUXA
              PortPin_P021_2: PortPinId=170, PortPinName=P021_2, PortPinDirection=PORT_PIN_IN_OUT_DISABLED, PortPinDirectionChangeable=0, PortPinOutputInBufEnable=0, PortPinInitialMode=AMUXA, PortPinModeChangeable=0, PortPinMode=GPIO
              PortPin_P021_3: PortPinId=171, PortPinName=P021_3, PortPinDirection=PORT_PIN_IN_OUT_DISABLED, PortPinDirectionChangeable=0, PortPinOutputInBufEnable=0, PortPinInitialMode=AMUXA, PortPinModeChangeable=0, PortPinMode=GPIO
          PortContainer22: PortId=22, PortNumberOfPortPins=1
            PortPin_P022_0 (PortPin):
              PortPinId = 176
              PortPinName = P022_0
              PortPinDirection = PORT_PIN_OUT
              PortPinDirectionChangeable = 1
              PortPinOutputInBufEnable = 1
              PortPinInitialMode = GPIO
              PortPinModeChangeable = 1
              PortPinMode = GPIO
              PortPinLevelValue = PORT_PIN_LEVEL_LOW
              PortPinOutputDrive = PORT_PIN_OUT_MODE_STRONG
              PortPinSmartioBypassEnable = 1
              PortPinSmartioSyncIoEnable = 0
              PortPinSmartioSyncChipEnable = 0
              PortPinSmartioLutTr0Source = PORT_SMART_LUT_TR_DU
              PortPinSmartioLutTr1Source = PORT_SMART_LUT_TR_LUT0
              PortPinSmartioLutTr2Source = PORT_SMART_LUT_TR_LUT0
              PortPinSmartioLut = 0
              PortPinSmartioLutOperation = PORT_SMART_LUT_OPC_COM_OUT_NO_FB
              PortPinInputBufferMode = PORT_PIN_IN_MODE_CMOS
              PortPinOutputSlowSlewRateEnable = 0
              PortPinOutputDriveStrength = PORT_PIN_OUT_STRENGTH_FULL
              PortPinOutputDriveSelectTrim = PORT_PIN_OUT_TRIM_DEFAULT
              Port5VPinInputBufferMode = PORT_PIN_5V_IN_MODE_CMOS_OR_TTL
          PortContainer23: PortId=23, PortNumberOfPortPins=5
            5 x PortPin, all with PortPinDirectionChangeable=1, PortPinOutputInBufEnable=1, PortPinModeChangeable=1, PortPinMode=GPIO, PortPinLevelValue=PORT_PIN_LEVEL_LOW, PortPinSmartioBypassEnable=1, PortPinSmartioSyncIoEnable=0, PortPinSmartioSyncChipEnable=0, PortPinSmartioLutTr0Source=PORT_SMART_LUT_TR_DU, PortPinSmartioLutTr1Source=PORT_SMART_LUT_TR_LUT0, PortPinSmartioLutTr2Source=PORT_SMART_LUT_TR_LUT0, PortPinSmartioLut=0, PortPinSmartioLutOperation=PORT_SMART_LUT_OPC_COM_OUT_NO_FB, PortPinInputBufferMode=PORT_PIN_IN_MODE_CMOS, PortPinOutputSlowSlewRateEnable=0, PortPinOutputDriveStrength=PORT_PIN_OUT_STRENGTH_FULL, PortPinOutputDriveSelectTrim=PORT_PIN_OUT_TRIM_DEFAULT, Port5VPinInputBufferMode=PORT_PIN_5V_IN_MODE_CMOS_OR_TTL:
              PortPin_P023_3: PortPinId=187, PortPinName=P023_3, PortPinDirection=PORT_PIN_OUT, PortPinInitialMode=GPIO, PortPinOutputDrive=PORT_PIN_OUT_MODE_STRONG
              PortPin_P023_4: PortPinId=188, PortPinName=P023_4, PortPinDirection=PORT_PIN_OUT, PortPinInitialMode=CPUSS_SWJ_SWO_TDO, PortPinOutputDrive=PORT_PIN_OUT_MODE_HIGHZ
              PortPin_P023_5: PortPinId=189, PortPinName=P023_5, PortPinDirection=PORT_PIN_IN, PortPinInitialMode=CPUSS_SWJ_SWCLK_TCLK, PortPinOutputDrive=PORT_PIN_OUT_MODE_HIGHZ
              PortPin_P023_6: PortPinId=190, PortPinName=P023_6, PortPinDirection=PORT_PIN_IN, PortPinInitialMode=CPUSS_SWJ_SWDIO_TMS, PortPinOutputDrive=PORT_PIN_OUT_MODE_HIGHZ
              PortPin_P023_7: PortPinId=191, PortPinName=P023_7, PortPinDirection=PORT_PIN_IN, PortPinInitialMode=CPUSS_SWJ_SWDOE_TDI, PortPinOutputDrive=PORT_PIN_OUT_MODE_HIGHZ
        PortAmuxSplitCell0 (PortAmuxSplitCell):
          PortAmuxSplitCellId = 0
          PortAmuxBusaSwitchSL = PORT_AMUX_SWITCH_OPEN
          PortAmuxBusaSwitchSR = PORT_AMUX_SWITCH_OPEN
          PortAmuxBusaSwitchS0 = PORT_AMUX_SWITCH_OPEN
          PortAmuxBusbSwitchSL = PORT_AMUX_SWITCH_OPEN
          PortAmuxBusbSwitchSR = PORT_AMUX_SWITCH_OPEN
          PortAmuxBusbSwitchS0 = PORT_AMUX_SWITCH_OPEN
    PortDefaultConfigSet
      PortDefaultAmuxSplitCell_0 (PortDefaultAmuxSplitCell):
        PortDefAmuxBusaSwitchS0 = PORT_AMUX_SWITCH_OPEN
        PortDefAmuxBusaSwitchSL = PORT_AMUX_SWITCH_OPEN
        PortDefAmuxBusaSwitchSR = PORT_AMUX_SWITCH_OPEN
        PortDefAmuxBusbSwitchS0 = PORT_AMUX_SWITCH_OPEN
        PortDefAmuxBusbSwitchSL = PORT_AMUX_SWITCH_OPEN
        PortDefAmuxBusbSwitchSR = PORT_AMUX_SWITCH_OPEN
      PortDefaultContainer_0 (PortDefaultContainer):
        PortDefSmartioClockSource = PORT_SMART_CLK_SRC_CONST0
        PortDefSmartioDataUnitBitSize = 1
        PortDefSmartioDataUnitData0Source = PORT_SMART_DU_DATA_CONST0
        PortDefSmartioDataUnitData1Source = PORT_SMART_DU_DATA_CONST0
        PortDefSmartioDataUnitOperation = PORT_SMART_DU_OPC_INCR
        PortDefSmartioDataUnitSource = 0
        PortDefSmartioDataUnitTr{0..2}Source = PORT_SMART_DU_TR_CONST0
        PortDefSmartioEnable = 0
        PortDefSmartioHoldOverrideEnable = 0
        PortDefSmartioPipelineEnable = 1
        PortDefaultPin_0 (PortDefaultPin):
          PortDef5VPinInputBufferMode = PORT_PIN_5V_IN_MODE_CMOS_OR_TTL
          PortDefPinDirection = PORT_PIN_IN
          PortDefPinDirectionChangeable = 0
          PortDefPinInitialMode = GPIO
          PortDefPinInputBufferMode = PORT_PIN_IN_MODE_CMOS
          PortDefPinLevelValue = PORT_PIN_LEVEL_LOW
          PortDefPinModeChangeable = 0
          PortDefPinOutputDrive = PORT_PIN_OUT_MODE_HIGHZ
          PortDefPinOutputDriveStrength = PORT_PIN_OUT_STRENGTH_FULL
          PortDefPinOutputInBufEnable = 1
          PortDefPinOutputSlowSlewRateEnable = 0
          PortDefPinSmartioBypassEnable = 1
          PortDefPinSmartioLut = 0
          PortDefPinSmartioLutOperation = PORT_SMART_LUT_OPC_COM_OUT_NO_FB
          PortDefPinSmartioLutTr0Source = PORT_SMART_LUT_TR_DU
          PortDefPinSmartioLutTr1Source = PORT_SMART_LUT_TR_LUT0
          PortDefPinSmartioLutTr2Source = PORT_SMART_LUT_TR_LUT0
          PortDefPinSmartioSyncChipEnable = 0
          PortDefPinSmartioSyncIoEnable = 0
    PortGeneral:
      PortDevErrorDetect = 1
      PortErrorCalloutFunction = Det_ReportError
      PortSafetyFunctionApi = 1
      PortSetPinDirectionApi = 1
      PortSetPinModeApi = 1
      PortSetToDioAlternateModeApi = 1
      PortSetTriggerApi = 1
      PortTriggerCommandApi = 1
      PortVersionInfoApi = 1
      PortIncludeFile = Det.h
    PortTriggerConfigSet_0 (PortTriggerConfigSet): PortTriggerConfigSetId=0
      PortTr1To1GroupContainer_0 (PortTr1To1GroupContainer): PortTr1To1GroupId=0, PortTr1To1GroupName=TCPWM_TO_LIN
        Port1To1OutputTrigger_0 (Port1To1OutputTrigger):
          PortTr1To1DbgFreezeEnable = 0
          PortTr1To1InputType = PORT_TR_1TO1_IN_CONST0
          PortTr1To1InvertEnable = 0
          PortTr1To1OutputName = LIN_0_TR_CMD_TX_HEADER_0
          PortTr1To1SensitiveType = PORT_TR_SENSITIVE_LEVEL
      3 x PortTrGroupContainer:
        PortTrGroupContainer_0: PortTrGroupId=0, PortTrGroupName=PDMA0_TR_0
          PortOutputTrigger_0 (PortOutputTrigger):
            PortTrDbgFreezeEnable = 0
            PortTrInputName = CPUSS_ZERO
            PortTrInvertEnable = 0
            PortTrOutputName = CPUSS_DW0_TR_IN_0
            PortTrSensitiveType = PORT_TR_SENSITIVE_LEVEL
        PortTrGroupContainer1: PortTrGroupId=8, PortTrGroupName=DEBUGMAIN
          PortOutputTrigger1 (PortOutputTrigger):
            PortTrOutputName = TCPWM_0_TR_DEBUG_FREEZE
            PortTrInputName = TR_GROUP_9_OUTPUT_0
            PortTrInvertEnable = 0
            PortTrSensitiveType = PORT_TR_SENSITIVE_LEVEL
            PortTrDbgFreezeEnable = 0
        PortTrGroupContainer2: PortTrGroupId=9, PortTrGroupName=DEBUGREDUCTION1
          PortOutputTrigger2 (PortOutputTrigger):
            PortTrOutputName = TR_GROUP_8_INPUT_1
            PortTrInputName = CPUSS_CTI_TR_OUT_0
            PortTrInvertEnable = 0
            PortTrSensitiveType = PORT_TR_SENSITIVE_LEVEL
            PortTrDbgFreezeEnable = 0

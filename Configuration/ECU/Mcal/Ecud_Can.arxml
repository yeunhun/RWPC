AUTOSAR XML (schema 4-0-3)
package /Can
  module config Can: implementation-config-variant=VARIANT-POST-BUILD, module-description=CanImplementation
    CanConfigSet
      SCM_LOCALCAN (CanController):
        category = TOOL_CONFIGURED
        CanBusoffProcessing = INTERRUPT
        CanControllerActivation = 1
        CanControllerId = 0
        CanTxProcessing = INTERRUPT
        CanRxProcessing = INTERRUPT
        CanWakeupProcessing = POLLING
        CanWakeupSupport = 1
        CanWakeupFunctionalityAPI = 1
        CanControllerBaseAddress = 0x40520000
        CanMessageRamBaseAddress = 0x40530000
        CanControllerPhysicalChannel = CANFD00
        CanMessageRamSize = 32768
        CanControllerInstance = INSTANCE0
        CanCpuClockRef = McuClockReferencePoint_CANFD0_CLOCK_CAN0
        CanWakeupSourceRef = ECUM_WKSOURCE_LOCALCAN_RX
        CanControllerDefaultBaudrate = SCM_LOCALCAN/CanControllerBaudrateConfig
        CanControllerBaudrateConfig:
          category = TOOL_CONFIGURED
          CanControllerBaudRate = 500
          CanControllerBaudRateConfigID = 0
          CanControllerPropSeg = 0
          CanControllerSeg1 = 15
          CanControllerSeg2 = 4
          CanControllerSyncJumpWidth = 4
      SCM_BCAN (CanController):
        category = TOOL_CONFIGURED
        CanBusoffProcessing = INTERRUPT
        CanControllerActivation = 1
        CanControllerId = 1
        CanTxProcessing = INTERRUPT
        CanRxProcessing = INTERRUPT
        CanWakeupProcessing = POLLING
        CanWakeupSupport = 1
        CanWakeupFunctionalityAPI = 1
        CanControllerBaseAddress = 0x40520400
        CanMessageRamBaseAddress = 0x40530000
        CanControllerPhysicalChannel = CANFD02
        CanMessageRamSize = 32768
        CanControllerInstance = INSTANCE0
        CanCpuClockRef = McuClockReferencePoint_CANFD0_CLOCK_CAN2
        CanWakeupSourceRef = ECUM_WKSOURCE_BCAN_RX
        CanControllerDefaultBaudrate = SCM_BCAN/CanControllerBaudrateConfig
        CanControllerBaudrateConfig:
          category = TOOL_CONFIGURED
          CanControllerBaudRate = 500
          CanControllerBaudRateConfigID = 0
          CanControllerPropSeg = 0
          CanControllerSeg1 = 15
          CanControllerSeg2 = 4
          CanControllerSyncJumpWidth = 4
      36 x CanHardwareObject, all with category=TOOL_CONFIGURED, CanIcomRxMessageDedicated=0, CanTriggerTransmitEnable=0:
        IN_HwObj_SCM_LOCALCAN_0x30a_LOCALCAN_TP_BDC_C_WPC: CanIdValue=778, CanObjectType=RECEIVE, CanHandleType=FULL, CanHwObjectCount=1, CanIdType=STANDARD, CanRxBufferSelection=CAN_RX_DEDICATED, CanObjectId=0, CanControllerRef=SCM_LOCALCAN
          CanHwFilter0 (CanHwFilter): category=TOOL_CONFIGURED, CanHwFilterMask=2047, CanHwFilterCode=778
        IN_HwObj_SCM_LOCALCAN_0x100_LOCALCAN_BDC_10: CanIdValue=256, CanObjectType=RECEIVE, CanHandleType=FULL, CanHwObjectCount=1, CanIdType=STANDARD, CanRxBufferSelection=CAN_RX_DEDICATED, CanObjectId=1, CanControllerRef=SCM_LOCALCAN
          CanHwFilter0 (CanHwFilter): category=TOOL_CONFIGURED, CanHwFilterMask=2047, CanHwFilterCode=256
        IN_HwObj_SCM_LOCALCAN_0x11_LOCALCAN_BDC_01: CanIdValue=17, CanObjectType=RECEIVE, CanHandleType=FULL, CanHwObjectCount=1, CanIdType=STANDARD, CanRxBufferSelection=CAN_RX_DEDICATED, CanObjectId=2, CanControllerRef=SCM_LOCALCAN
          CanHwFilter0 (CanHwFilter): category=TOOL_CONFIGURED, CanHwFilterMask=2047, CanHwFilterCode=17
        IN_HwObj_0x400_0x47f_SCM_LOCALCAN_NM_Message: CanIdValue=1024, CanObjectType=RECEIVE, CanHandleType=BASIC, CanIdType=STANDARD, CanHwObjectCount=13, CanRxBufferSelection=CAN_RX_FIFO0, CanObjectId=3, CanControllerRef=SCM_LOCALCAN
          CanHwFilter0 (CanHwFilter): category=TOOL_CONFIGURED, CanHwFilterMask=1920, CanHwFilterCode=1024
        IN_HwObj_SCM_BCAN_0x681aa02_BCAN_CLU_01_20ms_2: CanIdValue=109160962, CanObjectType=RECEIVE, CanHandleType=FULL, CanHwObjectCount=1, CanIdType=EXTENDED, CanRxBufferSelection=CAN_RX_DEDICATED, CanObjectId=4, CanControllerRef=SCM_BCAN
          CanHwFilter0 (CanHwFilter): category=TOOL_CONFIGURED, CanHwFilterMask=536870911, CanHwFilterCode=109160962
        IN_HwObj_SCM_BCAN_0x681aa01_BCAN_CLU_01_20ms_1: CanIdValue=109160961, CanObjectType=RECEIVE, CanHandleType=FULL, CanHwObjectCount=1, CanIdType=EXTENDED, CanRxBufferSelection=CAN_RX_DEDICATED, CanObjectId=5, CanControllerRef=SCM_BCAN
          CanHwFilter0 (CanHwFilter): category=TOOL_CONFIGURED, CanHwFilterMask=536870911, CanHwFilterCode=109160961
        IN_HwObj_SCM_BCAN_0x4010502_BCAN_EMS_07_10ms_2: CanIdValue=67175682, CanObjectType=RECEIVE, CanHandleType=FULL, CanHwObjectCount=1, CanIdType=EXTENDED, CanRxBufferSelection=CAN_RX_DEDICATED, CanObjectId=6, CanControllerRef=SCM_BCAN
          CanHwFilter0 (CanHwFilter): category=TOOL_CONFIGURED, CanHwFilterMask=536870911, CanHwFilterCode=67175682
        IN_HwObj_SCM_BCAN_0x4010001_BCAN_EMS_02_10ms_1: CanIdValue=67174401, CanObjectType=RECEIVE, CanHandleType=FULL, CanHwObjectCount=1, CanIdType=EXTENDED, CanRxBufferSelection=CAN_RX_DEDICATED, CanObjectId=7, CanControllerRef=SCM_BCAN
          CanHwFilter0 (CanHwFilter): category=TOOL_CONFIGURED, CanHwFilterMask=536870911, CanHwFilterCode=67174401
        IN_HwObj_SCM_BCAN_0x3c0fa02_BCAN_HCU_03_10ms_2: CanIdValue=62978562, CanObjectType=RECEIVE, CanHandleType=FULL, CanHwObjectCount=1, CanIdType=EXTENDED, CanRxBufferSelection=CAN_RX_DEDICATED, CanObjectId=8, CanControllerRef=SCM_BCAN
          CanHwFilter0 (CanHwFilter): category=TOOL_CONFIGURED, CanHwFilterMask=536870911, CanHwFilterCode=62978562
        IN_HwObj_SCM_BCAN_0xc03501_BCAN_VCU_01_10ms_1: CanIdValue=12596481, CanObjectType=RECEIVE, CanHandleType=FULL, CanHwObjectCount=1, CanIdType=EXTENDED, CanRxBufferSelection=CAN_RX_DEDICATED, CanObjectId=9, CanControllerRef=SCM_BCAN
          CanHwFilter0 (CanHwFilter): category=TOOL_CONFIGURED, CanHwFilterMask=536870911, CanHwFilterCode=12596481
        IN_HwObj_SCM_BCAN_0x7df_BCAN_GST_ALL: CanIdValue=2015, CanObjectType=RECEIVE, CanHandleType=FULL, CanHwObjectCount=1, CanIdType=STANDARD, CanRxBufferSelection=CAN_RX_DEDICATED, CanObjectId=10, CanControllerRef=SCM_BCAN
          CanHwFilter0 (CanHwFilter): category=TOOL_CONFIGURED, CanHwFilterMask=2047, CanHwFilterCode=2015
        IN_HwObj_SCM_BCAN_0x724_BCAN_GST_RWPC: CanIdValue=1828, CanObjectType=RECEIVE, CanHandleType=FULL, CanHwObjectCount=1, CanIdType=STANDARD, CanRxBufferSelection=CAN_RX_DEDICATED, CanObjectId=11, CanControllerRef=SCM_BCAN
          CanHwFilter0 (CanHwFilter): category=TOOL_CONFIGURED, CanHwFilterMask=2047, CanHwFilterCode=1828
        IN_HwObj_SCM_BCAN_0x4d8_BCAN_HU_GW_PE_01: CanIdValue=1240, CanObjectType=RECEIVE, CanHandleType=FULL, CanHwObjectCount=1, CanIdType=STANDARD, CanRxBufferSelection=CAN_RX_DEDICATED, CanObjectId=12, CanControllerRef=SCM_BCAN
          CanHwFilter0 (CanHwFilter): category=TOOL_CONFIGURED, CanHwFilterMask=2047, CanHwFilterCode=1240
        IN_HwObj_SCM_BCAN_0x4ab_BCAN_HU_USM_E_04: CanIdValue=1195, CanObjectType=RECEIVE, CanHandleType=FULL, CanHwObjectCount=1, CanIdType=STANDARD, CanRxBufferSelection=CAN_RX_DEDICATED, CanObjectId=13, CanControllerRef=SCM_BCAN
          CanHwFilter0 (CanHwFilter): category=TOOL_CONFIGURED, CanHwFilterMask=2047, CanHwFilterCode=1195
        IN_HwObj_SCM_BCAN_0x4a9_BCAN_HU_USM_E_02: CanIdValue=1193, CanObjectType=RECEIVE, CanHandleType=FULL, CanHwObjectCount=1, CanIdType=STANDARD, CanRxBufferSelection=CAN_RX_DEDICATED, CanObjectId=14, CanControllerRef=SCM_BCAN
          CanHwFilter0 (CanHwFilter): category=TOOL_CONFIGURED, CanHwFilterMask=2047, CanHwFilterCode=1193
        IN_HwObj_SCM_BCAN_0x44b_BCAN_WPC_01_200ms: CanIdValue=1099, CanObjectType=RECEIVE, CanHandleType=FULL, CanHwObjectCount=1, CanIdType=STANDARD, CanRxBufferSelection=CAN_RX_DEDICATED, CanObjectId=15, CanControllerRef=SCM_BCAN
          CanHwFilter0 (CanHwFilter): category=TOOL_CONFIGURED, CanHwFilterMask=2047, CanHwFilterCode=1099
        IN_HwObj_SCM_BCAN_0x447_BCAN_ATS_00_00ms: CanIdValue=1095, CanObjectType=RECEIVE, CanHandleType=FULL, CanHwObjectCount=1, CanIdType=STANDARD, CanRxBufferSelection=CAN_RX_DEDICATED, CanObjectId=16, CanControllerRef=SCM_BCAN
          CanHwFilter0 (CanHwFilter): category=TOOL_CONFIGURED, CanHwFilterMask=2047, CanHwFilterCode=1095
        IN_HwObj_SCM_BCAN_0x445_BCAN_SMK_06_200ms: CanIdValue=1093, CanObjectType=RECEIVE, CanHandleType=FULL, CanHwObjectCount=1, CanIdType=STANDARD, CanRxBufferSelection=CAN_RX_DEDICATED, CanObjectId=17, CanControllerRef=SCM_BCAN
          CanHwFilter0 (CanHwFilter): category=TOOL_CONFIGURED, CanHwFilterMask=2047, CanHwFilterCode=1093
        IN_HwObj_SCM_BCAN_0x442_BCAN_BCM_12_200ms: CanIdValue=1090, CanObjectType=RECEIVE, CanHandleType=FULL, CanHwObjectCount=1, CanIdType=STANDARD, CanRxBufferSelection=CAN_RX_DEDICATED, CanObjectId=18, CanControllerRef=SCM_BCAN
          CanHwFilter0 (CanHwFilter): category=TOOL_CONFIGURED, CanHwFilterMask=2047, CanHwFilterCode=1090
        IN_HwObj_SCM_BCAN_0x434_BCAN_IAU_16_200ms: CanIdValue=1076, CanObjectType=RECEIVE, CanHandleType=FULL, CanHwObjectCount=1, CanIdType=STANDARD, CanRxBufferSelection=CAN_RX_DEDICATED, CanObjectId=19, CanControllerRef=SCM_BCAN
          CanHwFilter0 (CanHwFilter): category=TOOL_CONFIGURED, CanHwFilterMask=2047, CanHwFilterCode=1076
        IN_HwObj_SCM_BCAN_0x41a_BCAN_BCM_07_200ms: CanIdValue=1050, CanObjectType=RECEIVE, CanHandleType=FULL, CanHwObjectCount=1, CanIdType=STANDARD, CanRxBufferSelection=CAN_RX_DEDICATED, CanObjectId=20, CanControllerRef=SCM_BCAN
          CanHwFilter0 (CanHwFilter): category=TOOL_CONFIGURED, CanHwFilterMask=2047, CanHwFilterCode=1050
        IN_HwObj_SCM_BCAN_0x411_BCAN_ICU_02_200ms: CanIdValue=1041, CanObjectType=RECEIVE, CanHandleType=FULL, CanHwObjectCount=1, CanIdType=STANDARD, CanRxBufferSelection=CAN_RX_DEDICATED, CanObjectId=21, CanControllerRef=SCM_BCAN
          CanHwFilter0 (CanHwFilter): category=TOOL_CONFIGURED, CanHwFilterMask=2047, CanHwFilterCode=1041
        IN_HwObj_SCM_BCAN_0x389_BCAN_SBCM_RR_01_200ms: CanIdValue=905, CanObjectType=RECEIVE, CanHandleType=FULL, CanHwObjectCount=1, CanIdType=STANDARD, CanRxBufferSelection=CAN_RX_DEDICATED, CanObjectId=22, CanControllerRef=SCM_BCAN
          CanHwFilter0 (CanHwFilter): category=TOOL_CONFIGURED, CanHwFilterMask=2047, CanHwFilterCode=905
        IN_HwObj_SCM_BCAN_0x35e_BCAN_SBCM_RL_01_200ms: CanIdValue=862, CanObjectType=RECEIVE, CanHandleType=FULL, CanHwObjectCount=1, CanIdType=STANDARD, CanRxBufferSelection=CAN_RX_DEDICATED, CanObjectId=23, CanControllerRef=SCM_BCAN
          CanHwFilter0 (CanHwFilter): category=TOOL_CONFIGURED, CanHwFilterMask=2047, CanHwFilterCode=862
        IN_HwObj_SCM_BCAN_0x35a_BCAN_SBCM_AST_02_200ms: CanIdValue=858, CanObjectType=RECEIVE, CanHandleType=FULL, CanHwObjectCount=1, CanIdType=STANDARD, CanRxBufferSelection=CAN_RX_DEDICATED, CanObjectId=24, CanControllerRef=SCM_BCAN
          CanHwFilter0 (CanHwFilter): category=TOOL_CONFIGURED, CanHwFilterMask=2047, CanHwFilterCode=858
        IN_HwObj_SCM_BCAN_0x33e_BCAN_WPC2_01_200ms: CanIdValue=830, CanObjectType=RECEIVE, CanHandleType=FULL, CanHwObjectCount=1, CanIdType=STANDARD, CanRxBufferSelection=CAN_RX_DEDICATED, CanObjectId=25, CanControllerRef=SCM_BCAN
          CanHwFilter0 (CanHwFilter): category=TOOL_CONFIGURED, CanHwFilterMask=2047, CanHwFilterCode=830
        IN_HwObj_SCM_BCAN_0x31f_BCAN_SBCM_DRV_01_200ms: CanIdValue=799, CanObjectType=RECEIVE, CanHandleType=FULL, CanHwObjectCount=1, CanIdType=STANDARD, CanRxBufferSelection=CAN_RX_DEDICATED, CanObjectId=26, CanControllerRef=SCM_BCAN
          CanHwFilter0 (CanHwFilter): category=TOOL_CONFIGURED, CanHwFilterMask=2047, CanHwFilterCode=799
        IN_HwObj_SCM_BCAN_0x1eb_BCAN_HU_USM_E_14: CanIdValue=491, CanObjectType=RECEIVE, CanHandleType=FULL, CanHwObjectCount=1, CanIdType=STANDARD, CanRxBufferSelection=CAN_RX_DEDICATED, CanObjectId=27, CanControllerRef=SCM_BCAN
          CanHwFilter0 (CanHwFilter): category=TOOL_CONFIGURED, CanHwFilterMask=2047, CanHwFilterCode=491
        IN_HwObj_0x500_0x57f_SCM_BCAN_NM_Message: CanIdValue=1280, CanObjectType=RECEIVE, CanHandleType=BASIC, CanIdType=STANDARD, CanHwObjectCount=30, CanRxBufferSelection=CAN_RX_FIFO0, CanObjectId=28, CanControllerRef=SCM_BCAN
          CanHwFilter0 (CanHwFilter): category=TOOL_CONFIGURED, CanHwFilterMask=1920, CanHwFilterCode=1280
        OUT_HwObj_SCM_LOCALCAN_0x10_LOCALCAN_WPC_01: CanIdValue=16, CanObjectType=TRANSMIT, CanHandleType=FULL, CanIdType=STANDARD, CanObjectId=29, CanHwObjectCount=1, CanControllerRef=SCM_LOCALCAN
        OUT_HwObj_SCM_LOCALCAN_0x110_LOCALCAN_WPC_10: CanIdValue=272, CanObjectType=TRANSMIT, CanHandleType=FULL, CanIdType=STANDARD, CanObjectId=30, CanHwObjectCount=1, CanControllerRef=SCM_LOCALCAN
        OUT_HwObj_SCM_LOCALCAN_0x318_LOCALCAN_TP_WPC_C_BDC: CanIdValue=792, CanObjectType=TRANSMIT, CanHandleType=FULL, CanIdType=STANDARD, CanObjectId=31, CanHwObjectCount=1, CanControllerRef=SCM_LOCALCAN
        OUT_HwObj_SCM_LOCALCAN_0x41e_LOCALCAN_NM_WPC: CanIdValue=1054, CanObjectType=TRANSMIT, CanHandleType=FULL, CanIdType=STANDARD, CanObjectId=32, CanHwObjectCount=1, CanControllerRef=SCM_LOCALCAN
        OUT_HwObj_SCM_BCAN_0x431_BCAN_RWPC_01_200ms: CanIdValue=1073, CanObjectType=TRANSMIT, CanHandleType=FULL, CanIdType=STANDARD, CanObjectId=33, CanHwObjectCount=1, CanControllerRef=SCM_BCAN
        OUT_HwObj_SCM_BCAN_0x51f_BCAN_NM_RWPC: CanIdValue=1311, CanObjectType=TRANSMIT, CanHandleType=FULL, CanIdType=STANDARD, CanObjectId=34, CanHwObjectCount=1, CanControllerRef=SCM_BCAN
        OUT_HwObj_SCM_BCAN_0x72c_BCAN_RWPC_GST: CanIdValue=1836, CanObjectType=TRANSMIT, CanHandleType=FULL, CanIdType=STANDARD, CanObjectId=35, CanHwObjectCount=1, CanControllerRef=SCM_BCAN
    CanGeneral:
      CanChangeBaudrateApi = 0
      CanDeInitApi = 0
      CanDevErrorDetection = 1
      CanErrorCalloutFunction = Det_ReportError
      CanGetStatusApi = 1
      CanHardwareCancellation = 1
      CanIdenticalIdCancellation = 1
      CanIncludeFile = Can_Version.h
      CanIncludeFile = Det.h
      CanIndex = 0
      CanMainFunctionModePeriod = 0.005
      CanPublicIcomSupport = 0
      CanRxIndicationCompatibility = CAN_ASR_422_COMPATIBILITY
      CanSetBaudrateInChangedClockApi = 0
      CanTimeoutDuration = 2.0
      CanVersionInfoApi = 1
      CanMultiplexedTransmission = 1
      CanOsCounterRef = OsCounter_0
      CanMainFunctionRWPeriods: category=TOOL_CONFIGURED, CanMainFunctionPeriod=0.005
      CanDemEventParameterRefs: CAN_E_HARDWARE_ERROR=CAN_E_HARDWARE_ERROR

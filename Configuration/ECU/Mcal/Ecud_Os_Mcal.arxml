AUTOSAR XML (schema 4-0-3)
package /Os
  module config Os: implementation-config-variant=VARIANT-PRE-COMPILE
    OsAppMode_0 (OsAppMode)
    OsCounter_0 (OsCounter): OsCounterMaxAllowedValue=4294967295, OsCounterMinCycle=1, OsCounterTicksPerBase=1, OsCounterType=HARDWARE, OsSecondsPerTick=0.001
    OsOS: OsStackMonitoring=1, OsStatus=EXTENDED, OsUseGetServiceId=1, OsUseParameterAccess=1, OsUseResScheduler=1
      OsHooks: OsErrorHook=1, OsPostTaskHook=1, OsPreTaskHook=1, OsShutdownHook=1, OsStartupHook=1
    OsResource_0 (OsResource): OsResourceProperty=INTERNAL
    CommonPublishedInformation

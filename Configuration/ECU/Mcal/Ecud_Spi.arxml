AUTOSAR XML (schema 4-0-3)
package /Spi
  module config Spi: implementation-config-variant=VARIANT-PRE-COMPILE, module-description=SpiImplementation
    SpiDriver
      SpiChannel_0 (SpiChannel): SpiAlignedBuffer=0, SpiChannelId=0, SpiChannelType=EB, SpiDataWidth=8, SpiEbMaxLength=256, SpiIbNBuffers=256, SpiTransferStart=MSB
      SpiExternalDevice_0 (SpiExternalDevice):
        SpiBaudrate = 1000000.0
        SpiCsIdentifier = P000_3
        SpiCsPolarity = LOW
        SpiDataShiftEdge = TRAILING
        SpiDeselect = 0.0
        SpiHoldDelay = 0.75
        SpiHwUnit = SCB0
        SpiSetupDelay = 0.75
        SpiShiftClockIdleLevel = LOW
        SpiTimeClk2Cs = 0.0
        SpiUseDma = 0
        SpiUseFifo = 1
        SpiEnableCs = 0
        SpiCsSelection = CS_VIA_GPIO
        SpiClockRef = McuClockReferencePoint_SCB0_CLOCK
      SpiJob_0 (SpiJob): SpiJobId=0, SpiJobPriority=0, SpiHwUnitSynchronous=SYNCHRONOUS, SpiDeviceAssignment=SpiExternalDevice_0
        SpiChannelList_0 (SpiChannelList): SpiChannelIndex=0, SpiChannelAssignment=SpiChannel_0
      SpiSequence_0 (SpiSequence): SpiInterruptibleSequence=0, SpiSequenceId=0, SpiJobAssignment=SpiJob_0
    SpiGeneral:
      SpiCancelApi = 1
      SpiChannelBuffersAllowed = 2
      SpiDevErrorDetect = 1
      SpiErrorCalloutFunction = Det_ReportError
      SpiHwStatusApi = 1
      SpiInterruptibleSeqAllowed = 0
      SpiLevelDelivered = 2
      SpiMainFunctionPeriod = 0.01
      SpiSupportConcurrentSyncTransmit = 0
      SpiVersionInfoApi = 1
      SpiIncludeFile = Det.h
    SpiPublishedInformation: SpiMaxHwUnit=32
    SpiDemEventParameterRefs: SPI_E_HARDWARE_ERROR=SPI_E_HARDWARE_ERROR

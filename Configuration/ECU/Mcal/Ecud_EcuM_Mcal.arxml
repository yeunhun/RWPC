AUTOSAR XML (schema 4-0-3)
package /EcuM
  module config EcuM: implementation-config-variant=VARIANT-POST-BUILD
    EcuMConfiguration
      EcuMCommonConfiguration: EcuMConfigConsistencyHash=0, EcuMDefaultAppMode=OsAppMode_0, EcuMOSResource=OsResource_0
        EcuMDefaultShutdownTarget: EcuMDefaultState=EcuMStateOff
        EcuMSleepMode_0 (EcuMSleepMode):
          EcuMSleepModeId = 0
          EcuMSleepModeSuspend = 1
          EcuMWakeupSourceMask = ECUM_WKSOURCE_POWER
          EcuMWakeupSourceMask = ECUM_WKSOURCE_EXTERNAL_WDG
          EcuMWakeupSourceMask = ECUM_WKSOURCE_GPT
          EcuMWakeupSourceMask = ECUM_WKSOURCE_INTERNAL_RESET
          EcuMWakeupSourceMask = ECUM_WKSOURCE_INTERNAL_WDG
          EcuMWakeupSourceMask = ECUM_WKSOURCE_RESET
          EcuMWakeupSourceMask = ECUM_WKSOURCE_LOCALCAN_RX
          EcuMWakeupSourceMask = ECUM_WKSOURCE_LOCALCAN_RX_POLL
          EcuMWakeupSourceMask = ECUM_WKSOURCE_BCAN_RX
          EcuMWakeupSourceMask = ECUM_WKSOURCE_BCAN_RX_POLL
        10 x EcuMWakeupSource, all with EcuMWakeupSourcePolling=0, EcuMResetReasonRef=MCU_RESET_UNDEFINED:
          ECUM_WKSOURCE_POWER: EcuMWakeupSourceId=0
          ECUM_WKSOURCE_RESET: EcuMWakeupSourceId=1
          ECUM_WKSOURCE_INTERNAL_RESET: EcuMWakeupSourceId=2
          ECUM_WKSOURCE_INTERNAL_WDG: EcuMWakeupSourceId=3
          ECUM_WKSOURCE_EXTERNAL_WDG: EcuMWakeupSourceId=4
          ECUM_WKSOURCE_GPT: EcuMWakeupSourceId=5
          ECUM_WKSOURCE_LOCALCAN_RX: EcuMWakeupSourceId=8
          ECUM_WKSOURCE_LOCALCAN_RX_POLL: EcuMWakeupSourceId=9
          ECUM_WKSOURCE_BCAN_RX: EcuMWakeupSourceId=6
          ECUM_WKSOURCE_BCAN_RX_POLL: EcuMWakeupSourceId=7
    EcuMGeneral: EcuMDevErrorDetect=1, EcuMIncludeDet=1, EcuMMainFunctionPeriod=0.0, EcuMVersionInfoApi=1
    CommonPublishedInformation

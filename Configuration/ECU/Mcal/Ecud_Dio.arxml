AUTOSAR XML (schema 4-0-3)
package /Dio
  module config Dio: implementation-config-variant=VARIANT-PRE-COMPILE, module-description=DioImplementation
    DioConfig_0 (DioConfig)
      14 x DioPort:
        DioPort0: DioPortId=0
          4 x DioChannel:
            DioChannel_P000_{0..3}: DioChannelId={0..3}, DioChannelPin=P000_{0..3}
        DioPort2: DioPortId=2
          DioChannel_P002_0 (DioChannel): DioChannelId=16, DioChannelPin=P002_0
          DioChannel_P002_1 (DioChannel): DioChannelId=17, DioChannelPin=P002_1
        DioPort5: DioPortId=5
          DioChannel_P005_0 (DioChannel): DioChannelId=40, DioChannelPin=P005_0
          DioChannel_P005_1 (DioChannel): DioChannelId=41, DioChannelPin=P005_1
        DioPort6: DioPortId=6
          7 x DioChannel:
            DioChannel_P006_0: DioChannelId=48, DioChannelPin=P006_0
            DioChannel_P006_1: DioChannelId=49, DioChannelPin=P006_1
            DioChannel_P006_2: DioChannelId=50, DioChannelPin=P006_2
            DioChannel_P006_3: DioChannelId=51, DioChannelPin=P006_3
            DioChannel_P006_4: DioChannelId=52, DioChannelPin=P006_4
            DioChannel_P006_5: DioChannelId=53, DioChannelPin=P006_5
            DioChannel_P006_6: DioChannelId=54, DioChannelPin=P006_6
        DioPort7: DioPortId=7
          3 x DioChannel:
            DioChannel_P007_0: DioChannelId=56, DioChannelPin=P007_0
            DioChannel_P007_1: DioChannelId=57, DioChannelPin=P007_1
            DioChannel_P007_2: DioChannelId=58, DioChannelPin=P007_2
        DioPort8: DioPortId=8
          DioChannel_P008_0 (DioChannel): DioChannelId=64, DioChannelPin=P008_0
          DioChannel_P008_1 (DioChannel): DioChannelId=65, DioChannelPin=P008_1
        DioPort11: DioPortId=11
          3 x DioChannel:
            DioChannel_P011_0: DioChannelId=88, DioChannelPin=P011_0
            DioChannel_P011_1: DioChannelId=89, DioChannelPin=P011_1
            DioChannel_P011_2: DioChannelId=90, DioChannelPin=P011_2
        DioPort12: DioPortId=12
          DioChannel_P012_0 (DioChannel): DioChannelId=96, DioChannelPin=P012_0
          DioChannel_P012_1 (DioChannel): DioChannelId=97, DioChannelPin=P012_1
        DioPort13: DioPortId=13
          4 x DioChannel:
            DioChannel_P013_0: DioChannelId=104, DioChannelPin=P013_0
            DioChannel_P013_1: DioChannelId=105, DioChannelPin=P013_1
            DioChannel_P013_2: DioChannelId=106, DioChannelPin=P013_2
            DioChannel_P013_3: DioChannelId=107, DioChannelPin=P013_3
        DioPort14: DioPortId=14
          3 x DioChannel:
            DioChannel_P014_0: DioChannelId=112, DioChannelPin=P014_0
            DioChannel_P014_1: DioChannelId=113, DioChannelPin=P014_1
            DioChannel_P014_2: DioChannelId=114, DioChannelPin=P014_2
        DioPort18: DioPortId=18
          7 x DioChannel:
            DioChannel_P018_0: DioChannelId=144, DioChannelPin=P018_0
            DioChannel_P018_1: DioChannelId=145, DioChannelPin=P018_1
            DioChannel_P018_3: DioChannelId=147, DioChannelPin=P018_3
            DioChannel_P018_4: DioChannelId=148, DioChannelPin=P018_4
            DioChannel_P018_5: DioChannelId=149, DioChannelPin=P018_5
            DioChannel_P018_6: DioChannelId=150, DioChannelPin=P018_6
            DioChannel_P018_7: DioChannelId=151, DioChannelPin=P018_7
        DioPort21: DioPortId=21
          4 x DioChannel:
            DioChannel_P021_0: DioChannelId=168, DioChannelPin=P021_0
            DioChannel_P021_1: DioChannelId=169, DioChannelPin=P021_1
            DioChannel_P021_2: DioChannelId=170, DioChannelPin=P021_2
            DioChannel_P021_3: DioChannelId=171, DioChannelPin=P021_3
        DioPort22: DioPortId=22
          DioChannel_P022_0 (DioChannel): DioChannelId=176, DioChannelPin=P022_0
        DioPort23: DioPortId=23
          5 x DioChannel:
            DioChannel_P023_3: DioChannelId=187, DioChannelPin=P023_3
            DioChannel_P023_4: DioChannelId=188, DioChannelPin=P023_4
            DioChannel_P023_5: DioChannelId=189, DioChannelPin=P023_5
            DioChannel_P023_6: DioChannelId=190, DioChannelPin=P023_6
            DioChannel_P023_7: DioChannelId=191, DioChannelPin=P023_7
    DioGeneral: DioDevErrorDetect=1, DioErrorCalloutFunction=Det_ReportError, DioFlipChannelApi=1, DioMaskedWritePortApi=1, DioVersionInfoApi=1, DioIncludeFile=Det.h

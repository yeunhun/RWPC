AUTOSAR XML (schema 4-0-3)
package /AUTOSAR
  module config Os: implementation-config-variant=VARIANT-PRE-COMPILE, module-description=BswImplementation_Os
    6 x OsAlarm, all with OsAlarmCounterRef=OsCounter_0:
      OsAlarm_BSW_5ms_Com
        OsAlarmAction: category=TOOL_CONFIGURED
          OsAlarmActivateTask: category=TOOL_CONFIGURED, OsAlarmActivateTaskRef=OsTask_BSW_FG1_5ms_Com
      OsAlarm_ASW_5ms
        OsAlarmAction
          OsAlarmActivateTask: OsAlarmActivateTaskRef=OsTask_ASW_FG1_5ms
      OsAlarm_BSW_10ms
        OsAlarmAction: category=TOOL_CONFIGURED
          OsAlarmActivateTask: category=TOOL_CONFIGURED, OsAlarmActivateTaskRef=OsTask_BSW_FG1_10ms
      OsAlarm_BSW_100ms
        OsAlarmAction
          OsAlarmActivateTask: OsAlarmActivateTaskRef=OsTask_BSW_FG1_100ms
      OsAlarm_ASW_10ms
        OsAlarmAction: category=TOOL_CONFIGURED
          OsAlarmActivateTask: category=TOOL_CONFIGURED, OsAlarmActivateTaskRef=OsTask_ASW_FG1_10ms
      OsAlarm_ASW_100ms
        OsAlarmAction: category=TOOL_CONFIGURED
          OsAlarmActivateTask: category=TOOL_CONFIGURED, OsAlarmActivateTaskRef=OsTask_ASW_FG1_100ms
    OsAppMode0 (OsAppMode)
    OsCounter_0 (OsCounter):
      OsCounterMaxAllowedValue = 0xFFFFFFFF
      OsCounterMinCycle = 1
      OsCounterTicksPerBase = 1
      OsCounterType = HARDWARE
      OsDrivingInterrupt = SYSTICK
      OsSecondsPerTick = 0.00125
    OsOS:
      OsNumberOfCores = 1
      OsScalabilityClass = SC1
      OsStackMonitoring = 1
      OsStatus = EXTENDED
      OsUseGetServiceId = 1
      OsUseResScheduler = 1
      OsProcessor = CYT2B93CAS
      OsProcessorSeries = CYT2B9
      OsUseParameterAccess = 1
      OsUserStackSize = 4096
      OsStackFrame = StackFrame8
      OsSystemTimerClock = 160
      OsHooks0 (OsHooks): OsErrorHook=1, OsPostTaskHook=0, OsPreTaskHook=0, OsProtectionHook=0, OsStartupHook=1, OsShutdownHook=1, OsProfilingHook=1
    22 x OsTask, all with OsTaskActivation=1, OsTaskSchedule=FULL:
      OsTask_BSW_ComMModeRequest: OsTaskPriority=253
      OsTask_BSW_FG2_IOManager: OsTaskPriority=220, OsTaskResourceRef=OsResource_FG2
      OsTask_BSW_FG2_WdgMAPI: OsTaskPriority=210, OsTaskResourceRef=OsResource_FG2
      OsTask_ASW_FG2_WdgMTestMode: OsTaskPriority=205, OsTaskResourceRef=OsResource_FG2
      OsTask_BSW_FG1_5ms_Com: OsTaskPriority=197, OsTaskResourceRef=OsResource_FG1
      OsTask_ASW_FG1_5ms: OsTaskPriority=196, OsTaskResourceRef=OsResource_FG1
      OsTask_BSW_FG1_IOManager: OsTaskPriority=195, OsTaskResourceRef=OsResource_FG1
      OsTask_BSW_FG1_10ms: OsTaskPriority=180, OsTaskResourceRef=OsResource_FG1
      OsTask_ASW_FG1_10ms: OsTaskPriority=140, OsTaskResourceRef=OsResource_FG1
      OsTask_ASW_TaskEvent_10ms_NP0: OsTaskPriority=139, OsTaskResourceRef=OsResource_FG1
      OsTask_ASW_TaskEvent_10ms_NP1: OsTaskPriority=137, OsTaskResourceRef=OsResource_FG1
      OsTask_ASW_FG1_BCanCbkRx: OsTaskPriority=130, OsTaskStackSize=512, OsTaskResourceRef=OsResource_FG1, OsTaskEventRef=OsEvent_BCAN_DRE_01, OsTaskEventRef=OsEvent_BCAN_DRE_02, OsTaskEventRef=OsEvent_BCAN_DRE_03, OsTaskEventRef=OsEvent_BCAN_DRE_04, OsTaskEventRef=OsEvent_BCAN_DRE_05, OsTaskEventRef=OsEvent_BCAN_DRE_06, OsTaskEventRef=OsEvent_BCAN_DRE_07, OsTaskEventRef=OsEvent_BCAN_DRE_08, OsTaskEventRef=OsEvent_BCAN_DRE_09, OsTaskEventRef=OsEvent_BCAN_DRE_10, OsTaskEventRef=OsEvent_BCAN_DRE_11, OsTaskEventRef=OsEvent_BCAN_DRE_12, OsTaskEventRef=OsEvent_BCAN_DRE_13, OsTaskEventRef=OsEvent_BCAN_DRE_14, OsTaskEventRef=OsEvent_BCAN_DRE_15, OsTaskEventRef=OsEvent_BCAN_DRE_16, OsTaskEventRef=OsEvent_BCAN_DRE_17, OsTaskEventRef=OsEvent_BCAN_DRE_18, OsTaskEventRef=OsEvent_BCAN_DRE_19, OsTaskEventRef=OsEvent_BCAN_DRE_20, OsTaskEventRef=OsEvent_BCAN_DRE_21, OsTaskEventRef=OsEvent_BCAN_DRE_22, OsTaskEventRef=OsEvent_BCAN_DRE_23, OsTaskEventRef=OsEvent_BCAN_DRE_24, OsTaskEventRef=OsEvent_BCAN_DRE_25, OsTaskEventRef=OsEvent_BCAN_DRE_26
      OsTask_ASW_FG1_BCanCbkRxTOut: OsTaskPriority=128, OsTaskStackSize=512, OsTaskResourceRef=OsResource_FG1, OsTaskEventRef=OsEvent_BCAN_DREE_01, OsTaskEventRef=OsEvent_BCAN_DREE_02, OsTaskEventRef=OsEvent_BCAN_DREE_03, OsTaskEventRef=OsEvent_BCAN_DREE_04, OsTaskEventRef=OsEvent_BCAN_DREE_05, OsTaskEventRef=OsEvent_BCAN_DREE_06, OsTaskEventRef=OsEvent_BCAN_DREE_07, OsTaskEventRef=OsEvent_BCAN_DREE_08, OsTaskEventRef=OsEvent_BCAN_DREE_09, OsTaskEventRef=OsEvent_BCAN_DREE_10, OsTaskEventRef=OsEvent_BCAN_DREE_11, OsTaskEventRef=OsEvent_BCAN_DREE_12, OsTaskEventRef=OsEvent_BCAN_DREE_13, OsTaskEventRef=OsEvent_BCAN_DREE_14, OsTaskEventRef=OsEvent_BCAN_DREE_15, OsTaskEventRef=OsEvent_BCAN_DREE_16, OsTaskEventRef=OsEvent_BCAN_DREE_17, OsTaskEventRef=OsEvent_BCAN_DREE_18, OsTaskEventRef=OsEvent_BCAN_DREE_19, OsTaskEventRef=OsEvent_BCAN_DREE_20, OsTaskEventRef=OsEvent_BCAN_DREE_21, OsTaskEventRef=OsEvent_BCAN_DREE_22, OsTaskEventRef=OsEvent_BCAN_DREE_23, OsTaskEventRef=OsEvent_BCAN_DREE_24, OsTaskEventRef=OsEvent_BCAN_DREE_25, OsTaskEventRef=OsEvent_BCAN_DREE_26
      OsTask_BSW_FG1_100ms: OsTaskPriority=120, OsTaskResourceRef=OsResource_FG1
      OsTask_ASW_FG1_100ms: OsTaskPriority=116, OsTaskResourceRef=OsResource_FG1
      OsTask_BSW_Init: OsTaskPriority=99
        OsTaskAutostart: OsTaskAppModeRef=OsAppMode0
      OsTask_BSW_Mem_Process: OsTaskPriority=98, OsTaskStackSize=1024, OsTaskEventRef=OsEvent_BSW_Mem_Process
      OsTask_BSW_BG_Csm: OsTaskPriority=5
      OsTask_BSW_BG_RomTst: OsTaskPriority=1
      OsTask_ASW_TaskEvent_10ms_NP2: OsTaskPriority=138, OsTaskResourceRef=OsResource_FG1
      OsTask_ASW_TaskEvent_5ms_NP0: OsTaskPriority=194, OsTaskResourceRef=OsResource_FG1
      OsTask_ASW_TaskEvent_5ms_NP3: OsTaskPriority=193, OsTaskResourceRef=OsResource_FG1
    OsResource_FG1 (OsResource): OsResourceProperty=INTERNAL
    OsResource_FG2 (OsResource): OsResourceProperty=INTERNAL
    OsAlarm_BSW_Mem_Process (OsAlarm): OsAlarmCounterRef=OsCounter_0
      OsAlarmAction
        OsAlarmSetEvent: OsAlarmSetEventRef=OsEvent_BSW_Mem_Process, OsAlarmSetEventTaskRef=OsTask_BSW_Mem_Process
    65 x OsEvent:
      OsEvent_BSW_Mem_Process: OsEventMask=1
      OsEvent_BCAN_DRE_01: OsEventMask=0x00000001
      OsEvent_BCAN_DRE_02: OsEventMask=0x00000002
      OsEvent_BCAN_DRE_03: OsEventMask=0x00000004
      OsEvent_BCAN_DRE_04: OsEventMask=0x00000008
      OsEvent_BCAN_DRE_05: OsEventMask=0x00000010
      OsEvent_BCAN_DRE_06: OsEventMask=0x00000020
      OsEvent_BCAN_DRE_07: OsEventMask=0x00000040
      OsEvent_BCAN_DRE_08: OsEventMask=0x00000080
      OsEvent_BCAN_DRE_09: OsEventMask=0x00000100
      OsEvent_BCAN_DRE_10: OsEventMask=0x00000200
      OsEvent_BCAN_DRE_11: OsEventMask=0x00000400
      OsEvent_BCAN_DRE_12: OsEventMask=0x00000800
      OsEvent_BCAN_DRE_13: OsEventMask=0x00001000
      OsEvent_BCAN_DRE_14: OsEventMask=0x00002000
      OsEvent_BCAN_DRE_15: OsEventMask=0x00004000
      OsEvent_BCAN_DRE_16: OsEventMask=0x00008000
      OsEvent_BCAN_DRE_17: OsEventMask=0x00010000
      OsEvent_BCAN_DRE_18: OsEventMask=0x00020000
      OsEvent_BCAN_DRE_19: OsEventMask=0x00040000
      OsEvent_BCAN_DRE_20: OsEventMask=0x00080000
      OsEvent_BCAN_DRE_21: OsEventMask=0x00100000
      OsEvent_BCAN_DRE_22: OsEventMask=0x00200000
      OsEvent_BCAN_DRE_23: OsEventMask=0x00400000
      OsEvent_BCAN_DRE_24: OsEventMask=0x00800000
      OsEvent_BCAN_DRE_25: OsEventMask=0x01000000
      OsEvent_BCAN_DRE_26: OsEventMask=0x02000000
      OsEvent_BCAN_DREE_01: OsEventMask=0x00000001
      OsEvent_BCAN_DREE_02: OsEventMask=0x00000002
      OsEvent_BCAN_DREE_03: OsEventMask=0x00000004
      OsEvent_BCAN_DREE_04: OsEventMask=0x00000008
      OsEvent_BCAN_DREE_05: OsEventMask=0x00000010
      OsEvent_BCAN_DREE_06: OsEventMask=0x00000020
      OsEvent_BCAN_DREE_07: OsEventMask=0x00000040
      OsEvent_BCAN_DREE_08: OsEventMask=0x00000080
      OsEvent_BCAN_DREE_09: OsEventMask=0x00000100
      OsEvent_BCAN_DREE_10: OsEventMask=0x00000200
      OsEvent_BCAN_DREE_11: OsEventMask=0x00000400
      OsEvent_BCAN_DREE_12: OsEventMask=0x00000800
      OsEvent_BCAN_DREE_13: OsEventMask=0x00001000
      OsEvent_BCAN_DREE_14: OsEventMask=0x00002000
      OsEvent_BCAN_DREE_15: OsEventMask=0x00004000
      OsEvent_BCAN_DREE_16: OsEventMask=0x00008000
      OsEvent_BCAN_DREE_17: OsEventMask=0x00010000
      OsEvent_BCAN_DREE_18: OsEventMask=0x00020000
      OsEvent_BCAN_DREE_19: OsEventMask=0x00040000
      OsEvent_BCAN_DREE_20: OsEventMask=0x00080000
      OsEvent_BCAN_DREE_21: OsEventMask=0x00100000
      OsEvent_BCAN_DREE_22: OsEventMask=0x00200000
      OsEvent_BCAN_DREE_23: OsEventMask=0x00400000
      OsEvent_BCAN_DREE_24: OsEventMask=0x00800000
      OsEvent_BCAN_DREE_25: OsEventMask=0x01000000
      OsEvent_BCAN_DREE_26: OsEventMask=0x02000000
      OsEvent_LCAN_DRE_01: OsEventMask=0x00000001
      OsEvent_LCAN_DRE_02: OsEventMask=0x00000002
      OsEvent_LCAN_DRE_03: OsEventMask=0x00000004
      OsEvent_LCAN_DRE_04: OsEventMask=0x00000008
      OsEvent_LCAN_DRE_05: OsEventMask=0x00000010
      OsEvent_LCAN_DRE_06: OsEventMask=0x00000020
      OsEvent_LCAN_DREE_01: OsEventMask=0x00000001
      OsEvent_LCAN_DREE_02: OsEventMask=0x00000002
      OsEvent_LCAN_DREE_03: OsEventMask=0x00000004
      OsEvent_LCAN_DREE_04: OsEventMask=0x00000008
      OsEvent_LCAN_DREE_05: OsEventMask=0x00000010
      OsEvent_LCAN_DREE_06: OsEventMask=0x00000020
    14 x OsIsr, all with OsIsrCategory=CATEGORY_2, OsIsrHardwarePriority=6:
      Adc_IsrConversionDone_99_Cat2: OsIsrName=SAR0, Channel #3 Interrupt(99)
      Adc_IsrConversionDone_155_Cat2: OsIsrName=SAR2, Channel #3 Interrupt(155)
      Can_Interrupt_CANFD00_Cat2: OsIsrName=CAN0, Interrupt #0, Channel #0(57)
      Can_Interrupt_CANFD02_Cat2: OsIsrName=CAN0, Interrupt #0, Channel #2(59)
      GPT_Isr_Vector_307_Cat2: OsIsrName=TCPWM0 Group #0, Counter #7 Interrupt(307)
      GPT_Isr_Vector_310_Cat2: OsIsrName=TCPWM0 Group #0, Counter #10 Interrupt(310)
      GPT_Isr_Vector_303_Cat2: OsIsrName=TCPWM0 Group #0, Counter #3 Interrupt(303)
      GPT_Isr_Vector_305_Cat2: OsIsrName=TCPWM0 Group #0, Counter #5 Interrupt(305)
      Hsm_Isr_Vector_4_Cat2: OsIsrName=CPUSS Inter Process Communication Interrupt #4(4)
      Icu_Isr_Vector_23_Cat2: OsIsrName=GPIO_STD Port #2 Interrupt(23)
      Icu_Isr_Vector_27_Cat2: OsIsrName=GPIO_STD Port #6 Interrupt(27)
      Icu_Isr_Vector_28_Cat2: OsIsrName=GPIO_STD Port #7 Interrupt(28)
      Icu_Isr_Vector_39_Cat2: OsIsrName=GPIO_STD Port #18 Interrupt(39)
      evtgen_0_interrupt_dpslp_IRQn_Cat2: OsIsrName=Event gen DeepSleep domain interrupt(18)
    OsApplication0 (OsApplication):
      OsTrusted = 1
      OsApplicationStackSize = 1024
      OsAppAlarmRef = OsAlarm_ASW_100ms
      OsAppAlarmRef = OsAlarm_ASW_10ms
      OsAppAlarmRef = OsAlarm_ASW_5ms
      OsAppAlarmRef = OsAlarm_BSW_100ms
      OsAppAlarmRef = OsAlarm_BSW_10ms
      OsAppAlarmRef = OsAlarm_BSW_5ms_Com
      OsAppAlarmRef = OsAlarm_BSW_Mem_Process
      OsAppCounterRef = OsCounter_0
      OsAppIsrRef = Adc_IsrConversionDone_155_Cat2
      OsAppIsrRef = Adc_IsrConversionDone_99_Cat2
      OsAppIsrRef = Can_Interrupt_CANFD00_Cat2
      OsAppIsrRef = Can_Interrupt_CANFD02_Cat2
      OsAppIsrRef = evtgen_0_interrupt_dpslp_IRQn_Cat2
      OsAppIsrRef = GPT_Isr_Vector_303_Cat2
      OsAppIsrRef = GPT_Isr_Vector_305_Cat2
      OsAppIsrRef = GPT_Isr_Vector_307_Cat2
      OsAppIsrRef = GPT_Isr_Vector_310_Cat2
      OsAppIsrRef = Hsm_Isr_Vector_4_Cat2
      OsAppIsrRef = Icu_Isr_Vector_23_Cat2
      OsAppIsrRef = Icu_Isr_Vector_27_Cat2
      OsAppIsrRef = Icu_Isr_Vector_28_Cat2
      OsAppIsrRef = Icu_Isr_Vector_39_Cat2
      OsAppTaskRef = OsTask_ASW_FG1_100ms
      OsAppTaskRef = OsTask_ASW_FG1_10ms
      OsAppTaskRef = OsTask_ASW_FG1_5ms
      OsAppTaskRef = OsTask_ASW_FG1_BCanCbkRx
      OsAppTaskRef = OsTask_ASW_FG1_BCanCbkRxTOut
      OsAppTaskRef = OsTask_ASW_FG2_WdgMTestMode
      OsAppTaskRef = OsTask_ASW_TaskEvent_10ms_NP{0..2}
      OsAppTaskRef = OsTask_ASW_TaskEvent_5ms_NP0
      OsAppTaskRef = OsTask_BSW_BG_Csm
      OsAppTaskRef = OsTask_BSW_BG_RomTst
      OsAppTaskRef = OsTask_BSW_ComMModeRequest
      OsAppTaskRef = OsTask_BSW_FG1_100ms
      OsAppTaskRef = OsTask_BSW_FG1_10ms
      OsAppTaskRef = OsTask_BSW_FG1_5ms_Com
      OsAppTaskRef = OsTask_BSW_FG1_IOManager
      OsAppTaskRef = OsTask_BSW_FG2_IOManager
      OsAppTaskRef = OsTask_BSW_FG2_WdgMAPI
      OsAppTaskRef = OsTask_BSW_Init
      OsAppTaskRef = OsTask_BSW_Mem_Process
      OsAppTaskRef = OsTask_ASW_TaskEvent_5ms_NP3
      OsAppResourceRef = OsResource_FG1
      OsAppResourceRef = OsResource_FG2
      OsApplicationHooks: OsAppErrorHook=0, OsAppShutdownHook=0, OsAppStartupHook=0

[part 2 of 2: package /AUTOSAR]
AUTOSAR XML (schema 4-0-3)
package /AUTOSAR  (continued)
  module config BswM: implementation-config-variant=VARIANT-PRE-COMPILE, module-description=BswImplementation_BswM  (continued)
    BswMConfig  (continued)
      BswMModeControl: category=TOOL_CONFIGURED
        139 x BswMAction:
          AC_ComMAllowCom_BCAN_FALSE: category=TOOL_CONFIGURED
            BswMAvailableActions: category=TOOL_CONFIGURED
              BswMComMAllowCom: category=TOOL_CONFIGURED, BswMComAllowed=0, BswMComMAllowChannelRef=ComMChannel_BCAN
          AC_ComMAllowCom_BCAN_TRUE: category=TOOL_CONFIGURED
            BswMAvailableActions: category=TOOL_CONFIGURED
              BswMComMAllowCom: category=TOOL_CONFIGURED, BswMComAllowed=1, BswMComMAllowChannelRef=ComMChannel_BCAN
          AC_ComMAllowCom_LOCALCAN_FALSE: category=TOOL_CONFIGURED
            BswMAvailableActions: category=TOOL_CONFIGURED
              BswMComMAllowCom: category=TOOL_CONFIGURED, BswMComAllowed=0, BswMComMAllowChannelRef=ComMChannel_LOCALCAN
          AC_ComMAllowCom_LOCALCAN_TRUE: category=TOOL_CONFIGURED
            BswMAvailableActions: category=TOOL_CONFIGURED
              BswMComMAllowCom: category=TOOL_CONFIGURED, BswMComAllowed=1, BswMComMAllowChannelRef=ComMChannel_LOCALCAN
          AC_ComMModeSwitch_BCAN_FULL_COM: category=TOOL_CONFIGURED
            BswMAvailableActions: category=TOOL_CONFIGURED
              BswMComMModeSwitch: category=TOOL_CONFIGURED, BswMComMRequestedMode=BSWM_FULL_COM, BswMComMUserRef=ComMUser_BCAN
          AC_ComMModeSwitch_BCAN_NO_COM: category=TOOL_CONFIGURED
            BswMAvailableActions: category=TOOL_CONFIGURED
              BswMComMModeSwitch: category=TOOL_CONFIGURED, BswMComMRequestedMode=BSWM_NO_COM, BswMComMUserRef=ComMUser_BCAN
          AC_ComMModeSwitch_LOCALCAN_FULL_COM: category=TOOL_CONFIGURED
            BswMAvailableActions: category=TOOL_CONFIGURED
              BswMComMModeSwitch: category=TOOL_CONFIGURED, BswMComMRequestedMode=BSWM_FULL_COM, BswMComMUserRef=ComMUser_LOCALCAN
          AC_ComMModeSwitch_LOCALCAN_NO_COM: category=TOOL_CONFIGURED
            BswMAvailableActions: category=TOOL_CONFIGURED
              BswMComMModeSwitch: category=TOOL_CONFIGURED, BswMComMRequestedMode=BSWM_NO_COM, BswMComMUserRef=ComMUser_LOCALCAN
          AC_DeadlineMonitoringControl_Rx_SCM_BCAN_DISABLE: category=TOOL_CONFIGURED
            BswMAvailableActions: category=TOOL_CONFIGURED
              BswMDeadlineMonitoringControl: category=TOOL_CONFIGURED, BswMDisabledDMPduGroupRef=ComIPduGroupRx_SCM_BCAN
          AC_DeadlineMonitoringControl_Rx_SCM_BCAN_ENABLE: category=TOOL_CONFIGURED
            BswMAvailableActions: category=TOOL_CONFIGURED
              BswMDeadlineMonitoringControl: category=TOOL_CONFIGURED, BswMEnabledDMPduGroupRef=ComIPduGroupRx_SCM_BCAN
          AC_DeadlineMonitoringControl_Rx_SCM_LOCALCAN_DISABLE: category=TOOL_CONFIGURED
            BswMAvailableActions: category=TOOL_CONFIGURED
              BswMDeadlineMonitoringControl: category=TOOL_CONFIGURED, BswMDisabledDMPduGroupRef=ComIPduGroupRx_SCM_LOCALCAN
          AC_DeadlineMonitoringControl_Rx_SCM_LOCALCAN_ENABLE: category=TOOL_CONFIGURED
            BswMAvailableActions: category=TOOL_CONFIGURED
              BswMDeadlineMonitoringControl: category=TOOL_CONFIGURED, BswMEnabledDMPduGroupRef=ComIPduGroupRx_SCM_LOCALCAN
          AC_EcuMGoDown_BSWM: category=TOOL_CONFIGURED
            BswMAvailableActions: category=TOOL_CONFIGURED
              BswMEcuMGoDown: category=TOOL_CONFIGURED, BswMEcuMUserIdRef=ECUM_USER_BSWM
          AC_EcuMSelectShutdownTarget_OFF: category=TOOL_CONFIGURED
            BswMAvailableActions: category=TOOL_CONFIGURED
              BswMEcuMSelectShutdownTarget: category=TOOL_CONFIGURED, BswMEcuMShutdownTarget=ECUM_STATE_OFF
          AC_EcuMSelectShutdownTarget_RESET_MCU: category=TOOL_CONFIGURED
            BswMAvailableActions: category=TOOL_CONFIGURED
              BswMEcuMSelectShutdownTarget: category=TOOL_CONFIGURED, BswMEcuMShutdownTarget=ECUM_STATE_RESET, BswMEcuMResetModeRef=ECUM_RESET_MCU
          AC_NMControl_BCAN_DISABLE: category=TOOL_CONFIGURED
            BswMAvailableActions: category=TOOL_CONFIGURED
              BswMNMControl: category=TOOL_CONFIGURED, BswMNMAction=BSWM_NM_DISABLE, BswMComMNetworkHandleRef=ComMChannel_BCAN
          AC_NMControl_BCAN_ENABLE: category=TOOL_CONFIGURED
            BswMAvailableActions: category=TOOL_CONFIGURED
              BswMNMControl: category=TOOL_CONFIGURED, BswMNMAction=BSWM_NM_ENABLE, BswMComMNetworkHandleRef=ComMChannel_BCAN
          AC_NMControl_LOCALCAN_DISABLE: category=TOOL_CONFIGURED
            BswMAvailableActions: category=TOOL_CONFIGURED
              BswMNMControl: category=TOOL_CONFIGURED, BswMNMAction=BSWM_NM_DISABLE, BswMComMNetworkHandleRef=ComMChannel_LOCALCAN
          AC_NMControl_LOCALCAN_ENABLE: category=TOOL_CONFIGURED
            BswMAvailableActions: category=TOOL_CONFIGURED
              BswMNMControl: category=TOOL_CONFIGURED, BswMNMAction=BSWM_NM_ENABLE, BswMComMNetworkHandleRef=ComMChannel_LOCALCAN
          AC_PduGroupSwitch_Rx_SCM_BCAN_DISABLE_REINIT: category=TOOL_CONFIGURED
            BswMAvailableActions: category=TOOL_CONFIGURED
              BswMPduGroupSwitch: category=TOOL_CONFIGURED, BswMPduGroupSwitchReinit=1, BswMDisabledPduGroupRef=ComIPduGroupRx_SCM_BCAN
          AC_PduGroupSwitch_Rx_SCM_BCAN_ENABLE_REINIT: category=TOOL_CONFIGURED
            BswMAvailableActions: category=TOOL_CONFIGURED
              BswMPduGroupSwitch: category=TOOL_CONFIGURED, BswMPduGroupSwitchReinit=1, BswMEnabledPduGroupRef=ComIPduGroupRx_SCM_BCAN
          AC_PduGroupSwitch_Rx_SCM_LOCALCAN_DISABLE_REINIT: category=TOOL_CONFIGURED
            BswMAvailableActions: category=TOOL_CONFIGURED
              BswMPduGroupSwitch: category=TOOL_CONFIGURED, BswMPduGroupSwitchReinit=1, BswMDisabledPduGroupRef=ComIPduGroupRx_SCM_LOCALCAN
          AC_PduGroupSwitch_Rx_SCM_LOCALCAN_ENABLE_REINIT: category=TOOL_CONFIGURED
            BswMAvailableActions: category=TOOL_CONFIGURED
              BswMPduGroupSwitch: category=TOOL_CONFIGURED, BswMPduGroupSwitchReinit=1, BswMEnabledPduGroupRef=ComIPduGroupRx_SCM_LOCALCAN
          AC_PduGroupSwitch_Tx_SCM_BCAN_DISABLE_REINIT: category=TOOL_CONFIGURED
            BswMAvailableActions: category=TOOL_CONFIGURED
              BswMPduGroupSwitch: category=TOOL_CONFIGURED, BswMPduGroupSwitchReinit=1, BswMDisabledPduGroupRef=ComIPduGroupTx_SCM_BCAN
          AC_PduGroupSwitch_Tx_SCM_BCAN_ENABLE_REINIT: category=TOOL_CONFIGURED
            BswMAvailableActions: category=TOOL_CONFIGURED
              BswMPduGroupSwitch: category=TOOL_CONFIGURED, BswMPduGroupSwitchReinit=1, BswMEnabledPduGroupRef=ComIPduGroupTx_SCM_BCAN
          AC_PduGroupSwitch_Tx_SCM_LOCALCAN_DISABLE_REINIT: category=TOOL_CONFIGURED
            BswMAvailableActions: category=TOOL_CONFIGURED
              BswMPduGroupSwitch: category=TOOL_CONFIGURED, BswMPduGroupSwitchReinit=1, BswMDisabledPduGroupRef=ComIPduGroupTx_SCM_LOCALCAN
          AC_PduGroupSwitch_Tx_SCM_LOCALCAN_ENABLE_REINIT: category=TOOL_CONFIGURED
            BswMAvailableActions: category=TOOL_CONFIGURED
              BswMPduGroupSwitch: category=TOOL_CONFIGURED, BswMPduGroupSwitchReinit=1, BswMEnabledPduGroupRef=ComIPduGroupTx_SCM_LOCALCAN
          AC_RteSwitch_CanSMBORState_BCAN_COMPLETE: category=TOOL_CONFIGURED
            BswMAvailableActions: category=TOOL_CONFIGURED
              BswMRteSwitch: category=TOOL_CONFIGURED, BswMRteSwitchPortRef=CanSMBORState_BCAN, BswMSwitchedMode=COMPLETE
          AC_RteSwitch_CanSMBORState_BCAN_START: category=TOOL_CONFIGURED
            BswMAvailableActions: category=TOOL_CONFIGURED
              BswMRteSwitch: category=TOOL_CONFIGURED, BswMRteSwitchPortRef=CanSMBORState_BCAN, BswMSwitchedMode=START
          AC_RteSwitch_CanSMBORState_LOCALCAN_COMPLETE: category=TOOL_CONFIGURED
            BswMAvailableActions: category=TOOL_CONFIGURED
              BswMRteSwitch: category=TOOL_CONFIGURED, BswMRteSwitchPortRef=CanSMBORState_LOCALCAN, BswMSwitchedMode=COMPLETE
          AC_RteSwitch_CanSMBORState_LOCALCAN_START: category=TOOL_CONFIGURED
            BswMAvailableActions: category=TOOL_CONFIGURED
              BswMRteSwitch: category=TOOL_CONFIGURED, BswMRteSwitchPortRef=CanSMBORState_LOCALCAN, BswMSwitchedMode=START
          AC_RteSwitch_CanSMState_BCAN_BUS_OFF: category=TOOL_CONFIGURED
            BswMAvailableActions: category=TOOL_CONFIGURED
              BswMRteSwitch: category=TOOL_CONFIGURED, BswMRteSwitchPortRef=CanSMState_BCAN, BswMSwitchedMode=BUS_OFF
          AC_RteSwitch_CanSMState_BCAN_CHANGE_BAUDRATE: category=TOOL_CONFIGURED
            BswMAvailableActions: category=TOOL_CONFIGURED
              BswMRteSwitch: category=TOOL_CONFIGURED, BswMRteSwitchPortRef=CanSMState_BCAN, BswMSwitchedMode=CHANGE_BAUDRATE
          AC_RteSwitch_CanSMState_BCAN_FULL_COM: category=TOOL_CONFIGURED
            BswMAvailableActions: category=TOOL_CONFIGURED
              BswMRteSwitch: category=TOOL_CONFIGURED, BswMRteSwitchPortRef=CanSMState_BCAN, BswMSwitchedMode=FULL_COM
          AC_RteSwitch_CanSMState_BCAN_NO_COM: category=TOOL_CONFIGURED
            BswMAvailableActions: category=TOOL_CONFIGURED
              BswMRteSwitch: category=TOOL_CONFIGURED, BswMRteSwitchPortRef=CanSMState_BCAN, BswMSwitchedMode=NO_COM
          AC_RteSwitch_CanSMState_BCAN_SILENT_COM: category=TOOL_CONFIGURED
            BswMAvailableActions: category=TOOL_CONFIGURED
              BswMRteSwitch: category=TOOL_CONFIGURED, BswMRteSwitchPortRef=CanSMState_BCAN, BswMSwitchedMode=SILENT_COM
          AC_RteSwitch_CanSMState_LOCALCAN_BUS_OFF: category=TOOL_CONFIGURED
            BswMAvailableActions: category=TOOL_CONFIGURED
              BswMRteSwitch: category=TOOL_CONFIGURED, BswMRteSwitchPortRef=CanSMState_LOCALCAN, BswMSwitchedMode=BUS_OFF
          AC_RteSwitch_CanSMState_LOCALCAN_CHANGE_BAUDRATE: category=TOOL_CONFIGURED
            BswMAvailableActions: category=TOOL_CONFIGURED
              BswMRteSwitch: category=TOOL_CONFIGURED, BswMRteSwitchPortRef=CanSMState_LOCALCAN, BswMSwitchedMode=CHANGE_BAUDRATE
          AC_RteSwitch_CanSMState_LOCALCAN_FULL_COM: category=TOOL_CONFIGURED
            BswMAvailableActions: category=TOOL_CONFIGURED
              BswMRteSwitch: category=TOOL_CONFIGURED, BswMRteSwitchPortRef=CanSMState_LOCALCAN, BswMSwitchedMode=FULL_COM
          AC_RteSwitch_CanSMState_LOCALCAN_NO_COM: category=TOOL_CONFIGURED
            BswMAvailableActions: category=TOOL_CONFIGURED
              BswMRteSwitch: category=TOOL_CONFIGURED, BswMRteSwitchPortRef=CanSMState_LOCALCAN, BswMSwitchedMode=NO_COM
          AC_RteSwitch_CanSMState_LOCALCAN_SILENT_COM: category=TOOL_CONFIGURED
            BswMAvailableActions: category=TOOL_CONFIGURED
              BswMRteSwitch: category=TOOL_CONFIGURED, BswMRteSwitchPortRef=CanSMState_LOCALCAN, BswMSwitchedMode=SILENT_COM
          AC_RteSwitch_ComMMode_BCAN_FULL_COM: category=TOOL_CONFIGURED
            BswMAvailableActions: category=TOOL_CONFIGURED
              BswMRteSwitch: category=TOOL_CONFIGURED, BswMRteSwitchPortRef=ComMMode_BCAN, BswMSwitchedMode=FULL_COM
          AC_RteSwitch_ComMMode_BCAN_NO_COM: category=TOOL_CONFIGURED
            BswMAvailableActions: category=TOOL_CONFIGURED
              BswMRteSwitch: category=TOOL_CONFIGURED, BswMRteSwitchPortRef=ComMMode_BCAN, BswMSwitchedMode=NO_COM
          AC_RteSwitch_ComMMode_BCAN_SILENT_COM: category=TOOL_CONFIGURED
            BswMAvailableActions: category=TOOL_CONFIGURED
              BswMRteSwitch: category=TOOL_CONFIGURED, BswMRteSwitchPortRef=ComMMode_BCAN, BswMSwitchedMode=SILENT_COM
          AC_RteSwitch_ComMMode_LOCALCAN_FULL_COM: category=TOOL_CONFIGURED
            BswMAvailableActions: category=TOOL_CONFIGURED
              BswMRteSwitch: category=TOOL_CONFIGURED, BswMRteSwitchPortRef=ComMMode_LOCALCAN, BswMSwitchedMode=FULL_COM
          AC_RteSwitch_ComMMode_LOCALCAN_NO_COM: category=TOOL_CONFIGURED
            BswMAvailableActions: category=TOOL_CONFIGURED
              BswMRteSwitch: category=TOOL_CONFIGURED, BswMRteSwitchPortRef=ComMMode_LOCALCAN, BswMSwitchedMode=NO_COM
          AC_RteSwitch_ComMMode_LOCALCAN_SILENT_COM: category=TOOL_CONFIGURED
            BswMAvailableActions: category=TOOL_CONFIGURED
              BswMRteSwitch: category=TOOL_CONFIGURED, BswMRteSwitchPortRef=ComMMode_LOCALCAN, BswMSwitchedMode=SILENT_COM
          AC_RteSwitch_DcmApplicationUpdated_APP_NOT_UPDATED: category=TOOL_CONFIGURED
            BswMAvailableActions: category=TOOL_CONFIGURED
              BswMRteSwitch: category=TOOL_CONFIGURED, BswMRteSwitchPortRef=DcmApplicationUpdated, BswMSwitchedMode=APP_NOT_UPDATED
          AC_RteSwitch_DcmApplicationUpdated_APP_UPDATED: category=TOOL_CONFIGURED
            BswMAvailableActions: category=TOOL_CONFIGURED
              BswMRteSwitch: category=TOOL_CONFIGURED, BswMRteSwitchPortRef=DcmApplicationUpdated, BswMSwitchedMode=APP_UPDATED
          AC_RteSwitch_DcmCommunicationControl_0_DCM_DISABLE_RX_DISABLE_TX_NM: category=TOOL_CONFIGURED
            BswMAvailableActions: category=TOOL_CONFIGURED
              BswMRteSwitch: category=TOOL_CONFIGURED, BswMRteSwitchPortRef=DcmCommunicationControl_0, BswMSwitchedMode=DCM_DISABLE_RX_DISABLE_TX_NM
          AC_RteSwitch_DcmCommunicationControl_0_DCM_DISABLE_RX_ENABLE_TX_NORM: category=TOOL_CONFIGURED
            BswMAvailableActions: category=TOOL_CONFIGURED
              BswMRteSwitch: category=TOOL_CONFIGURED, BswMRteSwitchPortRef=DcmCommunicationControl_0, BswMSwitchedMode=DCM_DISABLE_RX_ENABLE_TX_NORM
          AC_RteSwitch_DcmCommunicationControl_0_DCM_DISABLE_RX_ENABLE_TX_NORM_NM: category=TOOL_CONFIGURED
            BswMAvailableActions: category=TOOL_CONFIGURED
              BswMRteSwitch: category=TOOL_CONFIGURED, BswMRteSwitchPortRef=DcmCommunicationControl_0, BswMSwitchedMode=DCM_DISABLE_RX_ENABLE_TX_NORM_NM
          AC_RteSwitch_DcmCommunicationControl_0_DCM_DISABLE_RX_TX_NM: category=TOOL_CONFIGURED
            BswMAvailableActions: category=TOOL_CONFIGURED
              BswMRteSwitch: category=TOOL_CONFIGURED, BswMRteSwitchPortRef=DcmCommunicationControl_0, BswMSwitchedMode=DCM_DISABLE_RX_TX_NM
          AC_RteSwitch_DcmCommunicationControl_0_DCM_DISABLE_RX_TX_NORMAL: category=TOOL_CONFIGURED
            BswMAvailableActions: category=TOOL_CONFIGURED
              BswMRteSwitch: category=TOOL_CONFIGURED, BswMRteSwitchPortRef=DcmCommunicationControl_0, BswMSwitchedMode=DCM_DISABLE_RX_TX_NORMAL
          AC_RteSwitch_DcmCommunicationControl_0_DCM_DISABLE_RX_TX_NORM_NM: category=TOOL_CONFIGURED
            BswMAvailableActions: category=TOOL_CONFIGURED
              BswMRteSwitch: category=TOOL_CONFIGURED, BswMRteSwitchPortRef=DcmCommunicationControl_0, BswMSwitchedMode=DCM_DISABLE_RX_TX_NORM_NM
          AC_RteSwitch_DcmCommunicationControl_0_DCM_ENABLE_RX_DISABLE_TX_NM: category=TOOL_CONFIGURED
            BswMAvailableActions: category=TOOL_CONFIGURED
              BswMRteSwitch: category=TOOL_CONFIGURED, BswMRteSwitchPortRef=DcmCommunicationControl_0, BswMSwitchedMode=DCM_ENABLE_RX_DISABLE_TX_NM
          AC_RteSwitch_DcmCommunicationControl_0_DCM_ENABLE_RX_DISABLE_TX_NORM: category=TOOL_CONFIGURED
            BswMAvailableActions: category=TOOL_CONFIGURED
              BswMRteSwitch: category=TOOL_CONFIGURED, BswMRteSwitchPortRef=DcmCommunicationControl_0, BswMSwitchedMode=DCM_ENABLE_RX_DISABLE_TX_NORM
          AC_RteSwitch_DcmCommunicationControl_0_DCM_ENABLE_RX_DISABLE_TX_NORM_NM: category=TOOL_CONFIGURED
            BswMAvailableActions: category=TOOL_CONFIGURED
              BswMRteSwitch: category=TOOL_CONFIGURED, BswMRteSwitchPortRef=DcmCommunicationControl_0, BswMSwitchedMode=DCM_ENABLE_RX_DISABLE_TX_NORM_NM
          AC_RteSwitch_DcmCommunicationControl_0_DCM_ENABLE_RX_TX_NM: category=TOOL_CONFIGURED
            BswMAvailableActions: category=TOOL_CONFIGURED
              BswMRteSwitch: category=TOOL_CONFIGURED, BswMRteSwitchPortRef=DcmCommunicationControl_0, BswMSwitchedMode=DCM_ENABLE_RX_TX_NM
          AC_RteSwitch_DcmCommunicationControl_0_DCM_ENABLE_RX_TX_NORM: category=TOOL_CONFIGURED
            BswMAvailableActions: category=TOOL_CONFIGURED
              BswMRteSwitch: category=TOOL_CONFIGURED, BswMRteSwitchPortRef=DcmCommunicationControl_0, BswMSwitchedMode=DCM_ENABLE_RX_TX_NORM
          AC_RteSwitch_DcmCommunicationControl_0_DCM_ENABLE_RX_TX_NORM_NM: category=TOOL_CONFIGURED
            BswMAvailableActions: category=TOOL_CONFIGURED
              BswMRteSwitch: category=TOOL_CONFIGURED, BswMRteSwitchPortRef=DcmCommunicationControl_0, BswMSwitchedMode=DCM_ENABLE_RX_TX_NORM_NM
          AC_RteSwitch_DcmCommunicationControl_1_DCM_DISABLE_RX_DISABLE_TX_NM: category=TOOL_CONFIGURED
            BswMAvailableActions: category=TOOL_CONFIGURED
              BswMRteSwitch: category=TOOL_CONFIGURED, BswMRteSwitchPortRef=DcmCommunicationControl_1, BswMSwitchedMode=DCM_DISABLE_RX_DISABLE_TX_NM
          AC_RteSwitch_DcmCommunicationControl_1_DCM_DISABLE_RX_ENABLE_TX_NORM: category=TOOL_CONFIGURED
            BswMAvailableActions: category=TOOL_CONFIGURED
              BswMRteSwitch: category=TOOL_CONFIGURED, BswMRteSwitchPortRef=DcmCommunicationControl_1, BswMSwitchedMode=DCM_DISABLE_RX_ENABLE_TX_NORM
          AC_RteSwitch_DcmCommunicationControl_1_DCM_DISABLE_RX_ENABLE_TX_NORM_NM: category=TOOL_CONFIGURED
            BswMAvailableActions: category=TOOL_CONFIGURED
              BswMRteSwitch: category=TOOL_CONFIGURED, BswMRteSwitchPortRef=DcmCommunicationControl_1, BswMSwitchedMode=DCM_DISABLE_RX_ENABLE_TX_NORM_NM
          AC_RteSwitch_DcmCommunicationControl_1_DCM_DISABLE_RX_TX_NM: category=TOOL_CONFIGURED
            BswMAvailableActions: category=TOOL_CONFIGURED
              BswMRteSwitch: category=TOOL_CONFIGURED, BswMRteSwitchPortRef=DcmCommunicationControl_1, BswMSwitchedMode=DCM_DISABLE_RX_TX_NM
          AC_RteSwitch_DcmCommunicationControl_1_DCM_DISABLE_RX_TX_NORMAL: category=TOOL_CONFIGURED
            BswMAvailableActions: category=TOOL_CONFIGURED
              BswMRteSwitch: category=TOOL_CONFIGURED, BswMRteSwitchPortRef=DcmCommunicationControl_1, BswMSwitchedMode=DCM_DISABLE_RX_TX_NORMAL
          AC_RteSwitch_DcmCommunicationControl_1_DCM_DISABLE_RX_TX_NORM_NM: category=TOOL_CONFIGURED
            BswMAvailableActions: category=TOOL_CONFIGURED
              BswMRteSwitch: category=TOOL_CONFIGURED, BswMRteSwitchPortRef=DcmCommunicationControl_1, BswMSwitchedMode=DCM_DISABLE_RX_TX_NORM_NM
          AC_RteSwitch_DcmCommunicationControl_1_DCM_ENABLE_RX_DISABLE_TX_NM: category=TOOL_CONFIGURED
            BswMAvailableActions: category=TOOL_CONFIGURED
              BswMRteSwitch: category=TOOL_CONFIGURED, BswMRteSwitchPortRef=DcmCommunicationControl_1, BswMSwitchedMode=DCM_ENABLE_RX_DISABLE_TX_NM
          AC_RteSwitch_DcmCommunicationControl_1_DCM_ENABLE_RX_DISABLE_TX_NORM: category=TOOL_CONFIGURED
            BswMAvailableActions: category=TOOL_CONFIGURED
              BswMRteSwitch: category=TOOL_CONFIGURED, BswMRteSwitchPortRef=DcmCommunicationControl_1, BswMSwitchedMode=DCM_ENABLE_RX_DISABLE_TX_NORM
          AC_RteSwitch_DcmCommunicationControl_1_DCM_ENABLE_RX_DISABLE_TX_NORM_NM: category=TOOL_CONFIGURED
            BswMAvailableActions: category=TOOL_CONFIGURED
              BswMRteSwitch: category=TOOL_CONFIGURED, BswMRteSwitchPortRef=DcmCommunicationControl_1, BswMSwitchedMode=DCM_ENABLE_RX_DISABLE_TX_NORM_NM
          AC_RteSwitch_DcmCommunicationControl_1_DCM_ENABLE_RX_TX_NM: category=TOOL_CONFIGURED
            BswMAvailableActions: category=TOOL_CONFIGURED
              BswMRteSwitch: category=TOOL_CONFIGURED, BswMRteSwitchPortRef=DcmCommunicationControl_1, BswMSwitchedMode=DCM_ENABLE_RX_TX_NM
          AC_RteSwitch_DcmCommunicationControl_1_DCM_ENABLE_RX_TX_NORM: category=TOOL_CONFIGURED
            BswMAvailableActions: category=TOOL_CONFIGURED
              BswMRteSwitch: category=TOOL_CONFIGURED, BswMRteSwitchPortRef=DcmCommunicationControl_1, BswMSwitchedMode=DCM_ENABLE_RX_TX_NORM
          AC_RteSwitch_DcmCommunicationControl_1_DCM_ENABLE_RX_TX_NORM_NM: category=TOOL_CONFIGURED
            BswMAvailableActions: category=TOOL_CONFIGURED
              BswMRteSwitch: category=TOOL_CONFIGURED, BswMRteSwitchPortRef=DcmCommunicationControl_1, BswMSwitchedMode=DCM_ENABLE_RX_TX_NORM_NM
          AC_RteSwitch_DcmControlDTCSetting_DISABLEDTCSETTING: category=TOOL_CONFIGURED
            BswMAvailableActions: category=TOOL_CONFIGURED
              BswMRteSwitch: category=TOOL_CONFIGURED, BswMRteSwitchPortRef=DcmControlDTCSetting, BswMSwitchedMode=DISABLEDTCSETTING
          AC_RteSwitch_DcmControlDTCSetting_ENABLEDTCSETTING: category=TOOL_CONFIGURED
            BswMAvailableActions: category=TOOL_CONFIGURED
              BswMRteSwitch: category=TOOL_CONFIGURED, BswMRteSwitchPortRef=DcmControlDTCSetting, BswMSwitchedMode=ENABLEDTCSETTING
          AC_RteSwitch_DcmDiagnosticSessionControl_DCM_DEFAULT_SESSION: category=TOOL_CONFIGURED
            BswMAvailableActions: category=TOOL_CONFIGURED
              BswMRteSwitch: category=TOOL_CONFIGURED, BswMRteSwitchPortRef=DcmDiagnosticSessionControl, BswMSwitchedMode=DCM_DEFAULT_SESSION
          AC_RteSwitch_DcmDiagnosticSessionControl_DCM_ECU_PROGRAMMING_MODE: category=TOOL_CONFIGURED
            BswMAvailableActions: category=TOOL_CONFIGURED
              BswMRteSwitch: category=TOOL_CONFIGURED, BswMRteSwitchPortRef=DcmDiagnosticSessionControl, BswMSwitchedMode=DCM_ECU_PROGRAMMING_MODE
          AC_RteSwitch_DcmDiagnosticSessionControl_DCM_EXTENDED_DIAGNOSTIC_MODE: category=TOOL_CONFIGURED
            BswMAvailableActions: category=TOOL_CONFIGURED
              BswMRteSwitch: category=TOOL_CONFIGURED, BswMRteSwitchPortRef=DcmDiagnosticSessionControl, BswMSwitchedMode=DCM_EXTENDED_DIAGNOSTIC_MODE
          AC_RteSwitch_DcmDiagnosticSessionControl_DCM_EXTENDED_DIAGNOSTIC_SESSION: category=TOOL_CONFIGURED
            BswMAvailableActions: category=TOOL_CONFIGURED
              BswMRteSwitch: category=TOOL_CONFIGURED, BswMRteSwitchPortRef=DcmDiagnosticSessionControl, BswMSwitchedMode=DCM_EXTENDED_DIAGNOSTIC_SESSION
          AC_RteSwitch_DcmDiagnosticSessionControl_DCM_PROGRAMMING_SESSION: category=TOOL_CONFIGURED
            BswMAvailableActions: category=TOOL_CONFIGURED
              BswMRteSwitch: category=TOOL_CONFIGURED, BswMRteSwitchPortRef=DcmDiagnosticSessionControl, BswMSwitchedMode=DCM_PROGRAMMING_SESSION
          AC_RteSwitch_DcmDiagnosticSessionControl_DCM_QUIESCENT_CURRENT_DIAGNOSTIC_MODE_START: category=TOOL_CONFIGURED
            BswMAvailableActions: category=TOOL_CONFIGURED
              BswMRteSwitch: category=TOOL_CONFIGURED, BswMRteSwitchPortRef=DcmDiagnosticSessionControl, BswMSwitchedMode=DCM_QUIESCENT_CURRENT_DIAGNOSTIC_MODE_START
          AC_RteSwitch_DcmDiagnosticSessionControl_DCM_SAFETY_SYSTEM_DIAGNOSTIC_SESSION: category=TOOL_CONFIGURED
            BswMAvailableActions: category=TOOL_CONFIGURED
              BswMRteSwitch: category=TOOL_CONFIGURED, BswMRteSwitchPortRef=DcmDiagnosticSessionControl, BswMSwitchedMode=DCM_SAFETY_SYSTEM_DIAGNOSTIC_SESSION
          AC_RteSwitch_DcmDiagnosticSessionControl_DCM_SLEEP_MODE_START_REQUEST: category=TOOL_CONFIGURED
            BswMAvailableActions: category=TOOL_CONFIGURED
              BswMRteSwitch: category=TOOL_CONFIGURED, BswMRteSwitchPortRef=DcmDiagnosticSessionControl, BswMSwitchedMode=DCM_SLEEP_MODE_START_REQUEST
          AC_RteSwitch_DcmModeRapidPowerShutDown_DISABLE_RAPIDPOWERSHUTDOWN: category=TOOL_CONFIGURED
            BswMAvailableActions: category=TOOL_CONFIGURED
              BswMRteSwitch: category=TOOL_CONFIGURED, BswMRteSwitchPortRef=DcmModeRapidPowerShutDown, BswMSwitchedMode=DISABLE_RAPIDPOWERSHUTDOWN
          AC_RteSwitch_DcmModeRapidPowerShutDown_ENABLE_RAPIDPOWERSHUTDOWN: category=TOOL_CONFIGURED
            BswMAvailableActions: category=TOOL_CONFIGURED
              BswMRteSwitch: category=TOOL_CONFIGURED, BswMRteSwitchPortRef=DcmModeRapidPowerShutDown, BswMSwitchedMode=ENABLE_RAPIDPOWERSHUTDOWN
          AC_RteSwitch_EcuMode_ECUM_STATE_RUN: category=TOOL_CONFIGURED
            BswMAvailableActions: category=TOOL_CONFIGURED
              BswMRteSwitch: category=TOOL_CONFIGURED, BswMRteSwitchPortRef=EcuMode, BswMSwitchedMode=ECUM_STATE_RUN
          AC_RteSwitch_EcuMode_ECUM_STATE_SHUTDOWN: category=TOOL_CONFIGURED
            BswMAvailableActions: category=TOOL_CONFIGURED
              BswMRteSwitch: category=TOOL_CONFIGURED, BswMRteSwitchPortRef=EcuMode, BswMSwitchedMode=ECUM_STATE_SHUTDOWN
          AC_RteSwitch_EcuMode_ECUM_STATE_SLEEP: category=TOOL_CONFIGURED
            BswMAvailableActions: category=TOOL_CONFIGURED
              BswMRteSwitch: category=TOOL_CONFIGURED, BswMRteSwitchPortRef=EcuMode, BswMSwitchedMode=ECUM_STATE_SLEEP
          AC_RteSwitch_InitState_COMPLETE: category=TOOL_CONFIGURED
            BswMAvailableActions: category=TOOL_CONFIGURED
              BswMRteSwitch: category=TOOL_CONFIGURED, BswMRteSwitchPortRef=InitState, BswMSwitchedMode=COMPLETE
          AC_RteSwitch_PduGroupRx_BCAN_START: category=TOOL_CONFIGURED
            BswMAvailableActions: category=TOOL_CONFIGURED
              BswMRteSwitch: category=TOOL_CONFIGURED, BswMRteSwitchPortRef=PduGroupRx_BCAN, BswMSwitchedMode=START
          AC_RteSwitch_PduGroupRx_BCAN_STOP: category=TOOL_CONFIGURED
            BswMAvailableActions: category=TOOL_CONFIGURED
              BswMRteSwitch: category=TOOL_CONFIGURED, BswMRteSwitchPortRef=PduGroupRx_BCAN, BswMSwitchedMode=STOP
          AC_RteSwitch_PduGroupRx_LOCALCAN_START: category=TOOL_CONFIGURED
            BswMAvailableActions: category=TOOL_CONFIGURED
              BswMRteSwitch: category=TOOL_CONFIGURED, BswMRteSwitchPortRef=PduGroupRx_LOCALCAN, BswMSwitchedMode=START
          AC_RteSwitch_PduGroupRx_LOCALCAN_STOP: category=TOOL_CONFIGURED
            BswMAvailableActions: category=TOOL_CONFIGURED
              BswMRteSwitch: category=TOOL_CONFIGURED, BswMRteSwitchPortRef=PduGroupRx_LOCALCAN, BswMSwitchedMode=STOP
          AC_RteSwitch_PduGroupTx_BCAN_START: category=TOOL_CONFIGURED
            BswMAvailableActions: category=TOOL_CONFIGURED
              BswMRteSwitch: category=TOOL_CONFIGURED, BswMRteSwitchPortRef=PduGroupTx_BCAN, BswMSwitchedMode=START
          AC_RteSwitch_PduGroupTx_BCAN_STOP: category=TOOL_CONFIGURED
            BswMAvailableActions: category=TOOL_CONFIGURED
              BswMRteSwitch: category=TOOL_CONFIGURED, BswMRteSwitchPortRef=PduGroupTx_BCAN, BswMSwitchedMode=STOP
          AC_RteSwitch_PduGroupTx_LOCALCAN_START: category=TOOL_CONFIGURED
            BswMAvailableActions: category=TOOL_CONFIGURED
              BswMRteSwitch: category=TOOL_CONFIGURED, BswMRteSwitchPortRef=PduGroupTx_LOCALCAN, BswMSwitchedMode=START
          AC_RteSwitch_PduGroupTx_LOCALCAN_STOP: category=TOOL_CONFIGURED
            BswMAvailableActions: category=TOOL_CONFIGURED
              BswMRteSwitch: category=TOOL_CONFIGURED, BswMRteSwitchPortRef=PduGroupTx_LOCALCAN, BswMSwitchedMode=STOP
          AC_RteSwitch_WakeupEvent_BCAN_RX: category=TOOL_CONFIGURED
            BswMAvailableActions: category=TOOL_CONFIGURED
              BswMRteSwitch: category=TOOL_CONFIGURED, BswMRteSwitchPortRef=WakeupEvent, BswMSwitchedMode=BCAN_RX
          AC_RteSwitch_WakeupEvent_BCAN_RX_POLL: category=TOOL_CONFIGURED
            BswMAvailableActions: category=TOOL_CONFIGURED
              BswMRteSwitch: category=TOOL_CONFIGURED, BswMRteSwitchPortRef=WakeupEvent, BswMSwitchedMode=BCAN_RX_POLL
          AC_RteSwitch_WakeupEvent_IGN_WakeUP: category=TOOL_CONFIGURED
            BswMAvailableActions: category=TOOL_CONFIGURED
              BswMRteSwitch: category=TOOL_CONFIGURED, BswMRteSwitchPortRef=WakeupEvent, BswMSwitchedMode=IGN_WakeUP
          AC_RteSwitch_WakeupEvent_LOCALCAN_RX: category=TOOL_CONFIGURED
            BswMAvailableActions: category=TOOL_CONFIGURED
              BswMRteSwitch: category=TOOL_CONFIGURED, BswMRteSwitchPortRef=WakeupEvent, BswMSwitchedMode=LOCALCAN_RX
          AC_RteSwitch_WakeupEvent_LOCALCAN_RX_POLL: category=TOOL_CONFIGURED
            BswMAvailableActions: category=TOOL_CONFIGURED
              BswMRteSwitch: category=TOOL_CONFIGURED, BswMRteSwitchPortRef=WakeupEvent, BswMSwitchedMode=LOCALCAN_RX_POLL
          AC_SchMSwitch_EcuMode_ECUM_STATE_OFF: category=TOOL_CONFIGURED
            BswMAvailableActions: category=TOOL_CONFIGURED
              BswMSchMSwitch: category=TOOL_CONFIGURED, BswMSchMModeDeclarationGroupRef=EcuMode, BswMSchMSwitchedMode=ECUM_STATE_OFF
          AC_SchMSwitch_EcuMode_ECUM_STATE_RESET: category=TOOL_CONFIGURED
            BswMAvailableActions: category=TOOL_CONFIGURED
              BswMSchMSwitch: category=TOOL_CONFIGURED, BswMSchMModeDeclarationGroupRef=EcuMode, BswMSchMSwitchedMode=ECUM_STATE_RESET
          AC_SchMSwitch_EcuMode_ECUM_STATE_RUN: category=TOOL_CONFIGURED
            BswMAvailableActions: category=TOOL_CONFIGURED
              BswMSchMSwitch: category=TOOL_CONFIGURED, BswMSchMModeDeclarationGroupRef=EcuMode, BswMSchMSwitchedMode=ECUM_STATE_RUN
          AC_SchMSwitch_EcuMode_ECUM_STATE_SHUTDOWN: category=TOOL_CONFIGURED
            BswMAvailableActions: category=TOOL_CONFIGURED
              BswMSchMSwitch: category=TOOL_CONFIGURED, BswMSchMModeDeclarationGroupRef=EcuMode, BswMSchMSwitchedMode=ECUM_STATE_SHUTDOWN
          AC_SchMSwitch_EcuMode_ECUM_STATE_SLEEP: category=TOOL_CONFIGURED
            BswMAvailableActions: category=TOOL_CONFIGURED
              BswMSchMSwitch: category=TOOL_CONFIGURED, BswMSchMModeDeclarationGroupRef=EcuMode, BswMSchMSwitchedMode=ECUM_STATE_SLEEP
          AC_SchMSwitch_EcuMode_ECUM_STATE_STARTUP_THREE: category=TOOL_CONFIGURED
            BswMAvailableActions: category=TOOL_CONFIGURED
              BswMSchMSwitch: category=TOOL_CONFIGURED, BswMSchMModeDeclarationGroupRef=EcuMode, BswMSchMSwitchedMode=ECUM_STATE_STARTUP_THREE
          AC_SchMSwitch_EcuMode_ECUM_STATE_STARTUP_TWO: category=TOOL_CONFIGURED
            BswMAvailableActions: category=TOOL_CONFIGURED
              BswMSchMSwitch: category=TOOL_CONFIGURED, BswMSchMModeDeclarationGroupRef=EcuMode, BswMSchMSwitchedMode=ECUM_STATE_STARTUP_TWO
          AC_UserCallout_ComM_DeInit: category=TOOL_CONFIGURED
            BswMAvailableActions: category=TOOL_CONFIGURED
              ComM_DeInit (BswMUserCallout): category=TOOL_CONFIGURED, BswMUserCalloutFunction=ComM_DeInit()
          AC_UserCallout_Dcm_Init: category=TOOL_CONFIGURED
            BswMAvailableActions: category=TOOL_CONFIGURED
              Dcm_Init (BswMUserCallout): category=TOOL_CONFIGURED, BswMUserCalloutFunction=Dcm_Init(NULL_PTR)
          AC_UserCallout_Dem_Init: category=TOOL_CONFIGURED
            BswMAvailableActions: category=TOOL_CONFIGURED
              Dem_Init (BswMUserCallout): category=TOOL_CONFIGURED, BswMUserCalloutFunction=Dem_Init()
          AC_UserCallout_Dem_Shutdown: category=TOOL_CONFIGURED
            BswMAvailableActions: category=TOOL_CONFIGURED
              Dem_Shutdown (BswMUserCallout): category=TOOL_CONFIGURED, BswMUserCalloutFunction=Dem_Shutdown()
          AC_UserCallout_EcuM_GoHalt: category=TOOL_CONFIGURED
            BswMAvailableActions: category=TOOL_CONFIGURED
              EcuM_GoHalt (BswMUserCallout): category=TOOL_CONFIGURED, BswMUserCalloutFunction=EcuM_GoHalt()
          AC_UserCallout_EcuModeTransition_End: category=TOOL_CONFIGURED
            BswMAvailableActions: category=TOOL_CONFIGURED
              EcuModeTransition_End (BswMUserCallout): category=TOOL_CONFIGURED, BswMUserCalloutFunction=BswM_RequestMode((BswM_UserType)0x79, (BswM_ModeType)BSWM_ECUMODETRANSITION_END)
          AC_UserCallout_EcuModeTransition_Ongoing: category=TOOL_CONFIGURED
            BswMAvailableActions: category=TOOL_CONFIGURED
              EcuModeTransition_Ongoing (BswMUserCallout): category=TOOL_CONFIGURED, BswMUserCalloutFunction=BswM_RequestMode((BswM_UserType)0x79, (BswM_ModeType)BSWM_ECUMODETRANSITION_ONGOING)
          AC_UserCallout_EcuState_ENTRY_OFF: category=TOOL_CONFIGURED
            BswMAvailableActions: category=TOOL_CONFIGURED
              EcuState_ENTRY_OFF (BswMUserCallout): category=TOOL_CONFIGURED, BswMUserCalloutFunction=BswM_RequestMode((BswM_UserType)0x2A, (BswM_ModeType)BSWM_ECUSTATE_ENTRY_OFF)
          AC_UserCallout_EcuState_ENTRY_RESET: category=TOOL_CONFIGURED
            BswMAvailableActions: category=TOOL_CONFIGURED
              EcuState_ENTRY_RESET (BswMUserCallout): category=TOOL_CONFIGURED, BswMUserCalloutFunction=BswM_RequestMode((BswM_UserType)0x2A, (BswM_ModeType)BSWM_ECUSTATE_ENTRY_RESET)
          AC_UserCallout_EcuState_ENTRY_RUN: category=TOOL_CONFIGURED
            BswMAvailableActions: category=TOOL_CONFIGURED
              EcuState_ENTRY_RUN (BswMUserCallout): category=TOOL_CONFIGURED, BswMUserCalloutFunction=BswM_RequestMode((BswM_UserType)0x2A, (BswM_ModeType)BSWM_ECUSTATE_ENTRY_RUN)
          AC_UserCallout_EcuState_ENTRY_SHUTDOWN: category=TOOL_CONFIGURED
            BswMAvailableActions: category=TOOL_CONFIGURED
              EcuState_ENTRY_SHUTDOWN (BswMUserCallout): category=TOOL_CONFIGURED, BswMUserCalloutFunction=BswM_RequestMode((BswM_UserType)0x2A, (BswM_ModeType)BSWM_ECUSTATE_ENTRY_SHUTDOWN)
          AC_UserCallout_EcuState_ENTRY_SLEEP: category=TOOL_CONFIGURED
            BswMAvailableActions: category=TOOL_CONFIGURED
              EcuState_ENTRY_SLEEP (BswMUserCallout): category=TOOL_CONFIGURED, BswMUserCalloutFunction=BswM_RequestMode((BswM_UserType)0x2A, (BswM_ModeType)BSWM_ECUSTATE_ENTRY_SLEEP)
          AC_UserCallout_EcuState_ENTRY_STARTUP_THREE: category=TOOL_CONFIGURED
            BswMAvailableActions: category=TOOL_CONFIGURED
              EcuState_ENTRY_STARTUP_THREE (BswMUserCallout): category=TOOL_CONFIGURED, BswMUserCalloutFunction=BswM_RequestMode((BswM_UserType)0x2A, (BswM_ModeType)BSWM_ECUSTATE_ENTRY_STARTUP_THREE)
          AC_UserCallout_EcuState_ENTRY_STARTUP_TWO: category=TOOL_CONFIGURED
            BswMAvailableActions: category=TOOL_CONFIGURED
              EcuState_ENTRY_STARTUP_TWO (BswMUserCallout): category=TOOL_CONFIGURED, BswMUserCalloutFunction=BswM_RequestMode((BswM_UserType)0x2A, (BswM_ModeType)BSWM_ECUSTATE_ENTRY_STARTUP_TWO)
          AC_UserCallout_EcuState_EXIT_RUN: category=TOOL_CONFIGURED
            BswMAvailableActions: category=TOOL_CONFIGURED
              EcuState_EXIT_RUN (BswMUserCallout): category=TOOL_CONFIGURED, BswMUserCalloutFunction=BswM_RequestMode((BswM_UserType)0x2A, (BswM_ModeType)BSWM_ECUSTATE_EXIT_RUN)
          AC_UserCallout_EcuState_EXIT_SHUTDOWN: category=TOOL_CONFIGURED
            BswMAvailableActions: category=TOOL_CONFIGURED
              EcuState_EXIT_SHUTDOWN (BswMUserCallout): category=TOOL_CONFIGURED, BswMUserCalloutFunction=BswM_RequestMode((BswM_UserType)0x2A, (BswM_ModeType)BSWM_ECUSTATE_EXIT_SHUTDOWN)
          AC_UserCallout_EcuState_EXIT_SLEEP: category=TOOL_CONFIGURED
            BswMAvailableActions: category=TOOL_CONFIGURED
              EcuState_EXIT_SLEEP (BswMUserCallout): category=TOOL_CONFIGURED, BswMUserCalloutFunction=BswM_RequestMode((BswM_UserType)0x2A, (BswM_ModeType)BSWM_ECUSTATE_EXIT_SLEEP)
          AC_UserCallout_EcuState_EXIT_STARTUP_THREE: category=TOOL_CONFIGURED
            BswMAvailableActions: category=TOOL_CONFIGURED
              EcuState_EXIT_STARTUP_THREE (BswMUserCallout): category=TOOL_CONFIGURED, BswMUserCalloutFunction=BswM_RequestMode((BswM_UserType)0x2A, (BswM_ModeType)BSWM_ECUSTATE_EXIT_STARTUP_THREE)
          AC_UserCallout_EcuState_EXIT_STARTUP_TWO: category=TOOL_CONFIGURED
            BswMAvailableActions: category=TOOL_CONFIGURED
              EcuState_EXIT_STARTUP_TWO (BswMUserCallout): category=TOOL_CONFIGURED, BswMUserCalloutFunction=BswM_RequestMode((BswM_UserType)0x2A, (BswM_ModeType)BSWM_ECUSTATE_EXIT_STARTUP_TWO)
          AC_UserCallout_FiM_Init: category=TOOL_CONFIGURED
            BswMAvailableActions: category=TOOL_CONFIGURED
              FiM_Init (BswMUserCallout): category=TOOL_CONFIGURED, BswMUserCalloutFunction=FiM_Init(NULL_PTR)
          AC_UserCallout_Mem_Driver_ShutDown: category=TOOL_CONFIGURED
            BswMAvailableActions: category=TOOL_CONFIGURED
              Mem_Driver_ShutDown (BswMUserCallout): category=TOOL_CONFIGURED, BswMUserCalloutFunction=Mem_Driver_ShutDown()
          AC_UserCallout_Mem_Driver_StartUp: category=TOOL_CONFIGURED
            BswMAvailableActions: category=TOOL_CONFIGURED
              Mem_Driver_StartUp (BswMUserCallout): category=TOOL_CONFIGURED, BswMUserCalloutFunction=Mem_Driver_StartUp()
          AC_UserCallout_Rte_Start_Main: category=TOOL_CONFIGURED
            BswMAvailableActions: category=TOOL_CONFIGURED
              Rte_Start_Main (BswMUserCallout): category=TOOL_CONFIGURED, BswMUserCalloutFunction=(void)Rte_Start()
          AC_UserCallout_Rte_Stop_Main: category=TOOL_CONFIGURED
            BswMAvailableActions: category=TOOL_CONFIGURED
              Rte_Stop_Main (BswMUserCallout): category=TOOL_CONFIGURED, BswMUserCalloutFunction=(void)Rte_Stop()
          AC_UserCallout_ShutdownTargetTo_OFF: category=TOOL_CONFIGURED
            BswMAvailableActions: category=TOOL_CONFIGURED
              ShutdownTargetTo_OFF (BswMUserCallout): category=TOOL_CONFIGURED, BswMUserCalloutFunction=BswM_RequestMode((BswM_UserType)0x12A, (BswM_ModeType)BSWM_SHUTDOWNTARGET_OFF)
          AC_UserCallout_ShutdownTargetTo_RESET: category=TOOL_CONFIGURED
            BswMAvailableActions: category=TOOL_CONFIGURED
              ShutdownTargetTo_RESET (BswMUserCallout): category=TOOL_CONFIGURED, BswMUserCalloutFunction=BswM_RequestMode((BswM_UserType)0x12A, (BswM_ModeType)BSWM_SHUTDOWNTARGET_RESET)
          AC_UserCallout_ShutdownTargetTo_RUN: category=TOOL_CONFIGURED
            BswMAvailableActions: category=TOOL_CONFIGURED
              ShutdownTargetTo_RUN (BswMUserCallout): category=TOOL_CONFIGURED, BswMUserCalloutFunction=BswM_RequestMode((BswM_UserType)0x12A, (BswM_ModeType)BSWM_SHUTDOWNTARGET_RUN)
          AC_UserCallout_ShutdownTargetTo_SLEEP: category=TOOL_CONFIGURED
            BswMAvailableActions: category=TOOL_CONFIGURED
              ShutdownTargetTo_SLEEP (BswMUserCallout): category=TOOL_CONFIGURED, BswMUserCalloutFunction=BswM_RequestMode((BswM_UserType)0x12A, (BswM_ModeType)BSWM_SHUTDOWNTARGET_SLEEP)
          AC_UserCallout_WdgM_DeInit: category=TOOL_CONFIGURED
            BswMAvailableActions: category=TOOL_CONFIGURED
              WdgM_DeInit (BswMUserCallout): category=TOOL_CONFIGURED, BswMUserCalloutFunction=WdgM_DeInit()
          AC_UserCallout_Hae_HsmDriver_Init
            BswMAvailableActions
              BswMUserCallout: BswMUserCalloutFunction=UserCallout_HsmDriverInit
        113 x BswMActionList:
          AL_ComModeAllow_ALL_FALSE: category=TOOL_CONFIGURED, BswMActionListExecution=BSWM_TRIGGER
            AC_ComMAllowCom_BCAN_FALSE (BswMActionListItem): category=TOOL_CONFIGURED, BswMAbortOnFail=0, BswMActionListItemIndex=10, BswMActionListItemRef=BswMModeControl/AC_ComMAllowCom_BCAN_FALSE
            AC_ComMAllowCom_LOCALCAN_FALSE (BswMActionListItem): category=TOOL_CONFIGURED, BswMAbortOnFail=0, BswMActionListItemIndex=20, BswMActionListItemRef=BswMModeControl/AC_ComMAllowCom_LOCALCAN_FALSE
          AL_ComModeAllow_ALL_TRUE: category=TOOL_CONFIGURED, BswMActionListExecution=BSWM_TRIGGER
            AC_ComMAllowCom_BCAN_TRUE (BswMActionListItem): category=TOOL_CONFIGURED, BswMAbortOnFail=0, BswMActionListItemIndex=10, BswMActionListItemRef=BswMModeControl/AC_ComMAllowCom_BCAN_TRUE
            AC_ComMAllowCom_LOCALCAN_TRUE (BswMActionListItem): category=TOOL_CONFIGURED, BswMAbortOnFail=0, BswMActionListItemIndex=20, BswMActionListItemRef=BswMModeControl/AC_ComMAllowCom_LOCALCAN_TRUE
          AL_ComModeRequest_ALL_FULL_COM: category=TOOL_CONFIGURED, BswMActionListExecution=BSWM_TRIGGER
            AC_ComMModeSwitch_BCAN_FULL_COM (BswMActionListItem): category=TOOL_CONFIGURED, BswMAbortOnFail=0, BswMActionListItemIndex=10, BswMActionListItemRef=BswMModeControl/AC_ComMModeSwitch_BCAN_FULL_COM
            AC_ComMModeSwitch_LOCALCAN_FULL_COM (BswMActionListItem): category=TOOL_CONFIGURED, BswMAbortOnFail=0, BswMActionListItemIndex=20, BswMActionListItemRef=BswMModeControl/AC_ComMModeSwitch_LOCALCAN_FULL_COM
          AL_ComModeRequest_ALL_NO_COM: category=TOOL_CONFIGURED, BswMActionListExecution=BSWM_TRIGGER
            AC_ComMModeSwitch_BCAN_NO_COM (BswMActionListItem): category=TOOL_CONFIGURED, BswMAbortOnFail=0, BswMActionListItemIndex=10, BswMActionListItemRef=BswMModeControl/AC_ComMModeSwitch_BCAN_NO_COM
            AC_ComMModeSwitch_LOCALCAN_NO_COM (BswMActionListItem): category=TOOL_CONFIGURED, BswMAbortOnFail=0, BswMActionListItemIndex=20, BswMActionListItemRef=BswMModeControl/AC_ComMModeSwitch_LOCALCAN_NO_COM
          AL_DriverDeinit: category=TOOL_CONFIGURED, BswMActionListExecution=BSWM_TRIGGER
            3 x BswMActionListItem, all with category=TOOL_CONFIGURED, BswMAbortOnFail=0:
              AC_UserCallout_WdgM_DeInit: BswMActionListItemIndex=10, BswMActionListItemRef=BswMModeControl/AC_UserCallout_WdgM_DeInit
              AC_UserCallout_ComM_DeInit: BswMActionListItemIndex=20, BswMActionListItemRef=BswMModeControl/AC_UserCallout_ComM_DeInit
              AC_UserCallout_Mem_Driver_ShutDown: BswMActionListItemIndex=30, BswMActionListItemRef=BswMModeControl/AC_UserCallout_Mem_Driver_ShutDown
          AL_DriverInitThree: category=TOOL_CONFIGURED, BswMActionListExecution=BSWM_TRIGGER
            AC_UserCallout_FiM_Init (BswMActionListItem): category=TOOL_CONFIGURED, BswMAbortOnFail=0, BswMActionListItemIndex=10, BswMActionListItemRef=BswMModeControl/AC_UserCallout_FiM_Init
            AC_UserCallout_Dem_Init (BswMActionListItem): category=TOOL_CONFIGURED, BswMAbortOnFail=0, BswMActionListItemIndex=20, BswMActionListItemRef=BswMModeControl/AC_UserCallout_Dem_Init
          AL_DriverInitTwo: category=TOOL_CONFIGURED, BswMActionListExecution=BSWM_TRIGGER
            3 x BswMActionListItem, all with BswMAbortOnFail=0:
              AC_UserCallout_Dcm_Init: category=TOOL_CONFIGURED, BswMActionListItemIndex=10, BswMActionListItemRef=BswMModeControl/AC_UserCallout_Dcm_Init
              AC_UserCallout_Mem_Driver_StartUp: category=TOOL_CONFIGURED, BswMActionListItemIndex=20, BswMActionListItemRef=BswMModeControl/AC_UserCallout_Mem_Driver_StartUp
              AC_UserCallout_HaeHsmDriver_StartUp: BswMActionListItemIndex=30, BswMActionListItemRef=AC_UserCallout_Hae_HsmDriver_Init
          AL_DriverPreDeinit: category=TOOL_CONFIGURED, BswMActionListExecution=BSWM_TRIGGER
            AC_UserCallout_Dem_Shutdown (BswMActionListItem): category=TOOL_CONFIGURED, BswMAbortOnFail=0, BswMActionListItemIndex=10, BswMActionListItemRef=BswMModeControl/AC_UserCallout_Dem_Shutdown
          AL_RteStart: category=TOOL_CONFIGURED, BswMActionListExecution=BSWM_TRIGGER
            AC_UserCallout_Rte_Start_Main (BswMActionListItem): category=TOOL_CONFIGURED, BswMAbortOnFail=0, BswMActionListItemIndex=10, BswMActionListItemRef=BswMModeControl/AC_UserCallout_Rte_Start_Main
          AL_RteStop: category=TOOL_CONFIGURED, BswMActionListExecution=BSWM_TRIGGER
            AC_UserCallout_Rte_Stop_Main (BswMActionListItem): category=TOOL_CONFIGURED, BswMAbortOnFail=0, BswMActionListItemIndex=10, BswMActionListItemRef=BswMModeControl/AC_UserCallout_Rte_Stop_Main
          TrueAL_CanBorNotification_BCAN_COMPLETE: category=TOOL_CONFIGURED, BswMActionListExecution=BSWM_TRIGGER
            AC_RteSwitch_CanSMBORState_BCAN_COMPLETE (BswMActionListItem):
              category = TOOL_CONFIGURED
              BswMAbortOnFail = 0
              BswMActionListItemIndex = 10
              BswMActionListItemRef = BswMModeControl/AC_RteSwitch_CanSMBORState_BCAN_COMPLETE
          TrueAL_CanBorNotification_BCAN_START: category=TOOL_CONFIGURED, BswMActionListExecution=BSWM_TRIGGER
            AC_RteSwitch_CanSMBORState_BCAN_START (BswMActionListItem):
              category = TOOL_CONFIGURED
              BswMAbortOnFail = 0
              BswMActionListItemIndex = 10
              BswMActionListItemRef = BswMModeControl/AC_RteSwitch_CanSMBORState_BCAN_START
          TrueAL_CanBorNotification_LOCALCAN_COMPLETE: category=TOOL_CONFIGURED, BswMActionListExecution=BSWM_TRIGGER
            AC_RteSwitch_CanSMBORState_LOCALCAN_COMPLETE (BswMActionListItem):
              category = TOOL_CONFIGURED
              BswMAbortOnFail = 0
              BswMActionListItemIndex = 10
              BswMActionListItemRef = BswMModeControl/AC_RteSwitch_CanSMBORState_LOCALCAN_COMPLETE
          TrueAL_CanBorNotification_LOCALCAN_START: category=TOOL_CONFIGURED, BswMActionListExecution=BSWM_TRIGGER
            AC_RteSwitch_CanSMBORState_LOCALCAN_START (BswMActionListItem):
              category = TOOL_CONFIGURED
              BswMAbortOnFail = 0
              BswMActionListItemIndex = 10
              BswMActionListItemRef = BswMModeControl/AC_RteSwitch_CanSMBORState_LOCALCAN_START
          TrueAL_CanStateNotification_BCAN_BUS_OFF: category=TOOL_CONFIGURED, BswMActionListExecution=BSWM_TRIGGER
            AC_RteSwitch_CanSMState_BCAN_BUS_OFF (BswMActionListItem):
              category = TOOL_CONFIGURED
              BswMAbortOnFail = 0
              BswMActionListItemIndex = 10
              BswMActionListItemRef = BswMModeControl/AC_RteSwitch_CanSMState_BCAN_BUS_OFF
          TrueAL_CanStateNotification_BCAN_CHANGE_BAUDRATE: category=TOOL_CONFIGURED, BswMActionListExecution=BSWM_TRIGGER
            AC_RteSwitch_CanSMState_BCAN_CHANGE_BAUDRATE (BswMActionListItem):
              category = TOOL_CONFIGURED
              BswMAbortOnFail = 0
              BswMActionListItemIndex = 10
              BswMActionListItemRef = BswMModeControl/AC_RteSwitch_CanSMState_BCAN_CHANGE_BAUDRATE
          TrueAL_CanStateNotification_BCAN_FULL_COM: category=TOOL_CONFIGURED, BswMActionListExecution=BSWM_TRIGGER
            AC_RteSwitch_CanSMState_BCAN_FULL_COM (BswMActionListItem):
              category = TOOL_CONFIGURED
              BswMAbortOnFail = 0
              BswMActionListItemIndex = 10
              BswMActionListItemRef = BswMModeControl/AC_RteSwitch_CanSMState_BCAN_FULL_COM
          TrueAL_CanStateNotification_BCAN_NO_COM: category=TOOL_CONFIGURED, BswMActionListExecution=BSWM_TRIGGER
            AC_RteSwitch_CanSMState_BCAN_NO_COM (BswMActionListItem): category=TOOL_CONFIGURED, BswMAbortOnFail=0, BswMActionListItemIndex=10, BswMActionListItemRef=BswMModeControl/AC_RteSwitch_CanSMState_BCAN_NO_COM
          TrueAL_CanStateNotification_BCAN_SILENT_COM: category=TOOL_CONFIGURED, BswMActionListExecution=BSWM_TRIGGER
            AC_RteSwitch_CanSMState_BCAN_SILENT_COM (BswMActionListItem):
              category = TOOL_CONFIGURED
              BswMAbortOnFail = 0
              BswMActionListItemIndex = 10
              BswMActionListItemRef = BswMModeControl/AC_RteSwitch_CanSMState_BCAN_SILENT_COM
          TrueAL_CanStateNotification_LOCALCAN_BUS_OFF: category=TOOL_CONFIGURED, BswMActionListExecution=BSWM_TRIGGER
            AC_RteSwitch_CanSMState_LOCALCAN_BUS_OFF (BswMActionListItem):
              category = TOOL_CONFIGURED
              BswMAbortOnFail = 0
              BswMActionListItemIndex = 10
              BswMActionListItemRef = BswMModeControl/AC_RteSwitch_CanSMState_LOCALCAN_BUS_OFF
          TrueAL_CanStateNotification_LOCALCAN_CHANGE_BAUDRATE: category=TOOL_CONFIGURED, BswMActionListExecution=BSWM_TRIGGER
            AC_RteSwitch_CanSMState_LOCALCAN_CHANGE_BAUDRATE (BswMActionListItem):
              category = TOOL_CONFIGURED
              BswMAbortOnFail = 0
              BswMActionListItemIndex = 10
              BswMActionListItemRef = BswMModeControl/AC_RteSwitch_CanSMState_LOCALCAN_CHANGE_BAUDRATE
          TrueAL_CanStateNotification_LOCALCAN_FULL_COM: category=TOOL_CONFIGURED, BswMActionListExecution=BSWM_TRIGGER
            AC_RteSwitch_CanSMState_LOCALCAN_FULL_COM (BswMActionListItem):
              category = TOOL_CONFIGURED
              BswMAbortOnFail = 0
              BswMActionListItemIndex = 10
              BswMActionListItemRef = BswMModeControl/AC_RteSwitch_CanSMState_LOCALCAN_FULL_COM
          TrueAL_CanStateNotification_LOCALCAN_NO_COM: category=TOOL_CONFIGURED, BswMActionListExecution=BSWM_TRIGGER
            AC_RteSwitch_CanSMState_LOCALCAN_NO_COM (BswMActionListItem):
              category = TOOL_CONFIGURED
              BswMAbortOnFail = 0
              BswMActionListItemIndex = 10
              BswMActionListItemRef = BswMModeControl/AC_RteSwitch_CanSMState_LOCALCAN_NO_COM
          TrueAL_CanStateNotification_LOCALCAN_SILENT_COM: category=TOOL_CONFIGURED, BswMActionListExecution=BSWM_TRIGGER
            AC_RteSwitch_CanSMState_LOCALCAN_SILENT_COM (BswMActionListItem):
              category = TOOL_CONFIGURED
              BswMAbortOnFail = 0
              BswMActionListItemIndex = 10
              BswMActionListItemRef = BswMModeControl/AC_RteSwitch_CanSMState_LOCALCAN_SILENT_COM
          TrueAL_ComControl_BCAN_DISABLE_DM: category=TOOL_CONFIGURED, BswMActionListExecution=BSWM_CONDITION
            AC_DeadlineMonitoringControl_Rx_SCM_BCAN_DISABLE (BswMActionListItem):
              category = TOOL_CONFIGURED
              BswMAbortOnFail = 0
              BswMActionListItemIndex = 10
              BswMActionListItemRef = BswMModeControl/AC_DeadlineMonitoringControl_Rx_SCM_BCAN_DISABLE
          TrueAL_ComControl_BCAN_DISABLE_NM: category=TOOL_CONFIGURED, BswMActionListExecution=BSWM_TRIGGER
            AC_NMControl_BCAN_DISABLE (BswMActionListItem): category=TOOL_CONFIGURED, BswMAbortOnFail=0, BswMActionListItemIndex=10, BswMActionListItemRef=BswMModeControl/AC_NMControl_BCAN_DISABLE
          TrueAL_ComControl_BCAN_DISABLE_RX: category=TOOL_CONFIGURED, BswMActionListExecution=BSWM_TRIGGER
            AC_PduGroupSwitch_Rx_SCM_BCAN_DISABLE_REINIT (BswMActionListItem):
              category = TOOL_CONFIGURED
              BswMAbortOnFail = 0
              BswMActionListItemIndex = 10
              BswMActionListItemRef = BswMModeControl/AC_PduGroupSwitch_Rx_SCM_BCAN_DISABLE_REINIT
            AC_RteSwitch_PduGroupRx_BCAN_STOP (BswMActionListItem): category=TOOL_CONFIGURED, BswMAbortOnFail=0, BswMActionListItemIndex=20, BswMActionListItemRef=BswMModeControl/AC_RteSwitch_PduGroupRx_BCAN_STOP
          TrueAL_ComControl_BCAN_DISABLE_TX: category=TOOL_CONFIGURED, BswMActionListExecution=BSWM_TRIGGER
            AC_PduGroupSwitch_Tx_SCM_BCAN_DISABLE_REINIT (BswMActionListItem):
              category = TOOL_CONFIGURED
              BswMAbortOnFail = 0
              BswMActionListItemIndex = 10
              BswMActionListItemRef = BswMModeControl/AC_PduGroupSwitch_Tx_SCM_BCAN_DISABLE_REINIT
            AC_RteSwitch_PduGroupTx_BCAN_STOP (BswMActionListItem): category=TOOL_CONFIGURED, BswMAbortOnFail=0, BswMActionListItemIndex=20, BswMActionListItemRef=BswMModeControl/AC_RteSwitch_PduGroupTx_BCAN_STOP
          TrueAL_ComControl_BCAN_ENABLE_DM: category=TOOL_CONFIGURED, BswMActionListExecution=BSWM_TRIGGER
            AC_DeadlineMonitoringControl_Rx_SCM_BCAN_ENABLE (BswMActionListItem):
              category = TOOL_CONFIGURED
              BswMAbortOnFail = 0
              BswMActionListItemIndex = 10
              BswMActionListItemRef = BswMModeControl/AC_DeadlineMonitoringControl_Rx_SCM_BCAN_ENABLE
          TrueAL_ComControl_BCAN_ENABLE_NM: category=TOOL_CONFIGURED, BswMActionListExecution=BSWM_TRIGGER
            AC_NMControl_BCAN_ENABLE (BswMActionListItem): category=TOOL_CONFIGURED, BswMAbortOnFail=0, BswMActionListItemIndex=10, BswMActionListItemRef=BswMModeControl/AC_NMControl_BCAN_ENABLE
          TrueAL_ComControl_BCAN_ENABLE_RX: category=TOOL_CONFIGURED, BswMActionListExecution=BSWM_TRIGGER
            AC_PduGroupSwitch_Rx_SCM_BCAN_ENABLE_REINIT (BswMActionListItem):
              category = TOOL_CONFIGURED
              BswMAbortOnFail = 0
              BswMActionListItemIndex = 10
              BswMActionListItemRef = BswMModeControl/AC_PduGroupSwitch_Rx_SCM_BCAN_ENABLE_REINIT
            AC_RteSwitch_PduGroupRx_BCAN_START (BswMActionListItem): category=TOOL_CONFIGURED, BswMAbortOnFail=0, BswMActionListItemIndex=20, BswMActionListItemRef=BswMModeControl/AC_RteSwitch_PduGroupRx_BCAN_START
          TrueAL_ComControl_BCAN_ENABLE_TX: category=TOOL_CONFIGURED, BswMActionListExecution=BSWM_TRIGGER
            AC_PduGroupSwitch_Tx_SCM_BCAN_ENABLE_REINIT (BswMActionListItem):
              category = TOOL_CONFIGURED
              BswMAbortOnFail = 0
              BswMActionListItemIndex = 10
              BswMActionListItemRef = BswMModeControl/AC_PduGroupSwitch_Tx_SCM_BCAN_ENABLE_REINIT
            AC_RteSwitch_PduGroupTx_BCAN_START (BswMActionListItem): category=TOOL_CONFIGURED, BswMAbortOnFail=0, BswMActionListItemIndex=20, BswMActionListItemRef=BswMModeControl/AC_RteSwitch_PduGroupTx_BCAN_START
          TrueAL_ComControl_LOCALCAN_DISABLE_DM: category=TOOL_CONFIGURED, BswMActionListExecution=BSWM_CONDITION
            AC_DeadlineMonitoringControl_Rx_SCM_LOCALCAN_DISABLE (BswMActionListItem):
              category = TOOL_CONFIGURED
              BswMAbortOnFail = 0
              BswMActionListItemIndex = 10
              BswMActionListItemRef = BswMModeControl/AC_DeadlineMonitoringControl_Rx_SCM_LOCALCAN_DISABLE
          TrueAL_ComControl_LOCALCAN_DISABLE_NM: category=TOOL_CONFIGURED, BswMActionListExecution=BSWM_TRIGGER
            AC_NMControl_LOCALCAN_DISABLE (BswMActionListItem): category=TOOL_CONFIGURED, BswMAbortOnFail=0, BswMActionListItemIndex=10, BswMActionListItemRef=BswMModeControl/AC_NMControl_LOCALCAN_DISABLE
          TrueAL_ComControl_LOCALCAN_DISABLE_RX: category=TOOL_CONFIGURED, BswMActionListExecution=BSWM_TRIGGER
            AC_PduGroupSwitch_Rx_SCM_LOCALCAN_DISABLE_REINIT (BswMActionListItem):
              category = TOOL_CONFIGURED
              BswMAbortOnFail = 0
              BswMActionListItemIndex = 10
              BswMActionListItemRef = BswMModeControl/AC_PduGroupSwitch_Rx_SCM_LOCALCAN_DISABLE_REINIT
            AC_RteSwitch_PduGroupRx_LOCALCAN_STOP (BswMActionListItem):
              category = TOOL_CONFIGURED
              BswMAbortOnFail = 0
              BswMActionListItemIndex = 20
              BswMActionListItemRef = BswMModeControl/AC_RteSwitch_PduGroupRx_LOCALCAN_STOP
          TrueAL_ComControl_LOCALCAN_DISABLE_TX: category=TOOL_CONFIGURED, BswMActionListExecution=BSWM_TRIGGER
            AC_PduGroupSwitch_Tx_SCM_LOCALCAN_DISABLE_REINIT (BswMActionListItem):
              category = TOOL_CONFIGURED
              BswMAbortOnFail = 0
              BswMActionListItemIndex = 10
              BswMActionListItemRef = BswMModeControl/AC_PduGroupSwitch_Tx_SCM_LOCALCAN_DISABLE_REINIT
            AC_RteSwitch_PduGroupTx_LOCALCAN_STOP (BswMActionListItem):
              category = TOOL_CONFIGURED
              BswMAbortOnFail = 0
              BswMActionListItemIndex = 20
              BswMActionListItemRef = BswMModeControl/AC_RteSwitch_PduGroupTx_LOCALCAN_STOP
          TrueAL_ComControl_LOCALCAN_ENABLE_DM: category=TOOL_CONFIGURED, BswMActionListExecution=BSWM_TRIGGER
            AC_DeadlineMonitoringControl_Rx_SCM_LOCALCAN_ENABLE (BswMActionListItem):
              category = TOOL_CONFIGURED
              BswMAbortOnFail = 0
              BswMActionListItemIndex = 10
              BswMActionListItemRef = BswMModeControl/AC_DeadlineMonitoringControl_Rx_SCM_LOCALCAN_ENABLE
          TrueAL_ComControl_LOCALCAN_ENABLE_NM: category=TOOL_CONFIGURED, BswMActionListExecution=BSWM_TRIGGER
            AC_NMControl_LOCALCAN_ENABLE (BswMActionListItem): category=TOOL_CONFIGURED, BswMAbortOnFail=0, BswMActionListItemIndex=10, BswMActionListItemRef=BswMModeControl/AC_NMControl_LOCALCAN_ENABLE
          TrueAL_ComControl_LOCALCAN_ENABLE_RX: category=TOOL_CONFIGURED, BswMActionListExecution=BSWM_TRIGGER
            AC_PduGroupSwitch_Rx_SCM_LOCALCAN_ENABLE_REINIT (BswMActionListItem):
              category = TOOL_CONFIGURED
              BswMAbortOnFail = 0
              BswMActionListItemIndex = 10
              BswMActionListItemRef = BswMModeControl/AC_PduGroupSwitch_Rx_SCM_LOCALCAN_ENABLE_REINIT
            AC_RteSwitch_PduGroupRx_LOCALCAN_START (BswMActionListItem):
              category = TOOL_CONFIGURED
              BswMAbortOnFail = 0
              BswMActionListItemIndex = 20
              BswMActionListItemRef = BswMModeControl/AC_RteSwitch_PduGroupRx_LOCALCAN_START
          TrueAL_ComControl_LOCALCAN_ENABLE_TX: category=TOOL_CONFIGURED, BswMActionListExecution=BSWM_TRIGGER
            AC_PduGroupSwitch_Tx_SCM_LOCALCAN_ENABLE_REINIT (BswMActionListItem):
              category = TOOL_CONFIGURED
              BswMAbortOnFail = 0
              BswMActionListItemIndex = 10
              BswMActionListItemRef = BswMModeControl/AC_PduGroupSwitch_Tx_SCM_LOCALCAN_ENABLE_REINIT
            AC_RteSwitch_PduGroupTx_LOCALCAN_START (BswMActionListItem):
              category = TOOL_CONFIGURED
              BswMAbortOnFail = 0
              BswMActionListItemIndex = 20
              BswMActionListItemRef = BswMModeControl/AC_RteSwitch_PduGroupTx_LOCALCAN_START
          TrueAL_ComModeNotification_BCAN_FULL_COM: category=TOOL_CONFIGURED, BswMActionListExecution=BSWM_TRIGGER
            AC_RteSwitch_ComMMode_BCAN_FULL_COM (BswMActionListItem): category=TOOL_CONFIGURED, BswMAbortOnFail=0, BswMActionListItemIndex=10, BswMActionListItemRef=BswMModeControl/AC_RteSwitch_ComMMode_BCAN_FULL_COM
          TrueAL_ComModeNotification_BCAN_NO_COM: category=TOOL_CONFIGURED, BswMActionListExecution=BSWM_TRIGGER
            AC_RteSwitch_ComMMode_BCAN_NO_COM (BswMActionListItem): category=TOOL_CONFIGURED, BswMAbortOnFail=0, BswMActionListItemIndex=10, BswMActionListItemRef=BswMModeControl/AC_RteSwitch_ComMMode_BCAN_NO_COM
          TrueAL_ComModeNotification_BCAN_SILENT_COM: category=TOOL_CONFIGURED, BswMActionListExecution=BSWM_TRIGGER
            AC_RteSwitch_ComMMode_BCAN_SILENT_COM (BswMActionListItem):
              category = TOOL_CONFIGURED
              BswMAbortOnFail = 0
              BswMActionListItemIndex = 10
              BswMActionListItemRef = BswMModeControl/AC_RteSwitch_ComMMode_BCAN_SILENT_COM
          TrueAL_ComModeNotification_LOCALCAN_FULL_COM: category=TOOL_CONFIGURED, BswMActionListExecution=BSWM_TRIGGER
            AC_RteSwitch_ComMMode_LOCALCAN_FULL_COM (BswMActionListItem):
              category = TOOL_CONFIGURED
              BswMAbortOnFail = 0
              BswMActionListItemIndex = 10
              BswMActionListItemRef = BswMModeControl/AC_RteSwitch_ComMMode_LOCALCAN_FULL_COM
          TrueAL_ComModeNotification_LOCALCAN_NO_COM: category=TOOL_CONFIGURED, BswMActionListExecution=BSWM_TRIGGER
            AC_RteSwitch_ComMMode_LOCALCAN_NO_COM (BswMActionListItem):
              category = TOOL_CONFIGURED
              BswMAbortOnFail = 0
              BswMActionListItemIndex = 10
              BswMActionListItemRef = BswMModeControl/AC_RteSwitch_ComMMode_LOCALCAN_NO_COM
          TrueAL_ComModeNotification_LOCALCAN_SILENT_COM: category=TOOL_CONFIGURED, BswMActionListExecution=BSWM_TRIGGER
            AC_RteSwitch_ComMMode_LOCALCAN_SILENT_COM (BswMActionListItem):
              category = TOOL_CONFIGURED
              BswMAbortOnFail = 0
              BswMActionListItemIndex = 10
              BswMActionListItemRef = BswMModeControl/AC_RteSwitch_ComMMode_LOCALCAN_SILENT_COM
          TrueAL_ComModeRequest_BCAN_FULL_COM: category=TOOL_CONFIGURED, BswMActionListExecution=BSWM_TRIGGER
            AC_ComMModeSwitch_BCAN_FULL_COM (BswMActionListItem): category=TOOL_CONFIGURED, BswMAbortOnFail=0, BswMActionListItemIndex=10, BswMActionListItemRef=BswMModeControl/AC_ComMModeSwitch_BCAN_FULL_COM
          TrueAL_ComModeRequest_BCAN_NO_COM: category=TOOL_CONFIGURED, BswMActionListExecution=BSWM_TRIGGER
            AC_ComMModeSwitch_BCAN_NO_COM (BswMActionListItem): category=TOOL_CONFIGURED, BswMAbortOnFail=0, BswMActionListItemIndex=10, BswMActionListItemRef=BswMModeControl/AC_ComMModeSwitch_BCAN_NO_COM
          TrueAL_ComModeRequest_LOCALCAN_FULL_COM: category=TOOL_CONFIGURED, BswMActionListExecution=BSWM_TRIGGER
            AC_ComMModeSwitch_LOCALCAN_FULL_COM (BswMActionListItem): category=TOOL_CONFIGURED, BswMAbortOnFail=0, BswMActionListItemIndex=10, BswMActionListItemRef=BswMModeControl/AC_ComMModeSwitch_LOCALCAN_FULL_COM
          TrueAL_ComModeRequest_LOCALCAN_NO_COM: category=TOOL_CONFIGURED, BswMActionListExecution=BSWM_TRIGGER
            AC_ComMModeSwitch_LOCALCAN_NO_COM (BswMActionListItem): category=TOOL_CONFIGURED, BswMAbortOnFail=0, BswMActionListItemIndex=10, BswMActionListItemRef=BswMModeControl/AC_ComMModeSwitch_LOCALCAN_NO_COM
          TrueAL_DcmApplicationUpdatedNotification_APP_NOT_UPDATED: category=TOOL_CONFIGURED, BswMActionListExecution=BSWM_TRIGGER
            AC_RteSwitch_DcmApplicationUpdated_APP_NOT_UPDATED (BswMActionListItem):
              category = TOOL_CONFIGURED
              BswMAbortOnFail = 0
              BswMActionListItemIndex = 10
              BswMActionListItemRef = BswMModeControl/AC_RteSwitch_DcmApplicationUpdated_APP_NOT_UPDATED
          TrueAL_DcmApplicationUpdatedNotification_APP_UPDATED: category=TOOL_CONFIGURED, BswMActionListExecution=BSWM_TRIGGER
            AC_RteSwitch_DcmApplicationUpdated_APP_UPDATED (BswMActionListItem):
              category = TOOL_CONFIGURED
              BswMAbortOnFail = 0
              BswMActionListItemIndex = 10
              BswMActionListItemRef = BswMModeControl/AC_RteSwitch_DcmApplicationUpdated_APP_UPDATED
          TrueAL_DcmCommunicationControl_0_DCM_DISABLE_RX_DISABLE_TX_NM: category=TOOL_CONFIGURED, BswMActionListExecution=BSWM_TRIGGER
            AC_RteSwitch_DcmCommunicationControl_0_DCM_DISABLE_RX_DISABLE_TX_NM (BswMActionListItem):
              category = TOOL_CONFIGURED
              BswMAbortOnFail = 0
              BswMActionListItemIndex = 10
              BswMActionListItemRef = BswMModeControl/AC_RteSwitch_DcmCommunicationControl_0_DCM_DISABLE_RX_DISABLE_TX_NM
          TrueAL_DcmCommunicationControl_0_DCM_DISABLE_RX_ENABLE_TX_NORM: category=TOOL_CONFIGURED, BswMActionListExecution=BSWM_TRIGGER
            AC_RteSwitch_DcmCommunicationControl_0_DCM_DISABLE_RX_ENABLE_TX_NORM (BswMActionListItem):
              category = TOOL_CONFIGURED
              BswMAbortOnFail = 0
              BswMActionListItemIndex = 10
              BswMActionListItemRef = BswMModeControl/AC_RteSwitch_DcmCommunicationControl_0_DCM_DISABLE_RX_ENABLE_TX_NORM
            AC_RteSwitch_DcmCommunicationControl_0_DCM_DISABLE_RX_ENABLE_TX_NORM_NM (BswMActionListItem):
              category = TOOL_CONFIGURED
              BswMAbortOnFail = 0
              BswMActionListItemIndex = 20
              BswMActionListItemRef = BswMModeControl/AC_RteSwitch_DcmCommunicationControl_0_DCM_DISABLE_RX_ENABLE_TX_NORM_NM
          TrueAL_DcmCommunicationControl_0_DCM_DISABLE_RX_ENABLE_TX_NORM_NM: category=TOOL_CONFIGURED, BswMActionListExecution=BSWM_TRIGGER
            AC_RteSwitch_DcmCommunicationControl_0_DCM_DISABLE_RX_ENABLE_TX_NORM_NM (BswMActionListItem):
              category = TOOL_CONFIGURED
              BswMAbortOnFail = 0
              BswMActionListItemIndex = 10
              BswMActionListItemRef = BswMModeControl/AC_RteSwitch_DcmCommunicationControl_0_DCM_DISABLE_RX_ENABLE_TX_NORM_NM
          TrueAL_DcmCommunicationControl_0_DCM_DISABLE_RX_TX_NM: category=TOOL_CONFIGURED, BswMActionListExecution=BSWM_TRIGGER
            AC_RteSwitch_DcmCommunicationControl_0_DCM_DISABLE_RX_TX_NM (BswMActionListItem):
              category = TOOL_CONFIGURED
              BswMAbortOnFail = 0
              BswMActionListItemIndex = 10
              BswMActionListItemRef = BswMModeControl/AC_RteSwitch_DcmCommunicationControl_0_DCM_DISABLE_RX_TX_NM
          TrueAL_DcmCommunicationControl_0_DCM_DISABLE_RX_TX_NORMAL: category=TOOL_CONFIGURED, BswMActionListExecution=BSWM_TRIGGER
            AC_RteSwitch_DcmCommunicationControl_0_DCM_DISABLE_RX_TX_NORMAL (BswMActionListItem):
              category = TOOL_CONFIGURED
              BswMAbortOnFail = 0
              BswMActionListItemIndex = 10
              BswMActionListItemRef = BswMModeControl/AC_RteSwitch_DcmCommunicationControl_0_DCM_DISABLE_RX_TX_NORMAL
          TrueAL_DcmCommunicationControl_0_DCM_DISABLE_RX_TX_NORM_NM: category=TOOL_CONFIGURED, BswMActionListExecution=BSWM_TRIGGER
            AC_RteSwitch_DcmCommunicationControl_0_DCM_DISABLE_RX_TX_NORM_NM (BswMActionListItem):
              category = TOOL_CONFIGURED
              BswMAbortOnFail = 0
              BswMActionListItemIndex = 10
              BswMActionListItemRef = BswMModeControl/AC_RteSwitch_DcmCommunicationControl_0_DCM_DISABLE_RX_TX_NORM_NM
          TrueAL_DcmCommunicationControl_0_DCM_ENABLE_RX_DISABLE_TX_NM: category=TOOL_CONFIGURED, BswMActionListExecution=BSWM_TRIGGER
            AC_RteSwitch_DcmCommunicationControl_0_DCM_ENABLE_RX_DISABLE_TX_NM (BswMActionListItem):
              category = TOOL_CONFIGURED
              BswMAbortOnFail = 0
              BswMActionListItemIndex = 10
              BswMActionListItemRef = BswMModeControl/AC_RteSwitch_DcmCommunicationControl_0_DCM_ENABLE_RX_DISABLE_TX_NM
          TrueAL_DcmCommunicationControl_0_DCM_ENABLE_RX_DISABLE_TX_NORM: category=TOOL_CONFIGURED, BswMActionListExecution=BSWM_TRIGGER
            AC_RteSwitch_DcmCommunicationControl_0_DCM_ENABLE_RX_DISABLE_TX_NORM (BswMActionListItem):
              category = TOOL_CONFIGURED
              BswMAbortOnFail = 0
              BswMActionListItemIndex = 10
              BswMActionListItemRef = BswMModeControl/AC_RteSwitch_DcmCommunicationControl_0_DCM_ENABLE_RX_DISABLE_TX_NORM
            AC_RteSwitch_DcmCommunicationControl_0_DCM_ENABLE_RX_DISABLE_TX_NORM_NM (BswMActionListItem):
              category = TOOL_CONFIGURED
              BswMAbortOnFail = 0
              BswMActionListItemIndex = 20
              BswMActionListItemRef = BswMModeControl/AC_RteSwitch_DcmCommunicationControl_0_DCM_ENABLE_RX_DISABLE_TX_NORM_NM
          TrueAL_DcmCommunicationControl_0_DCM_ENABLE_RX_DISABLE_TX_NORM_NM: category=TOOL_CONFIGURED, BswMActionListExecution=BSWM_TRIGGER
            AC_RteSwitch_DcmCommunicationControl_0_DCM_ENABLE_RX_DISABLE_TX_NORM_NM (BswMActionListItem):
              category = TOOL_CONFIGURED
              BswMAbortOnFail = 0
              BswMActionListItemIndex = 10
              BswMActionListItemRef = BswMModeControl/AC_RteSwitch_DcmCommunicationControl_0_DCM_ENABLE_RX_DISABLE_TX_NORM_NM
          TrueAL_DcmCommunicationControl_0_DCM_ENABLE_RX_TX_NM: category=TOOL_CONFIGURED, BswMActionListExecution=BSWM_TRIGGER
            AC_RteSwitch_DcmCommunicationControl_0_DCM_ENABLE_RX_TX_NM (BswMActionListItem):
              category = TOOL_CONFIGURED
              BswMAbortOnFail = 0
              BswMActionListItemIndex = 10
              BswMActionListItemRef = BswMModeControl/AC_RteSwitch_DcmCommunicationControl_0_DCM_ENABLE_RX_TX_NM
          TrueAL_DcmCommunicationControl_0_DCM_ENABLE_RX_TX_NORM: category=TOOL_CONFIGURED, BswMActionListExecution=BSWM_TRIGGER
            AC_RteSwitch_DcmCommunicationControl_0_DCM_ENABLE_RX_TX_NORM (BswMActionListItem):
              category = TOOL_CONFIGURED
              BswMAbortOnFail = 0
              BswMActionListItemIndex = 10
              BswMActionListItemRef = BswMModeControl/AC_RteSwitch_DcmCommunicationControl_0_DCM_ENABLE_RX_TX_NORM
            AC_RteSwitch_DcmCommunicationControl_0_DCM_ENABLE_RX_TX_NORM_NM (BswMActionListItem):
              category = TOOL_CONFIGURED
              BswMAbortOnFail = 0
              BswMActionListItemIndex = 20
              BswMActionListItemRef = BswMModeControl/AC_RteSwitch_DcmCommunicationControl_0_DCM_ENABLE_RX_TX_NORM_NM
          TrueAL_DcmCommunicationControl_0_DCM_ENABLE_RX_TX_NORM_NM: category=TOOL_CONFIGURED, BswMActionListExecution=BSWM_TRIGGER
            AC_RteSwitch_DcmCommunicationControl_0_DCM_ENABLE_RX_TX_NORM_NM (BswMActionListItem):
              category = TOOL_CONFIGURED
              BswMAbortOnFail = 0
              BswMActionListItemIndex = 10
              BswMActionListItemRef = BswMModeControl/AC_RteSwitch_DcmCommunicationControl_0_DCM_ENABLE_RX_TX_NORM_NM
          TrueAL_DcmCommunicationControl_1_DCM_DISABLE_RX_DISABLE_TX_NM: category=TOOL_CONFIGURED, BswMActionListExecution=BSWM_TRIGGER
            AC_RteSwitch_DcmCommunicationControl_1_DCM_DISABLE_RX_DISABLE_TX_NM (BswMActionListItem):
              category = TOOL_CONFIGURED
              BswMAbortOnFail = 0
              BswMActionListItemIndex = 10
              BswMActionListItemRef = BswMModeControl/AC_RteSwitch_DcmCommunicationControl_1_DCM_DISABLE_RX_DISABLE_TX_NM
          TrueAL_DcmCommunicationControl_1_DCM_DISABLE_RX_ENABLE_TX_NORM: category=TOOL_CONFIGURED, BswMActionListExecution=BSWM_TRIGGER
            AC_RteSwitch_DcmCommunicationControl_1_DCM_DISABLE_RX_ENABLE_TX_NORM (BswMActionListItem):
              category = TOOL_CONFIGURED
              BswMAbortOnFail = 0
              BswMActionListItemIndex = 10
              BswMActionListItemRef = BswMModeControl/AC_RteSwitch_DcmCommunicationControl_1_DCM_DISABLE_RX_ENABLE_TX_NORM
            AC_RteSwitch_DcmCommunicationControl_1_DCM_DISABLE_RX_ENABLE_TX_NORM_NM (BswMActionListItem):
              category = TOOL_CONFIGURED
              BswMAbortOnFail = 0
              BswMActionListItemIndex = 20
              BswMActionListItemRef = BswMModeControl/AC_RteSwitch_DcmCommunicationControl_1_DCM_DISABLE_RX_ENABLE_TX_NORM_NM
          TrueAL_DcmCommunicationControl_1_DCM_DISABLE_RX_ENABLE_TX_NORM_NM: category=TOOL_CONFIGURED, BswMActionListExecution=BSWM_TRIGGER
            AC_RteSwitch_DcmCommunicationControl_1_DCM_DISABLE_RX_ENABLE_TX_NORM_NM (BswMActionListItem):
              category = TOOL_CONFIGURED
              BswMAbortOnFail = 0
              BswMActionListItemIndex = 10
              BswMActionListItemRef = BswMModeControl/AC_RteSwitch_DcmCommunicationControl_1_DCM_DISABLE_RX_ENABLE_TX_NORM_NM
          TrueAL_DcmCommunicationControl_1_DCM_DISABLE_RX_TX_NM: category=TOOL_CONFIGURED, BswMActionListExecution=BSWM_TRIGGER
            AC_RteSwitch_DcmCommunicationControl_1_DCM_DISABLE_RX_TX_NM (BswMActionListItem):
              category = TOOL_CONFIGURED
              BswMAbortOnFail = 0
              BswMActionListItemIndex = 10
              BswMActionListItemRef = BswMModeControl/AC_RteSwitch_DcmCommunicationControl_1_DCM_DISABLE_RX_TX_NM
          TrueAL_DcmCommunicationControl_1_DCM_DISABLE_RX_TX_NORMAL: category=TOOL_CONFIGURED, BswMActionListExecution=BSWM_TRIGGER
            AC_RteSwitch_DcmCommunicationControl_1_DCM_DISABLE_RX_TX_NORMAL (BswMActionListItem):
              category = TOOL_CONFIGURED
              BswMAbortOnFail = 0
              BswMActionListItemIndex = 10
              BswMActionListItemRef = BswMModeControl/AC_RteSwitch_DcmCommunicationControl_1_DCM_DISABLE_RX_TX_NORMAL
          TrueAL_DcmCommunicationControl_1_DCM_DISABLE_RX_TX_NORM_NM: category=TOOL_CONFIGURED, BswMActionListExecution=BSWM_TRIGGER
            AC_RteSwitch_DcmCommunicationControl_1_DCM_DISABLE_RX_TX_NORM_NM (BswMActionListItem):
              category = TOOL_CONFIGURED
              BswMAbortOnFail = 0
              BswMActionListItemIndex = 10
              BswMActionListItemRef = BswMModeControl/AC_RteSwitch_DcmCommunicationControl_1_DCM_DISABLE_RX_TX_NORM_NM
          TrueAL_DcmCommunicationControl_1_DCM_ENABLE_RX_DISABLE_TX_NM: category=TOOL_CONFIGURED, BswMActionListExecution=BSWM_TRIGGER
            AC_RteSwitch_DcmCommunicationControl_1_DCM_ENABLE_RX_DISABLE_TX_NM (BswMActionListItem):
              category = TOOL_CONFIGURED
              BswMAbortOnFail = 0
              BswMActionListItemIndex = 10
              BswMActionListItemRef = BswMModeControl/AC_RteSwitch_DcmCommunicationControl_1_DCM_ENABLE_RX_DISABLE_TX_NM
          TrueAL_DcmCommunicationControl_1_DCM_ENABLE_RX_DISABLE_TX_NORM: category=TOOL_CONFIGURED, BswMActionListExecution=BSWM_TRIGGER
            AC_RteSwitch_DcmCommunicationControl_1_DCM_ENABLE_RX_DISABLE_TX_NORM (BswMActionListItem):
              category = TOOL_CONFIGURED
              BswMAbortOnFail = 0
              BswMActionListItemIndex = 10
              BswMActionListItemRef = BswMModeControl/AC_RteSwitch_DcmCommunicationControl_1_DCM_ENABLE_RX_DISABLE_TX_NORM
            AC_RteSwitch_DcmCommunicationControl_1_DCM_ENABLE_RX_DISABLE_TX_NORM_NM (BswMActionListItem):
              category = TOOL_CONFIGURED
              BswMAbortOnFail = 0
              BswMActionListItemIndex = 20
              BswMActionListItemRef = BswMModeControl/AC_RteSwitch_DcmCommunicationControl_1_DCM_ENABLE_RX_DISABLE_TX_NORM_NM
          TrueAL_DcmCommunicationControl_1_DCM_ENABLE_RX_DISABLE_TX_NORM_NM: category=TOOL_CONFIGURED, BswMActionListExecution=BSWM_TRIGGER
            AC_RteSwitch_DcmCommunicationControl_1_DCM_ENABLE_RX_DISABLE_TX_NORM_NM (BswMActionListItem):
              category = TOOL_CONFIGURED
              BswMAbortOnFail = 0
              BswMActionListItemIndex = 10
              BswMActionListItemRef = BswMModeControl/AC_RteSwitch_DcmCommunicationControl_1_DCM_ENABLE_RX_DISABLE_TX_NORM_NM
          TrueAL_DcmCommunicationControl_1_DCM_ENABLE_RX_TX_NM: category=TOOL_CONFIGURED, BswMActionListExecution=BSWM_TRIGGER
            AC_RteSwitch_DcmCommunicationControl_1_DCM_ENABLE_RX_TX_NM (BswMActionListItem):
              category = TOOL_CONFIGURED
              BswMAbortOnFail = 0
              BswMActionListItemIndex = 10
              BswMActionListItemRef = BswMModeControl/AC_RteSwitch_DcmCommunicationControl_1_DCM_ENABLE_RX_TX_NM
          TrueAL_DcmCommunicationControl_1_DCM_ENABLE_RX_TX_NORM: category=TOOL_CONFIGURED, BswMActionListExecution=BSWM_TRIGGER
            AC_RteSwitch_DcmCommunicationControl_1_DCM_ENABLE_RX_TX_NORM (BswMActionListItem):
              category = TOOL_CONFIGURED
              BswMAbortOnFail = 0
              BswMActionListItemIndex = 10
              BswMActionListItemRef = BswMModeControl/AC_RteSwitch_DcmCommunicationControl_1_DCM_ENABLE_RX_TX_NORM
            AC_RteSwitch_DcmCommunicationControl_1_DCM_ENABLE_RX_TX_NORM_NM (BswMActionListItem):
              category = TOOL_CONFIGURED
              BswMAbortOnFail = 0
              BswMActionListItemIndex = 20
              BswMActionListItemRef = BswMModeControl/AC_RteSwitch_DcmCommunicationControl_1_DCM_ENABLE_RX_TX_NORM_NM
          TrueAL_DcmCommunicationControl_1_DCM_ENABLE_RX_TX_NORM_NM: category=TOOL_CONFIGURED, BswMActionListExecution=BSWM_TRIGGER
            AC_RteSwitch_DcmCommunicationControl_1_DCM_ENABLE_RX_TX_NORM_NM (BswMActionListItem):
              category = TOOL_CONFIGURED
              BswMAbortOnFail = 0
              BswMActionListItemIndex = 10
              BswMActionListItemRef = BswMModeControl/AC_RteSwitch_DcmCommunicationControl_1_DCM_ENABLE_RX_TX_NORM_NM
          TrueAL_DcmControlDTCSetting_DISABLEDTCSETTING: category=TOOL_CONFIGURED, BswMActionListExecution=BSWM_TRIGGER
            AC_RteSwitch_DcmControlDTCSetting_DISABLEDTCSETTING (BswMActionListItem):
              category = TOOL_CONFIGURED
              BswMAbortOnFail = 0
              BswMActionListItemIndex = 10
              BswMActionListItemRef = BswMModeControl/AC_RteSwitch_DcmControlDTCSetting_DISABLEDTCSETTING
          TrueAL_DcmControlDTCSetting_ENABLEDTCSETTING: category=TOOL_CONFIGURED, BswMActionListExecution=BSWM_TRIGGER
            AC_RteSwitch_DcmControlDTCSetting_ENABLEDTCSETTING (BswMActionListItem):
              category = TOOL_CONFIGURED
              BswMAbortOnFail = 0
              BswMActionListItemIndex = 10
              BswMActionListItemRef = BswMModeControl/AC_RteSwitch_DcmControlDTCSetting_ENABLEDTCSETTING
          TrueAL_DcmModeRapidPowerShutDown_DISABLE_RAPIDPOWERSHUTDOWN: category=TOOL_CONFIGURED, BswMActionListExecution=BSWM_TRIGGER
            AC_RteSwitch_DcmModeRapidPowerShutDown_DISABLE_RAPIDPOWERSHUTDOWN (BswMActionListItem):
              category = TOOL_CONFIGURED
              BswMAbortOnFail = 0
              BswMActionListItemIndex = 10
              BswMActionListItemRef = BswMModeControl/AC_RteSwitch_DcmModeRapidPowerShutDown_DISABLE_RAPIDPOWERSHUTDOWN
          TrueAL_DcmModeRapidPowerShutDown_ENABLE_RAPIDPOWERSHUTDOWN: category=TOOL_CONFIGURED, BswMActionListExecution=BSWM_TRIGGER
            AC_RteSwitch_DcmModeRapidPowerShutDown_ENABLE_RAPIDPOWERSHUTDOWN (BswMActionListItem):
              category = TOOL_CONFIGURED
              BswMAbortOnFail = 0
              BswMActionListItemIndex = 10
              BswMActionListItemRef = BswMModeControl/AC_RteSwitch_DcmModeRapidPowerShutDown_ENABLE_RAPIDPOWERSHUTDOWN
          TrueAL_DiagnosticSessionNotification_DEFAULT_SESSION: category=TOOL_CONFIGURED, BswMActionListExecution=BSWM_TRIGGER
            AC_RteSwitch_DcmDiagnosticSessionControl_DCM_DEFAULT_SESSION (BswMActionListItem):
              category = TOOL_CONFIGURED
              BswMAbortOnFail = 0
              BswMActionListItemIndex = 10
              BswMActionListItemRef = BswMModeControl/AC_RteSwitch_DcmDiagnosticSessionControl_DCM_DEFAULT_SESSION
          TrueAL_DiagnosticSessionNotification_ECU_PROGRAMMING_MODE: category=TOOL_CONFIGURED, BswMActionListExecution=BSWM_TRIGGER
            AC_RteSwitch_DcmDiagnosticSessionControl_DCM_ECU_PROGRAMMING_MODE (BswMActionListItem):
              category = TOOL_CONFIGURED
              BswMAbortOnFail = 0
              BswMActionListItemIndex = 10
              BswMActionListItemRef = BswMModeControl/AC_RteSwitch_DcmDiagnosticSessionControl_DCM_ECU_PROGRAMMING_MODE
          TrueAL_DiagnosticSessionNotification_EXTENDED_DIAGNOSTIC_MODE: category=TOOL_CONFIGURED, BswMActionListExecution=BSWM_TRIGGER
            AC_RteSwitch_DcmDiagnosticSessionControl_DCM_EXTENDED_DIAGNOSTIC_MODE (BswMActionListItem):
              category = TOOL_CONFIGURED
              BswMAbortOnFail = 0
              BswMActionListItemIndex = 10
              BswMActionListItemRef = BswMModeControl/AC_RteSwitch_DcmDiagnosticSessionControl_DCM_EXTENDED_DIAGNOSTIC_MODE
          TrueAL_DiagnosticSessionNotification_EXTENDED_DIAGNOSTIC_SESSION: category=TOOL_CONFIGURED, BswMActionListExecution=BSWM_TRIGGER
            AC_RteSwitch_DcmDiagnosticSessionControl_DCM_EXTENDED_DIAGNOSTIC_SESSION (BswMActionListItem):
              category = TOOL_CONFIGURED
              BswMAbortOnFail = 0
              BswMActionListItemIndex = 10
              BswMActionListItemRef = BswMModeControl/AC_RteSwitch_DcmDiagnosticSessionControl_DCM_EXTENDED_DIAGNOSTIC_SESSION
          TrueAL_DiagnosticSessionNotification_PROGRAMMING_SESSION: category=TOOL_CONFIGURED, BswMActionListExecution=BSWM_TRIGGER
            AC_RteSwitch_DcmDiagnosticSessionControl_DCM_PROGRAMMING_SESSION (BswMActionListItem):
              category = TOOL_CONFIGURED
              BswMAbortOnFail = 0
              BswMActionListItemIndex = 10
              BswMActionListItemRef = BswMModeControl/AC_RteSwitch_DcmDiagnosticSessionControl_DCM_PROGRAMMING_SESSION
          TrueAL_DiagnosticSessionNotification_QUIESCENT_CURRENT_DIAGNOSTIC_MODE_START: category=TOOL_CONFIGURED, BswMActionListExecution=BSWM_TRIGGER
            AC_RteSwitch_DcmDiagnosticSessionControl_DCM_QUIESCENT_CURRENT_DIAGNOSTIC_MODE_START (BswMActionListItem):
              category = TOOL_CONFIGURED
              BswMAbortOnFail = 0
              BswMActionListItemIndex = 10
              BswMActionListItemRef = BswMModeControl/AC_RteSwitch_DcmDiagnosticSessionControl_DCM_QUIESCENT_CURRENT_DIAGNOSTIC_MODE_START
          TrueAL_DiagnosticSessionNotification_SAFETY_SYSTEM_DIAGNOSTIC_SESSION: category=TOOL_CONFIGURED, BswMActionListExecution=BSWM_TRIGGER
            AC_RteSwitch_DcmDiagnosticSessionControl_DCM_SAFETY_SYSTEM_DIAGNOSTIC_SESSION (BswMActionListItem):
              category = TOOL_CONFIGURED
              BswMAbortOnFail = 0
              BswMActionListItemIndex = 10
              BswMActionListItemRef = BswMModeControl/AC_RteSwitch_DcmDiagnosticSessionControl_DCM_SAFETY_SYSTEM_DIAGNOSTIC_SESSION
          TrueAL_DiagnosticSessionNotification_SLEEP_MODE_START_REQUEST: category=TOOL_CONFIGURED, BswMActionListExecution=BSWM_TRIGGER
            AC_RteSwitch_DcmDiagnosticSessionControl_DCM_SLEEP_MODE_START_REQUEST (BswMActionListItem):
              category = TOOL_CONFIGURED
              BswMAbortOnFail = 0
              BswMActionListItemIndex = 10
              BswMActionListItemRef = BswMModeControl/AC_RteSwitch_DcmDiagnosticSessionControl_DCM_SLEEP_MODE_START_REQUEST
          TrueAL_EcuStateTo_OFF: category=TOOL_CONFIGURED, BswMActionListExecution=BSWM_TRIGGER
            AC_SchMSwitch_EcuMode_ECUM_STATE_OFF (BswMActionListItem):
              category = TOOL_CONFIGURED
              BswMAbortOnFail = 0
              BswMActionListItemIndex = 10
              BswMActionListItemRef = BswMModeControl/AC_SchMSwitch_EcuMode_ECUM_STATE_OFF
            AC_UserCallout_EcuState_ENTRY_OFF (BswMActionListItem): category=TOOL_CONFIGURED, BswMAbortOnFail=0, BswMActionListItemIndex=20, BswMActionListItemRef=BswMModeControl/AC_UserCallout_EcuState_ENTRY_OFF
          TrueAL_EcuStateTo_RESET: category=TOOL_CONFIGURED, BswMActionListExecution=BSWM_TRIGGER
            AC_SchMSwitch_EcuMode_ECUM_STATE_RESET (BswMActionListItem):
              category = TOOL_CONFIGURED
              BswMAbortOnFail = 0
              BswMActionListItemIndex = 10
              BswMActionListItemRef = BswMModeControl/AC_SchMSwitch_EcuMode_ECUM_STATE_RESET
            AC_UserCallout_EcuState_ENTRY_RESET (BswMActionListItem): category=TOOL_CONFIGURED, BswMAbortOnFail=0, BswMActionListItemIndex=20, BswMActionListItemRef=BswMModeControl/AC_UserCallout_EcuState_ENTRY_RESET
          TrueAL_EcuStateTo_RUN_From_SLEEP: category=TOOL_CONFIGURED, BswMActionListExecution=BSWM_TRIGGER
            4 x BswMActionListItem, all with category=TOOL_CONFIGURED, BswMAbortOnFail=0:
              AC_UserCallout_EcuModeTransition_End: BswMActionListItemIndex=10, BswMActionListItemRef=BswMModeControl/AC_UserCallout_EcuModeTransition_End
              AC_SchMSwitch_EcuMode_ECUM_STATE_RUN: BswMActionListItemIndex=20, BswMActionListItemRef=BswMModeControl/AC_SchMSwitch_EcuMode_ECUM_STATE_RUN
              AC_RteSwitch_EcuMode_ECUM_STATE_RUN: BswMActionListItemIndex=30, BswMActionListItemRef=BswMModeControl/AC_RteSwitch_EcuMode_ECUM_STATE_RUN
              AC_UserCallout_EcuState_ENTRY_RUN: BswMActionListItemIndex=40, BswMActionListItemRef=BswMModeControl/AC_UserCallout_EcuState_ENTRY_RUN
          TrueAL_EcuStateTo_RUN_From_STARTUP: category=TOOL_CONFIGURED, BswMActionListExecution=BSWM_TRIGGER
            3 x BswMActionListItem, all with category=TOOL_CONFIGURED, BswMAbortOnFail=0:
              AC_SchMSwitch_EcuMode_ECUM_STATE_RUN: BswMActionListItemIndex=10, BswMActionListItemRef=BswMModeControl/AC_SchMSwitch_EcuMode_ECUM_STATE_RUN
              AC_RteSwitch_EcuMode_ECUM_STATE_RUN: BswMActionListItemIndex=20, BswMActionListItemRef=BswMModeControl/AC_RteSwitch_EcuMode_ECUM_STATE_RUN
              AC_UserCallout_EcuState_ENTRY_RUN: BswMActionListItemIndex=30, BswMActionListItemRef=BswMModeControl/AC_UserCallout_EcuState_ENTRY_RUN
          TrueAL_EcuStateTo_SHUTDOWN: category=TOOL_CONFIGURED, BswMActionListExecution=BSWM_TRIGGER
            4 x BswMActionListItem, all with category=TOOL_CONFIGURED, BswMAbortOnFail=0:
              AC_UserCallout_EcuModeTransition_End: BswMActionListItemIndex=10, BswMActionListItemRef=BswMModeControl/AC_UserCallout_EcuModeTransition_End
              AC_SchMSwitch_EcuMode_ECUM_STATE_SHUTDOWN: BswMActionListItemIndex=20, BswMActionListItemRef=BswMModeControl/AC_SchMSwitch_EcuMode_ECUM_STATE_SHUTDOWN
              AC_RteSwitch_EcuMode_ECUM_STATE_SHUTDOWN: BswMActionListItemIndex=30, BswMActionListItemRef=BswMModeControl/AC_RteSwitch_EcuMode_ECUM_STATE_SHUTDOWN
              AC_UserCallout_EcuState_ENTRY_SHUTDOWN: BswMActionListItemIndex=40, BswMActionListItemRef=BswMModeControl/AC_UserCallout_EcuState_ENTRY_SHUTDOWN
          TrueAL_EcuStateTo_SLEEP: category=TOOL_CONFIGURED, BswMActionListExecution=BSWM_TRIGGER
            4 x BswMActionListItem, all with category=TOOL_CONFIGURED, BswMAbortOnFail=0:
              AC_UserCallout_EcuModeTransition_End: BswMActionListItemIndex=10, BswMActionListItemRef=BswMModeControl/AC_UserCallout_EcuModeTransition_End
              AC_SchMSwitch_EcuMode_ECUM_STATE_SLEEP: BswMActionListItemIndex=20, BswMActionListItemRef=BswMModeControl/AC_SchMSwitch_EcuMode_ECUM_STATE_SLEEP
              AC_RteSwitch_EcuMode_ECUM_STATE_SLEEP: BswMActionListItemIndex=30, BswMActionListItemRef=BswMModeControl/AC_RteSwitch_EcuMode_ECUM_STATE_SLEEP
              AC_UserCallout_EcuState_ENTRY_SLEEP: BswMActionListItemIndex=40, BswMActionListItemRef=BswMModeControl/AC_UserCallout_EcuState_ENTRY_SLEEP
          TrueAL_EcuStateTo_STARTUP_THREE: category=TOOL_CONFIGURED, BswMActionListExecution=BSWM_TRIGGER
            AC_SchMSwitch_EcuMode_ECUM_STATE_STARTUP_THREE (BswMActionListItem):
              category = TOOL_CONFIGURED
              BswMAbortOnFail = 0
              BswMActionListItemIndex = 10
              BswMActionListItemRef = BswMModeControl/AC_SchMSwitch_EcuMode_ECUM_STATE_STARTUP_THREE
            AC_UserCallout_EcuState_ENTRY_STARTUP_THREE (BswMActionListItem):
              category = TOOL_CONFIGURED
              BswMAbortOnFail = 0
              BswMActionListItemIndex = 20
              BswMActionListItemRef = BswMModeControl/AC_UserCallout_EcuState_ENTRY_STARTUP_THREE
          TrueAL_EcuStateTo_STARTUP_TWO: category=TOOL_CONFIGURED, BswMActionListExecution=BSWM_TRIGGER
            AC_SchMSwitch_EcuMode_ECUM_STATE_STARTUP_TWO (BswMActionListItem):
              category = TOOL_CONFIGURED
              BswMAbortOnFail = 0
              BswMActionListItemIndex = 10
              BswMActionListItemRef = BswMModeControl/AC_SchMSwitch_EcuMode_ECUM_STATE_STARTUP_TWO
            AC_UserCallout_EcuState_ENTRY_STARTUP_TWO (BswMActionListItem):
              category = TOOL_CONFIGURED
              BswMAbortOnFail = 0
              BswMActionListItemIndex = 20
              BswMActionListItemRef = BswMModeControl/AC_UserCallout_EcuState_ENTRY_STARTUP_TWO
          TrueAL_EcuState_OFF: category=TOOL_CONFIGURED, BswMActionListExecution=BSWM_TRIGGER
            AC_EcuMGoDown_BSWM (BswMActionListItem): category=TOOL_CONFIGURED, BswMAbortOnFail=0, BswMActionListItemIndex=10, BswMActionListItemRef=BswMModeControl/AC_EcuMGoDown_BSWM
          TrueAL_EcuState_RESET: category=TOOL_CONFIGURED, BswMActionListExecution=BSWM_TRIGGER
            AC_EcuMGoDown_BSWM (BswMActionListItem): category=TOOL_CONFIGURED, BswMAbortOnFail=0, BswMActionListItemIndex=10, BswMActionListItemRef=BswMModeControl/AC_EcuMGoDown_BSWM
          TrueAL_EcuState_RUN: category=TOOL_CONFIGURED, BswMActionListExecution=BSWM_TRIGGER
            AC_UserCallout_EcuState_EXIT_RUN (BswMActionListItem): category=TOOL_CONFIGURED, BswMAbortOnFail=0, BswMActionListItemIndex=10, BswMActionListItemRef=BswMModeControl/AC_UserCallout_EcuState_EXIT_RUN
          TrueAL_EcuState_SHUTDOWN: category=TOOL_CONFIGURED, BswMActionListExecution=BSWM_TRIGGER
            5 x BswMActionListItem, all with category=TOOL_CONFIGURED, BswMAbortOnFail=0:
              AL_ComModeAllow_ALL_FALSE: BswMActionListItemIndex=10, BswMActionListItemRef=BswMModeControl/AL_ComModeAllow_ALL_FALSE
              AL_DriverPreDeinit: BswMActionListItemIndex=20, BswMActionListItemRef=BswMModeControl/AL_DriverPreDeinit
              AL_RteStop: BswMActionListItemIndex=30, BswMActionListItemRef=BswMModeControl/AL_RteStop
              AL_DriverDeinit: BswMActionListItemIndex=40, BswMActionListItemRef=BswMModeControl/AL_DriverDeinit
              AC_UserCallout_EcuState_EXIT_SHUTDOWN: BswMActionListItemIndex=50, BswMActionListItemRef=BswMModeControl/AC_UserCallout_EcuState_EXIT_SHUTDOWN
          TrueAL_EcuState_SLEEP: category=TOOL_CONFIGURED, BswMActionListExecution=BSWM_TRIGGER
            AC_UserCallout_EcuM_GoHalt (BswMActionListItem): category=TOOL_CONFIGURED, BswMAbortOnFail=0, BswMActionListItemIndex=10, BswMActionListItemRef=BswMModeControl/AC_UserCallout_EcuM_GoHalt
            AC_UserCallout_EcuState_EXIT_SLEEP (BswMActionListItem): category=TOOL_CONFIGURED, BswMAbortOnFail=0, BswMActionListItemIndex=20, BswMActionListItemRef=BswMModeControl/AC_UserCallout_EcuState_EXIT_SLEEP
          TrueAL_EcuState_STARTUP_THREE: category=TOOL_CONFIGURED, BswMActionListExecution=BSWM_TRIGGER
            5 x BswMActionListItem, all with category=TOOL_CONFIGURED, BswMAbortOnFail=0:
              AL_DriverInitThree: BswMActionListItemIndex=10, BswMActionListItemRef=BswMModeControl/AL_DriverInitThree
              AL_ComModeAllow_ALL_TRUE: BswMActionListItemIndex=20, BswMActionListItemRef=BswMModeControl/AL_ComModeAllow_ALL_TRUE
              AL_RteStart: BswMActionListItemIndex=30, BswMActionListItemRef=BswMModeControl/AL_RteStart
              AC_RteSwitch_InitState_COMPLETE: BswMActionListItemIndex=40, BswMActionListItemRef=BswMModeControl/AC_RteSwitch_InitState_COMPLETE
              AC_UserCallout_EcuState_EXIT_STARTUP_THREE: BswMActionListItemIndex=50, BswMActionListItemRef=BswMModeControl/AC_UserCallout_EcuState_EXIT_STARTUP_THREE
          TrueAL_EcuState_STARTUP_TWO: category=TOOL_CONFIGURED, BswMActionListExecution=BSWM_TRIGGER
            AL_DriverInitTwo (BswMActionListItem): category=TOOL_CONFIGURED, BswMAbortOnFail=0, BswMActionListItemIndex=10, BswMActionListItemRef=BswMModeControl/AL_DriverInitTwo
            AC_UserCallout_EcuState_EXIT_STARTUP_TWO (BswMActionListItem):
              category = TOOL_CONFIGURED
              BswMAbortOnFail = 0
              BswMActionListItemIndex = 20
              BswMActionListItemRef = BswMModeControl/AC_UserCallout_EcuState_EXIT_STARTUP_TWO
          TrueAL_ShutdownTargetTo_OFF: category=TOOL_CONFIGURED, BswMActionListExecution=BSWM_TRIGGER
            3 x BswMActionListItem, all with category=TOOL_CONFIGURED, BswMAbortOnFail=0:
              AC_UserCallout_EcuModeTransition_Ongoing: BswMActionListItemIndex=10, BswMActionListItemRef=BswMModeControl/AC_UserCallout_EcuModeTransition_Ongoing
              AC_EcuMSelectShutdownTarget_OFF: BswMActionListItemIndex=20, BswMActionListItemRef=BswMModeControl/AC_EcuMSelectShutdownTarget_OFF
              AC_UserCallout_ShutdownTargetTo_OFF: BswMActionListItemIndex=30, BswMActionListItemRef=BswMModeControl/AC_UserCallout_ShutdownTargetTo_OFF
          TrueAL_ShutdownTargetTo_RESET: category=TOOL_CONFIGURED, BswMActionListExecution=BSWM_TRIGGER
            3 x BswMActionListItem, all with category=TOOL_CONFIGURED, BswMAbortOnFail=0:
              AC_UserCallout_EcuModeTransition_Ongoing: BswMActionListItemIndex=10, BswMActionListItemRef=BswMModeControl/AC_UserCallout_EcuModeTransition_Ongoing
              AC_EcuMSelectShutdownTarget_RESET_MCU: BswMActionListItemIndex=20, BswMActionListItemRef=BswMModeControl/AC_EcuMSelectShutdownTarget_RESET_MCU
              AC_UserCallout_ShutdownTargetTo_RESET: BswMActionListItemIndex=30, BswMActionListItemRef=BswMModeControl/AC_UserCallout_ShutdownTargetTo_RESET
          TrueAL_ShutdownTargetTo_RUN: category=TOOL_CONFIGURED, BswMActionListExecution=BSWM_TRIGGER
            AC_UserCallout_EcuModeTransition_Ongoing (BswMActionListItem):
              category = TOOL_CONFIGURED
              BswMAbortOnFail = 0
              BswMActionListItemIndex = 10
              BswMActionListItemRef = BswMModeControl/AC_UserCallout_EcuModeTransition_Ongoing
            AC_UserCallout_ShutdownTargetTo_RUN (BswMActionListItem): category=TOOL_CONFIGURED, BswMAbortOnFail=0, BswMActionListItemIndex=20, BswMActionListItemRef=BswMModeControl/AC_UserCallout_ShutdownTargetTo_RUN
          TrueAL_ShutdownTargetTo_SLEEP: category=TOOL_CONFIGURED, BswMActionListExecution=BSWM_TRIGGER
            AC_UserCallout_EcuModeTransition_Ongoing (BswMActionListItem):
              category = TOOL_CONFIGURED
              BswMAbortOnFail = 0
              BswMActionListItemIndex = 10
              BswMActionListItemRef = BswMModeControl/AC_UserCallout_EcuModeTransition_Ongoing
            AC_UserCallout_ShutdownTargetTo_SLEEP (BswMActionListItem):
              category = TOOL_CONFIGURED
              BswMAbortOnFail = 0
              BswMActionListItemIndex = 20
              BswMActionListItemRef = BswMModeControl/AC_UserCallout_ShutdownTargetTo_SLEEP
          TrueAL_WakeupEventNotification_BCAN_RX: category=TOOL_CONFIGURED, BswMActionListExecution=BSWM_TRIGGER
            AC_RteSwitch_WakeupEvent_BCAN_RX (BswMActionListItem): category=TOOL_CONFIGURED, BswMAbortOnFail=0, BswMActionListItemIndex=10, BswMActionListItemRef=BswMModeControl/AC_RteSwitch_WakeupEvent_BCAN_RX
          TrueAL_WakeupEventNotification_BCAN_RX_POLL: category=TOOL_CONFIGURED, BswMActionListExecution=BSWM_TRIGGER
            AC_RteSwitch_WakeupEvent_BCAN_RX_POLL (BswMActionListItem):
              category = TOOL_CONFIGURED
              BswMAbortOnFail = 0
              BswMActionListItemIndex = 10
              BswMActionListItemRef = BswMModeControl/AC_RteSwitch_WakeupEvent_BCAN_RX_POLL
          TrueAL_WakeupEventNotification_IGN_WakeUP: category=TOOL_CONFIGURED, BswMActionListExecution=BSWM_TRIGGER
            AC_RteSwitch_WakeupEvent_IGN_WakeUP (BswMActionListItem): category=TOOL_CONFIGURED, BswMAbortOnFail=0, BswMActionListItemIndex=10, BswMActionListItemRef=BswMModeControl/AC_RteSwitch_WakeupEvent_IGN_WakeUP
          TrueAL_WakeupEventNotification_LOCALCAN_RX: category=TOOL_CONFIGURED, BswMActionListExecution=BSWM_TRIGGER
            AC_RteSwitch_WakeupEvent_LOCALCAN_RX (BswMActionListItem):
              category = TOOL_CONFIGURED
              BswMAbortOnFail = 0
              BswMActionListItemIndex = 10
              BswMActionListItemRef = BswMModeControl/AC_RteSwitch_WakeupEvent_LOCALCAN_RX
          TrueAL_WakeupEventNotification_LOCALCAN_RX_POLL: category=TOOL_CONFIGURED, BswMActionListExecution=BSWM_TRIGGER
            AC_RteSwitch_WakeupEvent_LOCALCAN_RX_POLL (BswMActionListItem):
              category = TOOL_CONFIGURED
              BswMAbortOnFail = 0
              BswMActionListItemIndex = 10
              BswMActionListItemRef = BswMModeControl/AC_RteSwitch_WakeupEvent_LOCALCAN_RX_POLL
          TrueAL_WakeupEventNotification_IGN_WakeUp: BswMActionListExecution=BSWM_TRIGGER
            AC_RteSwitch_WakeupEvent_IGN_WakeUP (BswMActionListItem): BswMActionListItemIndex=10, BswMAbortOnFail=0, BswMActionListItemRef=BswMModeControl/AC_RteSwitch_WakeupEvent_IGN_WakeUP
        19 x BswMSwitchPort, all with category=TOOL_CONFIGURED:
          CanSMBORState_BCAN: BswMModeSwitchInterfaceRef=CanSMBORStateInterface_BCAN
          CanSMBORState_LOCALCAN: BswMModeSwitchInterfaceRef=CanSMBORStateInterface_LOCALCAN
          CanSMState_BCAN: BswMModeSwitchInterfaceRef=CanSMStateInterface_BCAN
          CanSMState_LOCALCAN: BswMModeSwitchInterfaceRef=CanSMStateInterface_LOCALCAN
          ComMMode_BCAN: BswMModeSwitchInterfaceRef=ComMModeInterface_BCAN
          ComMMode_LOCALCAN: BswMModeSwitchInterfaceRef=ComMModeInterface_LOCALCAN
          DcmApplicationUpdated: BswMModeSwitchInterfaceRef=DcmApplicationUpdated
          DcmCommunicationControl_0: BswMModeSwitchInterfaceRef=DcmCommunicationControl_0
          DcmCommunicationControl_1: BswMModeSwitchInterfaceRef=DcmCommunicationControl_1
          DcmControlDTCSetting: BswMModeSwitchInterfaceRef=DcmControlDTCSetting
          DcmDiagnosticSessionControl: BswMModeSwitchInterfaceRef=DcmDiagnosticSessionControl
          DcmModeRapidPowerShutDown: BswMModeSwitchInterfaceRef=DcmModeRapidPowerShutDown
          EcuMode: BswMModeSwitchInterfaceRef=EcuModeInterface
          InitState: BswMModeSwitchInterfaceRef=InitStateInterface
          PduGroupRx_BCAN: BswMModeSwitchInterfaceRef=PduGroupRxInterface_BCAN
          PduGroupRx_LOCALCAN: BswMModeSwitchInterfaceRef=PduGroupRxInterface_LOCALCAN
          PduGroupTx_BCAN: BswMModeSwitchInterfaceRef=PduGroupTxInterface_BCAN
          PduGroupTx_LOCALCAN: BswMModeSwitchInterfaceRef=PduGroupTxInterface_LOCALCAN
          WakeupEvent: BswMModeSwitchInterfaceRef=WakeupEventInterface

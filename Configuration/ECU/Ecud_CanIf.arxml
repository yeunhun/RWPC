AUTOSAR XML (schema 4-0-3)
package /AUTOSAR
  module config CanIf: implementation-config-variant=VARIANT-PRE-COMPILE, module-description=BswImplementation_CanIf
    CanIfDispatchCfg:
      CanIfDispatchUserCtrlBusOffUL = CDD
      CanIfDispatchUserCtrlModeIndicationUL = CAN_SM
      CanIfDispatchUserValidateWakeupEventUL = ECUM
      CanIfDispatchUserCheckTrcvWakeFlagIndicationUL = CAN_SM
      CanIfDispatchUserClearTrcvWufFlagIndicationUL = CAN_SM
      CanIfDispatchUserTrcvModeIndicationUL = CAN_SM
      CanIfDispatchUserCtrlBusOffName = OsekNm_ControllerBusOff
    CanIfPrivateCfg: CanIfPrivateDlcCheck=1, CanIfPrivateSoftwareFilterType=BINARY, CanIfSupportTTCAN=0, CanIfSupportCanCM=1, CanIfSupportCANFD=1
    CanIfPublicCfg:
      CanIfPublicChangeBaudrateSupport = 0
      CanIfPublicDevErrorDetect = 1
      CanIfPublicMultipleDrvSupport = 0
      CanIfPublicNumberOfCanHwUnits = 1
      CanIfPublicPnSupport = 0
      CanIfPublicReadRxPduDataApi = 0
      CanIfPublicReadRxPduNotifyStatusApi = 0
      CanIfPublicReadTxPduNotifyStatusApi = 0
      CanIfPublicSetDynamicTxIdApi = 0
      CanIfPublicTxBuffering = 1
      CanIfPublicTxConfirmPollingSupport = 1
      CanIfPublicVersionInfoApi = 1
      CanIfPublicWakeupCheckValidSupport = 0
      CanIfPublicWakeupCheckValidByNM = 0
      CanIfPublicCancelTransmitSupport = 0
      CanIfMetaDataSupport = 0
      CanIfPublicHandleTypeEnum = UINT16
      CanIfCANFDID16BitSupport = 0
      CanIfCANFDDiscreteDlcSupport = 0
      CanIfAutronTrcvDrvSupport = 0
      CanIfExternalTrcvDrvSupport = 1
      CanIfBusloadDetectingSupport = 0
      CanIfPublicCddHeaderFile = OsekNm_Cbk
      CanIfPublicCanDrvVersion = AR_403
    CanIfTrcvDrvCfg0 (CanIfTrcvDrvCfg)
      CanIfTrcvCfg_LOCALCAN (CanIfTrcvCfg): CanIfTrcvWakeupSupport=0, CanIfTrcvId=1, CanIfTrcvCanTrcvRef=CanTrcvChannel_LOCALCAN
      CanIfTrcvCfg_BCAN (CanIfTrcvCfg): CanIfTrcvWakeupSupport=0, CanIfTrcvId=0, CanIfTrcvCanTrcvRef=CanTrcvChannel_BCAN
    CanIfInitCfg
      CanIfInitHohCfg0 (CanIfInitHohCfg): category=TOOL_CONFIGURED, CanIfInitRefCfgSet=CanConfigSet
        CanIfHthCfg_OUT_SCM_LOCALCAN_0x318_LOCALCAN_TP_WPC_C_BDC (CanIfHthCfg):
          category = TOOL_CONFIGURED
          CanIfHthCanCtrlIdRef = CanIfCtrlCfg_SCM_LOCALCAN
          CanIfHthCanHandleTypeRef = OUT_HwObj_SCM_LOCALCAN_0x318_LOCALCAN_TP_WPC_C_BDC
          CanIfHthIdSymRef = OUT_HwObj_SCM_LOCALCAN_0x318_LOCALCAN_TP_WPC_C_BDC
        29 x CanIfHrhCfg, all with category=TOOL_CONFIGURED, CanIfHrhSoftwareFilter=1:
          CanIfHrhCfg_IN_SCM_LOCALCAN_0x30a_LOCALCAN_TP_BDC_C_WPC: CanIfHrhCanCtrlIdRef=CanIfCtrlCfg_SCM_LOCALCAN, CanIfHrhCanHandleTypeRef=IN_HwObj_SCM_LOCALCAN_0x30a_LOCALCAN_TP_BDC_C_WPC, CanIfHrhIdSymRef=IN_HwObj_SCM_LOCALCAN_0x30a_LOCALCAN_TP_BDC_C_WPC
          CanIfHrhCfg_IN_SCM_LOCALCAN_0x100_LOCALCAN_BDC_10: CanIfHrhCanCtrlIdRef=CanIfCtrlCfg_SCM_LOCALCAN, CanIfHrhCanHandleTypeRef=IN_HwObj_SCM_LOCALCAN_0x100_LOCALCAN_BDC_10, CanIfHrhIdSymRef=IN_HwObj_SCM_LOCALCAN_0x100_LOCALCAN_BDC_10
          CanIfHrhCfg_IN_SCM_LOCALCAN_0x11_LOCALCAN_BDC_01: CanIfHrhCanCtrlIdRef=CanIfCtrlCfg_SCM_LOCALCAN, CanIfHrhCanHandleTypeRef=IN_HwObj_SCM_LOCALCAN_0x11_LOCALCAN_BDC_01, CanIfHrhIdSymRef=IN_HwObj_SCM_LOCALCAN_0x11_LOCALCAN_BDC_01
          CanIfHrhCfg_IN_SCM_BCAN_0x681aa02_BCAN_CLU_01_20ms_2: CanIfHrhCanCtrlIdRef=CanIfCtrlCfg_SCM_BCAN, CanIfHrhCanHandleTypeRef=IN_HwObj_SCM_BCAN_0x681aa02_BCAN_CLU_01_20ms_2, CanIfHrhIdSymRef=IN_HwObj_SCM_BCAN_0x681aa02_BCAN_CLU_01_20ms_2
          CanIfHrhCfg_IN_SCM_BCAN_0x681aa01_BCAN_CLU_01_20ms_1: CanIfHrhCanCtrlIdRef=CanIfCtrlCfg_SCM_BCAN, CanIfHrhCanHandleTypeRef=IN_HwObj_SCM_BCAN_0x681aa01_BCAN_CLU_01_20ms_1, CanIfHrhIdSymRef=IN_HwObj_SCM_BCAN_0x681aa01_BCAN_CLU_01_20ms_1
          CanIfHrhCfg_IN_SCM_BCAN_0x4010502_BCAN_EMS_07_10ms_2: CanIfHrhCanCtrlIdRef=CanIfCtrlCfg_SCM_BCAN, CanIfHrhCanHandleTypeRef=IN_HwObj_SCM_BCAN_0x4010502_BCAN_EMS_07_10ms_2, CanIfHrhIdSymRef=IN_HwObj_SCM_BCAN_0x4010502_BCAN_EMS_07_10ms_2
          CanIfHrhCfg_IN_SCM_BCAN_0x4010001_BCAN_EMS_02_10ms_1: CanIfHrhCanCtrlIdRef=CanIfCtrlCfg_SCM_BCAN, CanIfHrhCanHandleTypeRef=IN_HwObj_SCM_BCAN_0x4010001_BCAN_EMS_02_10ms_1, CanIfHrhIdSymRef=IN_HwObj_SCM_BCAN_0x4010001_BCAN_EMS_02_10ms_1
          CanIfHrhCfg_IN_SCM_BCAN_0x3c0fa02_BCAN_HCU_03_10ms_2: CanIfHrhCanCtrlIdRef=CanIfCtrlCfg_SCM_BCAN, CanIfHrhCanHandleTypeRef=IN_HwObj_SCM_BCAN_0x3c0fa02_BCAN_HCU_03_10ms_2, CanIfHrhIdSymRef=IN_HwObj_SCM_BCAN_0x3c0fa02_BCAN_HCU_03_10ms_2
          CanIfHrhCfg_IN_SCM_BCAN_0xc03501_BCAN_VCU_01_10ms_1: CanIfHrhCanCtrlIdRef=CanIfCtrlCfg_SCM_BCAN, CanIfHrhCanHandleTypeRef=IN_HwObj_SCM_BCAN_0xc03501_BCAN_VCU_01_10ms_1, CanIfHrhIdSymRef=IN_HwObj_SCM_BCAN_0xc03501_BCAN_VCU_01_10ms_1
          CanIfHrhCfg_IN_SCM_BCAN_0x7df_BCAN_GST_ALL: CanIfHrhCanCtrlIdRef=CanIfCtrlCfg_SCM_BCAN, CanIfHrhCanHandleTypeRef=IN_HwObj_SCM_BCAN_0x7df_BCAN_GST_ALL, CanIfHrhIdSymRef=IN_HwObj_SCM_BCAN_0x7df_BCAN_GST_ALL
          CanIfHrhCfg_IN_SCM_BCAN_0x724_BCAN_GST_RWPC: CanIfHrhCanCtrlIdRef=CanIfCtrlCfg_SCM_BCAN, CanIfHrhCanHandleTypeRef=IN_HwObj_SCM_BCAN_0x724_BCAN_GST_RWPC, CanIfHrhIdSymRef=IN_HwObj_SCM_BCAN_0x724_BCAN_GST_RWPC
          CanIfHrhCfg_IN_SCM_BCAN_0x4d8_BCAN_HU_GW_PE_01: CanIfHrhCanCtrlIdRef=CanIfCtrlCfg_SCM_BCAN, CanIfHrhCanHandleTypeRef=IN_HwObj_SCM_BCAN_0x4d8_BCAN_HU_GW_PE_01, CanIfHrhIdSymRef=IN_HwObj_SCM_BCAN_0x4d8_BCAN_HU_GW_PE_01
          CanIfHrhCfg_IN_SCM_BCAN_0x4ab_BCAN_HU_USM_E_04: CanIfHrhCanCtrlIdRef=CanIfCtrlCfg_SCM_BCAN, CanIfHrhCanHandleTypeRef=IN_HwObj_SCM_BCAN_0x4ab_BCAN_HU_USM_E_04, CanIfHrhIdSymRef=IN_HwObj_SCM_BCAN_0x4ab_BCAN_HU_USM_E_04
          CanIfHrhCfg_IN_SCM_BCAN_0x4a9_BCAN_HU_USM_E_02: CanIfHrhCanCtrlIdRef=CanIfCtrlCfg_SCM_BCAN, CanIfHrhCanHandleTypeRef=IN_HwObj_SCM_BCAN_0x4a9_BCAN_HU_USM_E_02, CanIfHrhIdSymRef=IN_HwObj_SCM_BCAN_0x4a9_BCAN_HU_USM_E_02
          CanIfHrhCfg_IN_SCM_BCAN_0x44b_BCAN_WPC_01_200ms: CanIfHrhCanCtrlIdRef=CanIfCtrlCfg_SCM_BCAN, CanIfHrhCanHandleTypeRef=IN_HwObj_SCM_BCAN_0x44b_BCAN_WPC_01_200ms, CanIfHrhIdSymRef=IN_HwObj_SCM_BCAN_0x44b_BCAN_WPC_01_200ms
          CanIfHrhCfg_IN_SCM_BCAN_0x447_BCAN_ATS_00_00ms: CanIfHrhCanCtrlIdRef=CanIfCtrlCfg_SCM_BCAN, CanIfHrhCanHandleTypeRef=IN_HwObj_SCM_BCAN_0x447_BCAN_ATS_00_00ms, CanIfHrhIdSymRef=IN_HwObj_SCM_BCAN_0x447_BCAN_ATS_00_00ms
          CanIfHrhCfg_IN_SCM_BCAN_0x445_BCAN_SMK_06_200ms: CanIfHrhCanCtrlIdRef=CanIfCtrlCfg_SCM_BCAN, CanIfHrhCanHandleTypeRef=IN_HwObj_SCM_BCAN_0x445_BCAN_SMK_06_200ms, CanIfHrhIdSymRef=IN_HwObj_SCM_BCAN_0x445_BCAN_SMK_06_200ms
          CanIfHrhCfg_IN_SCM_BCAN_0x442_BCAN_BCM_12_200ms: CanIfHrhCanCtrlIdRef=CanIfCtrlCfg_SCM_BCAN, CanIfHrhCanHandleTypeRef=IN_HwObj_SCM_BCAN_0x442_BCAN_BCM_12_200ms, CanIfHrhIdSymRef=IN_HwObj_SCM_BCAN_0x442_BCAN_BCM_12_200ms
          CanIfHrhCfg_IN_SCM_BCAN_0x434_BCAN_IAU_16_200ms: CanIfHrhCanCtrlIdRef=CanIfCtrlCfg_SCM_BCAN, CanIfHrhCanHandleTypeRef=IN_HwObj_SCM_BCAN_0x434_BCAN_IAU_16_200ms, CanIfHrhIdSymRef=IN_HwObj_SCM_BCAN_0x434_BCAN_IAU_16_200ms
          CanIfHrhCfg_IN_SCM_BCAN_0x41a_BCAN_BCM_07_200ms: CanIfHrhCanCtrlIdRef=CanIfCtrlCfg_SCM_BCAN, CanIfHrhCanHandleTypeRef=IN_HwObj_SCM_BCAN_0x41a_BCAN_BCM_07_200ms, CanIfHrhIdSymRef=IN_HwObj_SCM_BCAN_0x41a_BCAN_BCM_07_200ms
          CanIfHrhCfg_IN_SCM_BCAN_0x411_BCAN_ICU_02_200ms: CanIfHrhCanCtrlIdRef=CanIfCtrlCfg_SCM_BCAN, CanIfHrhCanHandleTypeRef=IN_HwObj_SCM_BCAN_0x411_BCAN_ICU_02_200ms, CanIfHrhIdSymRef=IN_HwObj_SCM_BCAN_0x411_BCAN_ICU_02_200ms
          CanIfHrhCfg_IN_SCM_BCAN_0x389_BCAN_SBCM_RR_01_200ms: CanIfHrhCanCtrlIdRef=CanIfCtrlCfg_SCM_BCAN, CanIfHrhCanHandleTypeRef=IN_HwObj_SCM_BCAN_0x389_BCAN_SBCM_RR_01_200ms, CanIfHrhIdSymRef=IN_HwObj_SCM_BCAN_0x389_BCAN_SBCM_RR_01_200ms
          CanIfHrhCfg_IN_SCM_BCAN_0x35e_BCAN_SBCM_RL_01_200ms: CanIfHrhCanCtrlIdRef=CanIfCtrlCfg_SCM_BCAN, CanIfHrhCanHandleTypeRef=IN_HwObj_SCM_BCAN_0x35e_BCAN_SBCM_RL_01_200ms, CanIfHrhIdSymRef=IN_HwObj_SCM_BCAN_0x35e_BCAN_SBCM_RL_01_200ms
          CanIfHrhCfg_IN_SCM_BCAN_0x35a_BCAN_SBCM_AST_02_200ms: CanIfHrhCanCtrlIdRef=CanIfCtrlCfg_SCM_BCAN, CanIfHrhCanHandleTypeRef=IN_HwObj_SCM_BCAN_0x35a_BCAN_SBCM_AST_02_200ms, CanIfHrhIdSymRef=IN_HwObj_SCM_BCAN_0x35a_BCAN_SBCM_AST_02_200ms
          CanIfHrhCfg_IN_SCM_BCAN_0x33e_BCAN_WPC2_01_200ms: CanIfHrhCanCtrlIdRef=CanIfCtrlCfg_SCM_BCAN, CanIfHrhCanHandleTypeRef=IN_HwObj_SCM_BCAN_0x33e_BCAN_WPC2_01_200ms, CanIfHrhIdSymRef=IN_HwObj_SCM_BCAN_0x33e_BCAN_WPC2_01_200ms
          CanIfHrhCfg_IN_SCM_BCAN_0x31f_BCAN_SBCM_DRV_01_200ms: CanIfHrhCanCtrlIdRef=CanIfCtrlCfg_SCM_BCAN, CanIfHrhCanHandleTypeRef=IN_HwObj_SCM_BCAN_0x31f_BCAN_SBCM_DRV_01_200ms, CanIfHrhIdSymRef=IN_HwObj_SCM_BCAN_0x31f_BCAN_SBCM_DRV_01_200ms
          CanIfHrhCfg_IN_SCM_BCAN_0x1eb_BCAN_HU_USM_E_14: CanIfHrhCanCtrlIdRef=CanIfCtrlCfg_SCM_BCAN, CanIfHrhCanHandleTypeRef=IN_HwObj_SCM_BCAN_0x1eb_BCAN_HU_USM_E_14, CanIfHrhIdSymRef=IN_HwObj_SCM_BCAN_0x1eb_BCAN_HU_USM_E_14
          CanIfHrhCfg_IN_0x400_0x47f_SCM_LOCALCAN_NM_Message: CanIfHrhCanCtrlIdRef=CanIfCtrlCfg_SCM_LOCALCAN, CanIfHrhCanHandleTypeRef=IN_HwObj_0x400_0x47f_SCM_LOCALCAN_NM_Message, CanIfHrhIdSymRef=IN_HwObj_0x400_0x47f_SCM_LOCALCAN_NM_Message
            CanIfHrhRangeCfg0 (CanIfHrhRangeCfg): category=TOOL_CONFIGURED, CanIfHrhRangeRxPduLowerCanId=1024, CanIfHrhRangeRxPduUpperCanId=1151, CanIfHrhRangeRxPduRangeCanIdType=STANDARD
          CanIfHrhCfg_IN_0x500_0x57f_SCM_BCAN_NM_Message: CanIfHrhCanCtrlIdRef=CanIfCtrlCfg_SCM_BCAN, CanIfHrhCanHandleTypeRef=IN_HwObj_0x500_0x57f_SCM_BCAN_NM_Message, CanIfHrhIdSymRef=IN_HwObj_0x500_0x57f_SCM_BCAN_NM_Message
            CanIfHrhRangeCfg0 (CanIfHrhRangeCfg): category=TOOL_CONFIGURED, CanIfHrhRangeRxPduLowerCanId=1280, CanIfHrhRangeRxPduUpperCanId=1407, CanIfHrhRangeRxPduRangeCanIdType=STANDARD
        6 x CanIfHthCfg, all with category=TOOL_CONFIGURED:
          CanIfHthCfg_OUT_SCM_LOCALCAN_0x10_LOCALCAN_WPC_01: CanIfHthCanCtrlIdRef=CanIfCtrlCfg_SCM_LOCALCAN, CanIfHthCanHandleTypeRef=OUT_HwObj_SCM_LOCALCAN_0x10_LOCALCAN_WPC_01, CanIfHthIdSymRef=OUT_HwObj_SCM_LOCALCAN_0x10_LOCALCAN_WPC_01
          CanIfHthCfg_OUT_SCM_LOCALCAN_0x110_LOCALCAN_WPC_10: CanIfHthCanCtrlIdRef=CanIfCtrlCfg_SCM_LOCALCAN, CanIfHthCanHandleTypeRef=OUT_HwObj_SCM_LOCALCAN_0x110_LOCALCAN_WPC_10, CanIfHthIdSymRef=OUT_HwObj_SCM_LOCALCAN_0x110_LOCALCAN_WPC_10
          CanIfHthCfg_OUT_SCM_LOCALCAN_0x41e_LOCALCAN_NM_WPC: CanIfHthCanCtrlIdRef=CanIfCtrlCfg_SCM_LOCALCAN, CanIfHthCanHandleTypeRef=OUT_HwObj_SCM_LOCALCAN_0x41e_LOCALCAN_NM_WPC, CanIfHthIdSymRef=OUT_HwObj_SCM_LOCALCAN_0x41e_LOCALCAN_NM_WPC
          CanIfHthCfg_OUT_SCM_BCAN_0x431_BCAN_RWPC_01_200ms: CanIfHthCanCtrlIdRef=CanIfCtrlCfg_SCM_BCAN, CanIfHthCanHandleTypeRef=OUT_HwObj_SCM_BCAN_0x431_BCAN_RWPC_01_200ms, CanIfHthIdSymRef=OUT_HwObj_SCM_BCAN_0x431_BCAN_RWPC_01_200ms
          CanIfHthCfg_OUT_SCM_BCAN_0x51f_BCAN_NM_RWPC: CanIfHthCanCtrlIdRef=CanIfCtrlCfg_SCM_BCAN, CanIfHthCanHandleTypeRef=OUT_HwObj_SCM_BCAN_0x51f_BCAN_NM_RWPC, CanIfHthIdSymRef=OUT_HwObj_SCM_BCAN_0x51f_BCAN_NM_RWPC
          CanIfHthCfg_OUT_SCM_BCAN_0x72c_BCAN_RWPC_GST: CanIfHthCanCtrlIdRef=CanIfCtrlCfg_SCM_BCAN, CanIfHthCanHandleTypeRef=OUT_HwObj_SCM_BCAN_0x72c_BCAN_RWPC_GST, CanIfHthIdSymRef=OUT_HwObj_SCM_BCAN_0x72c_BCAN_RWPC_GST
      CanIfBufferCfg_OUT_SCM_LOCALCAN_0x318_LOCALCAN_TP_WPC_C_BDC (CanIfBufferCfg): category=TOOL_CONFIGURED, CanIfBufferSize=0, CanIfBufferHthRef=CanIfHthCfg_OUT_SCM_LOCALCAN_0x318_LOCALCAN_TP_WPC_C_BDC
      29 x CanIfRxPduCfg, all with category=TOOL_CONFIGURED, CanIfRxPduDlc=8, CanIfPduReportIdsMEnable=0, CanIfRxPduReadData=0, CanIfRxPduReadNotifyStatus=0:
        CanIfRxPduCfg_IN_SCM_LOCALCAN_0x30a_LOCALCAN_TP_BDC_C_WPC: CanIfRxPduCanId=778, CanIfRxPduCanIdType=STANDARD_CAN, CanIfRxPduCanIdMask=2015, CanIfRxPduId=0, CanIfRxPduUserRxIndicationUL=CAN_TP, CanIfRxPduHrhIdRef=CanIfHrhCfg_IN_SCM_LOCALCAN_0x30a_LOCALCAN_TP_BDC_C_WPC, CanIfRxPduRef=Pdu_NPdu_LOCALCAN_TP_BDC_C_WPC
        CanIfRxPduCfg_IN_SCM_LOCALCAN_0x100_LOCALCAN_BDC_10: CanIfRxPduCanId=256, CanIfRxPduCanIdType=STANDARD_CAN, CanIfRxPduCanIdMask=2015, CanIfRxPduId=1, CanIfRxPduUserRxIndicationUL=PDUR, CanIfRxPduHrhIdRef=CanIfHrhCfg_IN_SCM_LOCALCAN_0x100_LOCALCAN_BDC_10, CanIfRxPduRef=Pdu_ISignalIPdu_LOCALCAN_BDC_10
        CanIfRxPduCfg_IN_SCM_LOCALCAN_0x11_LOCALCAN_BDC_01: CanIfRxPduCanId=17, CanIfRxPduCanIdType=STANDARD_CAN, CanIfRxPduCanIdMask=2015, CanIfRxPduId=2, CanIfRxPduUserRxIndicationUL=PDUR, CanIfRxPduHrhIdRef=CanIfHrhCfg_IN_SCM_LOCALCAN_0x11_LOCALCAN_BDC_01, CanIfRxPduRef=Pdu_ISignalIPdu_LOCALCAN_BDC_01
        CanIfRxPduCfg_IN_SCM_BCAN_0x681aa02_BCAN_CLU_01_20ms_2: CanIfRxPduCanId=109160962, CanIfRxPduCanIdType=EXTENDED_CAN, CanIfRxPduCanIdMask=536870911, CanIfRxPduId=3, CanIfRxPduUserRxIndicationUL=PDUR, CanIfRxPduHrhIdRef=CanIfHrhCfg_IN_SCM_BCAN_0x681aa02_BCAN_CLU_01_20ms_2, CanIfRxPduRef=Pdu_ISignalIPdu_BCAN_CLU_01_20ms_2
        CanIfRxPduCfg_IN_SCM_BCAN_0x681aa01_BCAN_CLU_01_20ms_1: CanIfRxPduCanId=109160961, CanIfRxPduCanIdType=EXTENDED_CAN, CanIfRxPduCanIdMask=536870911, CanIfRxPduId=4, CanIfRxPduUserRxIndicationUL=PDUR, CanIfRxPduHrhIdRef=CanIfHrhCfg_IN_SCM_BCAN_0x681aa01_BCAN_CLU_01_20ms_1, CanIfRxPduRef=Pdu_ISignalIPdu_BCAN_CLU_01_20ms_1
        CanIfRxPduCfg_IN_SCM_BCAN_0x4010502_BCAN_EMS_07_10ms_2: CanIfRxPduCanId=67175682, CanIfRxPduCanIdType=EXTENDED_CAN, CanIfRxPduCanIdMask=536870911, CanIfRxPduId=5, CanIfRxPduUserRxIndicationUL=PDUR, CanIfRxPduHrhIdRef=CanIfHrhCfg_IN_SCM_BCAN_0x4010502_BCAN_EMS_07_10ms_2, CanIfRxPduRef=Pdu_ISignalIPdu_BCAN_EMS_07_10ms_2
        CanIfRxPduCfg_IN_SCM_BCAN_0x4010001_BCAN_EMS_02_10ms_1: CanIfRxPduCanId=67174401, CanIfRxPduCanIdType=EXTENDED_CAN, CanIfRxPduCanIdMask=536870911, CanIfRxPduId=6, CanIfRxPduUserRxIndicationUL=PDUR, CanIfRxPduHrhIdRef=CanIfHrhCfg_IN_SCM_BCAN_0x4010001_BCAN_EMS_02_10ms_1, CanIfRxPduRef=Pdu_ISignalIPdu_BCAN_EMS_02_10ms_1
        CanIfRxPduCfg_IN_SCM_BCAN_0x3c0fa02_BCAN_HCU_03_10ms_2: CanIfRxPduCanId=62978562, CanIfRxPduCanIdType=EXTENDED_CAN, CanIfRxPduCanIdMask=536870911, CanIfRxPduId=7, CanIfRxPduUserRxIndicationUL=PDUR, CanIfRxPduHrhIdRef=CanIfHrhCfg_IN_SCM_BCAN_0x3c0fa02_BCAN_HCU_03_10ms_2, CanIfRxPduRef=Pdu_ISignalIPdu_BCAN_HCU_03_10ms_2
        CanIfRxPduCfg_IN_SCM_BCAN_0xc03501_BCAN_VCU_01_10ms_1: CanIfRxPduCanId=12596481, CanIfRxPduCanIdType=EXTENDED_CAN, CanIfRxPduCanIdMask=536870911, CanIfRxPduId=8, CanIfRxPduUserRxIndicationUL=PDUR, CanIfRxPduHrhIdRef=CanIfHrhCfg_IN_SCM_BCAN_0xc03501_BCAN_VCU_01_10ms_1, CanIfRxPduRef=Pdu_ISignalIPdu_BCAN_VCU_01_10ms_1
        CanIfRxPduCfg_IN_SCM_BCAN_0x7df_BCAN_GST_ALL: CanIfRxPduCanId=2015, CanIfRxPduCanIdType=STANDARD_CAN, CanIfRxPduCanIdMask=2015, CanIfRxPduId=9, CanIfRxPduUserRxIndicationUL=CAN_TP, CanIfRxPduHrhIdRef=CanIfHrhCfg_IN_SCM_BCAN_0x7df_BCAN_GST_ALL, CanIfRxPduRef=Pdu_NPdu_BCAN_GST_ALL
        CanIfRxPduCfg_IN_SCM_BCAN_0x724_BCAN_GST_RWPC: CanIfRxPduCanId=1828, CanIfRxPduCanIdType=STANDARD_CAN, CanIfRxPduCanIdMask=2015, CanIfRxPduId=10, CanIfRxPduUserRxIndicationUL=CAN_TP, CanIfRxPduHrhIdRef=CanIfHrhCfg_IN_SCM_BCAN_0x724_BCAN_GST_RWPC, CanIfRxPduRef=Pdu_NPdu_BCAN_GST_RWPC
        CanIfRxPduCfg_IN_SCM_BCAN_0x4d8_BCAN_HU_GW_PE_01: CanIfRxPduCanId=1240, CanIfRxPduCanIdType=STANDARD_CAN, CanIfRxPduCanIdMask=2015, CanIfRxPduId=11, CanIfRxPduUserRxIndicationUL=PDUR, CanIfRxPduHrhIdRef=CanIfHrhCfg_IN_SCM_BCAN_0x4d8_BCAN_HU_GW_PE_01, CanIfRxPduRef=Pdu_ISignalIPdu_BCAN_HU_GW_PE_01
        CanIfRxPduCfg_IN_SCM_BCAN_0x4ab_BCAN_HU_USM_E_04: CanIfRxPduCanId=1195, CanIfRxPduCanIdType=STANDARD_CAN, CanIfRxPduCanIdMask=2015, CanIfRxPduId=12, CanIfRxPduUserRxIndicationUL=PDUR, CanIfRxPduHrhIdRef=CanIfHrhCfg_IN_SCM_BCAN_0x4ab_BCAN_HU_USM_E_04, CanIfRxPduRef=Pdu_ISignalIPdu_BCAN_HU_USM_E_04
        CanIfRxPduCfg_IN_SCM_BCAN_0x4a9_BCAN_HU_USM_E_02: CanIfRxPduCanId=1193, CanIfRxPduCanIdType=STANDARD_CAN, CanIfRxPduCanIdMask=2015, CanIfRxPduId=13, CanIfRxPduUserRxIndicationUL=PDUR, CanIfRxPduHrhIdRef=CanIfHrhCfg_IN_SCM_BCAN_0x4a9_BCAN_HU_USM_E_02, CanIfRxPduRef=Pdu_ISignalIPdu_BCAN_HU_USM_E_02
        CanIfRxPduCfg_IN_SCM_BCAN_0x44b_BCAN_WPC_01_200ms: CanIfRxPduCanId=1099, CanIfRxPduCanIdType=STANDARD_CAN, CanIfRxPduCanIdMask=2015, CanIfRxPduId=14, CanIfRxPduUserRxIndicationUL=PDUR, CanIfRxPduHrhIdRef=CanIfHrhCfg_IN_SCM_BCAN_0x44b_BCAN_WPC_01_200ms, CanIfRxPduRef=Pdu_ISignalIPdu_BCAN_WPC_01_200ms
        CanIfRxPduCfg_IN_SCM_BCAN_0x447_BCAN_ATS_00_00ms: CanIfRxPduCanId=1095, CanIfRxPduCanIdType=STANDARD_CAN, CanIfRxPduCanIdMask=2015, CanIfRxPduId=15, CanIfRxPduUserRxIndicationUL=PDUR, CanIfRxPduHrhIdRef=CanIfHrhCfg_IN_SCM_BCAN_0x447_BCAN_ATS_00_00ms, CanIfRxPduRef=Pdu_ISignalIPdu_BCAN_ATS_00_00ms
        CanIfRxPduCfg_IN_SCM_BCAN_0x445_BCAN_SMK_06_200ms: CanIfRxPduCanId=1093, CanIfRxPduCanIdType=STANDARD_CAN, CanIfRxPduCanIdMask=2015, CanIfRxPduId=16, CanIfRxPduUserRxIndicationUL=PDUR, CanIfRxPduHrhIdRef=CanIfHrhCfg_IN_SCM_BCAN_0x445_BCAN_SMK_06_200ms, CanIfRxPduRef=Pdu_ISignalIPdu_BCAN_SMK_06_200ms
        CanIfRxPduCfg_IN_SCM_BCAN_0x442_BCAN_BCM_12_200ms: CanIfRxPduCanId=1090, CanIfRxPduCanIdType=STANDARD_CAN, CanIfRxPduCanIdMask=2015, CanIfRxPduId=17, CanIfRxPduUserRxIndicationUL=PDUR, CanIfRxPduHrhIdRef=CanIfHrhCfg_IN_SCM_BCAN_0x442_BCAN_BCM_12_200ms, CanIfRxPduRef=Pdu_ISignalIPdu_BCAN_BCM_12_200ms
        CanIfRxPduCfg_IN_SCM_BCAN_0x434_BCAN_IAU_16_200ms: CanIfRxPduCanId=1076, CanIfRxPduCanIdType=STANDARD_CAN, CanIfRxPduCanIdMask=2015, CanIfRxPduId=18, CanIfRxPduUserRxIndicationUL=PDUR, CanIfRxPduHrhIdRef=CanIfHrhCfg_IN_SCM_BCAN_0x434_BCAN_IAU_16_200ms, CanIfRxPduRef=Pdu_ISignalIPdu_BCAN_IAU_16_200ms
        CanIfRxPduCfg_IN_SCM_BCAN_0x41a_BCAN_BCM_07_200ms: CanIfRxPduCanId=1050, CanIfRxPduCanIdType=STANDARD_CAN, CanIfRxPduCanIdMask=2015, CanIfRxPduId=19, CanIfRxPduUserRxIndicationUL=PDUR, CanIfRxPduHrhIdRef=CanIfHrhCfg_IN_SCM_BCAN_0x41a_BCAN_BCM_07_200ms, CanIfRxPduRef=Pdu_ISignalIPdu_BCAN_BCM_07_200ms
        CanIfRxPduCfg_IN_SCM_BCAN_0x411_BCAN_ICU_02_200ms: CanIfRxPduCanId=1041, CanIfRxPduCanIdType=STANDARD_CAN, CanIfRxPduCanIdMask=2015, CanIfRxPduId=20, CanIfRxPduUserRxIndicationUL=PDUR, CanIfRxPduHrhIdRef=CanIfHrhCfg_IN_SCM_BCAN_0x411_BCAN_ICU_02_200ms, CanIfRxPduRef=Pdu_ISignalIPdu_BCAN_ICU_02_200ms
        CanIfRxPduCfg_IN_SCM_BCAN_0x389_BCAN_SBCM_RR_01_200ms: CanIfRxPduCanId=905, CanIfRxPduCanIdType=STANDARD_CAN, CanIfRxPduCanIdMask=2015, CanIfRxPduId=21, CanIfRxPduUserRxIndicationUL=PDUR, CanIfRxPduHrhIdRef=CanIfHrhCfg_IN_SCM_BCAN_0x389_BCAN_SBCM_RR_01_200ms, CanIfRxPduRef=Pdu_ISignalIPdu_BCAN_SBCM_RR_01_200ms
        CanIfRxPduCfg_IN_SCM_BCAN_0x35e_BCAN_SBCM_RL_01_200ms: CanIfRxPduCanId=862, CanIfRxPduCanIdType=STANDARD_CAN, CanIfRxPduCanIdMask=2015, CanIfRxPduId=22, CanIfRxPduUserRxIndicationUL=PDUR, CanIfRxPduHrhIdRef=CanIfHrhCfg_IN_SCM_BCAN_0x35e_BCAN_SBCM_RL_01_200ms, CanIfRxPduRef=Pdu_ISignalIPdu_BCAN_SBCM_RL_01_200ms
        CanIfRxPduCfg_IN_SCM_BCAN_0x35a_BCAN_SBCM_AST_02_200ms: CanIfRxPduCanId=858, CanIfRxPduCanIdType=STANDARD_CAN, CanIfRxPduCanIdMask=2015, CanIfRxPduId=23, CanIfRxPduUserRxIndicationUL=PDUR, CanIfRxPduHrhIdRef=CanIfHrhCfg_IN_SCM_BCAN_0x35a_BCAN_SBCM_AST_02_200ms, CanIfRxPduRef=Pdu_ISignalIPdu_BCAN_SBCM_AST_02_200ms
        CanIfRxPduCfg_IN_SCM_BCAN_0x33e_BCAN_WPC2_01_200ms: CanIfRxPduCanId=830, CanIfRxPduCanIdType=STANDARD_CAN, CanIfRxPduCanIdMask=2015, CanIfRxPduId=24, CanIfRxPduUserRxIndicationUL=PDUR, CanIfRxPduHrhIdRef=CanIfHrhCfg_IN_SCM_BCAN_0x33e_BCAN_WPC2_01_200ms, CanIfRxPduRef=Pdu_ISignalIPdu_BCAN_WPC2_01_200ms
        CanIfRxPduCfg_IN_SCM_BCAN_0x31f_BCAN_SBCM_DRV_01_200ms: CanIfRxPduCanId=799, CanIfRxPduCanIdType=STANDARD_CAN, CanIfRxPduCanIdMask=2015, CanIfRxPduId=25, CanIfRxPduUserRxIndicationUL=PDUR, CanIfRxPduHrhIdRef=CanIfHrhCfg_IN_SCM_BCAN_0x31f_BCAN_SBCM_DRV_01_200ms, CanIfRxPduRef=Pdu_ISignalIPdu_BCAN_SBCM_DRV_01_200ms
        CanIfRxPduCfg_IN_SCM_BCAN_0x1eb_BCAN_HU_USM_E_14: CanIfRxPduCanId=491, CanIfRxPduCanIdType=STANDARD_CAN, CanIfRxPduCanIdMask=2015, CanIfRxPduId=26, CanIfRxPduUserRxIndicationUL=PDUR, CanIfRxPduHrhIdRef=CanIfHrhCfg_IN_SCM_BCAN_0x1eb_BCAN_HU_USM_E_14, CanIfRxPduRef=Pdu_ISignalIPdu_BCAN_HU_USM_E_14
        CanIfRxPduCfg_IN_SCM_LOCALCAN_OSEKNM_MESSAGE: CanIfRxPduCanId=1141, CanIfRxPduCanIdType=STANDARD_CAN, CanIfRxPduCanIdMask=2015, CanIfRxPduId=27, CanIfRxPduUserRxIndicationUL=OSEK_NM, CanIfRxPduHrhIdRef=CanIfHrhCfg_IN_0x400_0x47f_SCM_LOCALCAN_NM_Message, CanIfRxPduRef=Pdu_UserDefinedPdu_LOCALCAN_NM_UWB_INT
          CanIfRxPduCanIdRange0 (CanIfRxPduCanIdRange): category=TOOL_CONFIGURED, CanIfRxPduCanIdRangeLowerCanId=1024, CanIfRxPduCanIdRangeUpperCanId=1151
        CanIfRxPduCfg_IN_SCM_BCAN_OSEKNM_MESSAGE: CanIfRxPduCanId=1392, CanIfRxPduCanIdType=STANDARD_CAN, CanIfRxPduCanIdMask=2015, CanIfRxPduId=28, CanIfRxPduUserRxIndicationUL=OSEK_NM, CanIfRxPduHrhIdRef=CanIfHrhCfg_IN_0x500_0x57f_SCM_BCAN_NM_Message, CanIfRxPduRef=Pdu_UserDefinedPdu_BCAN_NM_CGW_CCU
          CanIfRxPduCanIdRange0 (CanIfRxPduCanIdRange): category=TOOL_CONFIGURED, CanIfRxPduCanIdRangeLowerCanId=1280, CanIfRxPduCanIdRangeUpperCanId=1407
      6 x CanIfBufferCfg, all with category=TOOL_CONFIGURED, CanIfBufferSize=0:
        CanIfBufferCfg_OUT_SCM_LOCALCAN_0x10_LOCALCAN_WPC_01: CanIfBufferHthRef=CanIfHthCfg_OUT_SCM_LOCALCAN_0x10_LOCALCAN_WPC_01
        CanIfBufferCfg_OUT_SCM_LOCALCAN_0x110_LOCALCAN_WPC_10: CanIfBufferHthRef=CanIfHthCfg_OUT_SCM_LOCALCAN_0x110_LOCALCAN_WPC_10
        CanIfBufferCfg_OUT_SCM_LOCALCAN_0x41e_LOCALCAN_NM_WPC: CanIfBufferHthRef=CanIfHthCfg_OUT_SCM_LOCALCAN_0x41e_LOCALCAN_NM_WPC
        CanIfBufferCfg_OUT_SCM_BCAN_0x431_BCAN_RWPC_01_200ms: CanIfBufferHthRef=CanIfHthCfg_OUT_SCM_BCAN_0x431_BCAN_RWPC_01_200ms
        CanIfBufferCfg_OUT_SCM_BCAN_0x51f_BCAN_NM_RWPC: CanIfBufferHthRef=CanIfHthCfg_OUT_SCM_BCAN_0x51f_BCAN_NM_RWPC
        CanIfBufferCfg_OUT_SCM_BCAN_0x72c_BCAN_RWPC_GST: CanIfBufferHthRef=CanIfHthCfg_OUT_SCM_BCAN_0x72c_BCAN_RWPC_GST
      7 x CanIfTxPduCfg, all with category=TOOL_CONFIGURED, CanIfTxPduCanIdType=STANDARD_CAN, CanIfTxPduCanIdMask=2015, CanIfTxPduDlc=8, CanIfTxPduPnFilterPdu=0, CanIfTxPduReadNotifyStatus=0, CanIfTxPduType=STATIC:
        CanIfTxPduCfg_OUT_SCM_LOCALCAN_0x318_LOCALCAN_TP_WPC_C_BDC: CanIfTxPduCanId=792, CanIfTxPduId=0, CanIfTxPduUserTxConfirmationUL=CAN_TP, CanIfTxPduBufferRef=CanIfBufferCfg_OUT_SCM_LOCALCAN_0x318_LOCALCAN_TP_WPC_C_BDC, CanIfTxPduRef=Pdu_NPdu_LOCALCAN_TP_WPC_C_BDC
        CanIfTxPduCfg_OUT_SCM_LOCALCAN_0x10_LOCALCAN_WPC_01: CanIfTxPduCanId=16, CanIfTxPduId=1, CanIfTxPduUserTxConfirmationUL=PDUR, CanIfTxPduBufferRef=CanIfBufferCfg_OUT_SCM_LOCALCAN_0x10_LOCALCAN_WPC_01, CanIfTxPduRef=Pdu_ISignalIPdu_LOCALCAN_WPC_01
        CanIfTxPduCfg_OUT_SCM_LOCALCAN_0x110_LOCALCAN_WPC_10: CanIfTxPduCanId=272, CanIfTxPduId=2, CanIfTxPduUserTxConfirmationUL=PDUR, CanIfTxPduBufferRef=CanIfBufferCfg_OUT_SCM_LOCALCAN_0x110_LOCALCAN_WPC_10, CanIfTxPduRef=Pdu_ISignalIPdu_LOCALCAN_WPC_10
        CanIfTxPduCfg_OUT_SCM_LOCALCAN_0x41e_LOCALCAN_NM_WPC: CanIfTxPduCanId=1054, CanIfTxPduId=3, CanIfTxPduUserTxConfirmationUL=OSEK_NM, CanIfTxPduBufferRef=CanIfBufferCfg_OUT_SCM_LOCALCAN_0x41e_LOCALCAN_NM_WPC, CanIfTxPduRef=Pdu_UserDefinedPdu_LOCALCAN_NM_WPC
        CanIfTxPduCfg_OUT_SCM_BCAN_0x431_BCAN_RWPC_01_200ms: CanIfTxPduCanId=1073, CanIfTxPduId=4, CanIfTxPduUserTxConfirmationUL=PDUR, CanIfTxPduBufferRef=CanIfBufferCfg_OUT_SCM_BCAN_0x431_BCAN_RWPC_01_200ms, CanIfTxPduRef=Pdu_ISignalIPdu_BCAN_RWPC_01_200ms
        CanIfTxPduCfg_OUT_SCM_BCAN_0x51f_BCAN_NM_RWPC: CanIfTxPduCanId=1311, CanIfTxPduId=5, CanIfTxPduUserTxConfirmationUL=OSEK_NM, CanIfTxPduBufferRef=CanIfBufferCfg_OUT_SCM_BCAN_0x51f_BCAN_NM_RWPC, CanIfTxPduRef=Pdu_UserDefinedPdu_BCAN_NM_RWPC
        CanIfTxPduCfg_OUT_SCM_BCAN_0x72c_BCAN_RWPC_GST: CanIfTxPduCanId=1836, CanIfTxPduId=6, CanIfTxPduUserTxConfirmationUL=CAN_TP, CanIfTxPduBufferRef=CanIfBufferCfg_OUT_SCM_BCAN_0x72c_BCAN_RWPC_GST, CanIfTxPduRef=Pdu_NPdu_BCAN_RWPC_GST
    CanIfCtrlDrvCfg0 (CanIfCtrlDrvCfg): CanIfCtrlDrvTxCancellation=1, CanIfCtrlDrvNameRef=CanGeneral, CanIfCtrlDrvInitHohConfigRef=CanIfInitHohCfg0
      CanIfCtrlCfg_SCM_LOCALCAN (CanIfCtrlCfg): category=TOOL_CONFIGURED, CanIfCtrlId=0, CanIfCtrlWakeupSupport=0, CanIfCtrlCanCtrlRef=SCM_LOCALCAN
      CanIfCtrlCfg_SCM_BCAN (CanIfCtrlCfg): category=TOOL_CONFIGURED, CanIfCtrlId=1, CanIfCtrlWakeupSupport=0, CanIfCtrlCanCtrlRef=SCM_BCAN

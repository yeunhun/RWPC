AUTOSAR XML (schema 4-0-3)
package /AUTOSAR
  module config FiM: implementation-config-variant=VARIANT-PRE-COMPILE, module-description=BswImplementation_FiM
    FiMConfigSet_0 (FiMConfigSet)
      FiMEventSummary_0 (FiMEventSummary): FiMInputSumEventRef=DEM_E_TEST_EVENT1, FiMOutputSumEventRef=FiMSummaryEventId_0, FiMInputSumEventRef=DEM_E_TEST_EVENT2
      FiMSummaryEventId_0 (FiMSummaryEventId): FiMEventSumId=0
      FiMInhConf_FiMFID_0_TESTED (FiMInhibitionConfiguration): FiMInhInhibitionMask=FIM_TESTED, FiMInhFunctionIdRef=FiMFID_0
        FiMInhEventId0 (FiMInhEventId)
          FiMInhRefChoice0 (FiMInhRefChoice)
            FiMInhChoiceDemRef: FiMInhEventRef=DEM_E_TEST_EVENT3
      FiMInhConf_FiMFID_1_TESTED_AND_FAILED (FiMInhibitionConfiguration): FiMInhInhibitionMask=FIM_TESTED_AND_FAILED, FiMInhFunctionIdRef=FiMFID_1
        FiMInhEventId0 (FiMInhEventId)
          FiMInhRefChoice0 (FiMInhRefChoice)
            FiMInhChoiceSumRef: FiMInhSumRef=FiMSummaryEventId_0
      FiMFID_0 (FiMFID): FiMFunctionId=0
      FiMFID_1 (FiMFID): FiMFunctionId=1
    FiMGeneral_0 (FiMGeneral):
      FiMDataFixed = 0
      FiMDevErrorDetect = 1
      FiMEventUpdateTriggeredByDem = 1
      FiMMaxEventFidLinks = 255
      FiMMaxEventsPerFid = 5
      FiMMaxFidsPerEvent = 5
      FiMMaxSummaryEvents = 5
      FiMMaxSummaryLinks = 5
      FiMMaxTotalLinks = 10
      FiMTaskTime = 0.01
      FiMVersionInfoApi = 0

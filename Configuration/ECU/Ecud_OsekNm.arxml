AUTOSAR XML (schema 4-0-3)
package /AUTOSAR
  module config OsekNm: implementation-config-variant=VARIANT-PRE-COMPILE, module-description=BswImplementation_OsekNm
    OsekNmGlobalConfig:
      OsekNmDevErrorDetect = 1
      OsekNmVersionInfoApi = 0
      OsekNmComControlEnabled = 1
      OsekNmMainFunctionPeriod = 0.005
      OsekNmPassiveModeEnabled = 0
      OsekNmPduRxIndicationEnabled = 0
      OsekNmRemoteSleepIndEnabled = 0
      OsekNmStateChangeIndEnabled = 0
      OsekNmUserDataEnabled = 1
      OsekNmBusSynchronizationEnabled = 0
      OsekNmNumberOfChannels = 2
    OsekNmChannel_BCAN (OsekNmChannelConfig): OsekNmNodeId=31, OsekNmTimeoutMax=0.26, OsekNmTimeoutError=1, OsekNmTimeoutWaitSleep=1.5, OsekNmTimeoutTyp=0.1, OsekNmChannelIdRef=NmChannel_BCAN
      OsekNmRxPdu_IN_SCM_BCAN_OSEKNM_MESSAGE (OsekNmRxPdu): category=TOOL_CONFIGURED, OsekNmRxPduId=0, OsekNmRxPduRef=Pdu_UserDefinedPdu_BCAN_NM_CGW_CCU
      OsekNmTxPdu_OUT_SCM_BCAN_0x51f_BCAN_NM_RWPC (OsekNmTxPdu): category=TOOL_CONFIGURED, OsekNmTxPduId=0, OsekNmTxPduRef=Pdu_UserDefinedPdu_BCAN_NM_RWPC
    OsekNmChannel_LOCALCAN (OsekNmChannelConfig): OsekNmNodeId=30, OsekNmTimeoutMax=0.26, OsekNmTimeoutError=1, OsekNmTimeoutWaitSleep=1.5, OsekNmTimeoutTyp=0.1, OsekNmChannelIdRef=NmChannel_LOCALCAN
      OsekNmTxPdu_OUT_SCM_LOCALCAN_0x41e_LOCALCAN_NM_WPC (OsekNmTxPdu): category=TOOL_CONFIGURED, OsekNmTxPduId=1, OsekNmTxPduRef=Pdu_UserDefinedPdu_LOCALCAN_NM_WPC
      OsekNmRxPdu_IN_SCM_LOCALCAN_OSEKNM_MESSAGE (OsekNmRxPdu): category=TOOL_CONFIGURED, OsekNmRxPduId=1, OsekNmRxPduRef=Pdu_UserDefinedPdu_LOCALCAN_NM_UWB_INT

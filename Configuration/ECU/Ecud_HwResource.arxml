AUTOSAR XML (schema 4-0-3)
package /AUTOSAR
  module config HwResource: implementation-config-variant=VARIANT-PRE-COMPILE
    HwResourceGeneral: HwResourceMcuPackageType=CYT2B9XX/QFP64
      7 x HwResourceVendor:
        FREESCALE
          7 x HwResourceFamily:
            MPC5601X
              MPC5601D (HwResourceMcu)
                LQFP64 (HwResourcePackage)
                LQFP100 (HwResourcePackage)
            MPC5602X
              3 x HwResourceMcu:
                MPC5602B
                  3 x HwResourcePackage:
                    LQFP64
                    LQFP100
                    LQFP144
                MPC5602C
                  LQFP64 (HwResourcePackage)
                  LQFP100 (HwResourcePackage)
                MPC5602D
                  LQFP64 (HwResourcePackage)
                  LQFP100 (HwResourcePackage)
            MPC5603X
              MPC5603B (HwResourceMcu)
                3 x HwResourcePackage:
                  LQFP64
                  LQFP100
                  LQFP144
              MPC5603C (HwResourceMcu)
                LQFP64 (HwResourcePackage)
                LQFP100 (HwResourcePackage)
            MPC5604X
              MPC5604B (HwResourceMcu)
                4 x HwResourcePackage:
                  LQFP64
                  LQFP100
                  LQFP144
                  MAPBGA208
              MPC5604C (HwResourceMcu)
                LQFP64 (HwResourcePackage)
                LQFP100 (HwResourcePackage)
            MPC5605X
              MPC5605B (HwResourceMcu)
                3 x HwResourcePackage:
                  LQFP100
                  LQFP144
                  LQFP176
            MPC5606X
              MPC5606B (HwResourceMcu)
                3 x HwResourcePackage:
                  LQFP100
                  LQFP144
                  LQFP176
            MPC5607X
              MPC5607B (HwResourceMcu)
                LQFP176 (HwResourcePackage)
                MAPBGA208 (HwResourcePackage)
        INFINEON
          8 x HwResourceFamily:
            TC21X
              3 x HwResourceMcu:
                TC212L
                  TQFP80 (HwResourcePackage)
                TC213L
                  TQFP100 (HwResourcePackage)
                TC214L
                  TQFP144 (HwResourcePackage)
            TC22X
              3 x HwResourceMcu:
                TC222L
                  TQFP80 (HwResourcePackage)
                TC223L
                  TQFP100 (HwResourcePackage)
                TC224L
                  TQFP144 (HwResourcePackage)
            TC23X
              3 x HwResourceMcu:
                TC233L
                  TQFP100 (HwResourcePackage)
                TC234L
                  TQFP144 (HwResourcePackage)
                TC237L
                  LFBGA292 (HwResourcePackage)
            TC26X
              3 x HwResourceMcu:
                TC264D
                  LQFP144 (HwResourcePackage)
                TC265D
                  LQFP176 (HwResourcePackage)
                TC267D
                  LFBGA292 (HwResourcePackage)
            TC27X
              TC275T (HwResourceMcu)
                LQFP176 (HwResourcePackage)
              TC277T (HwResourceMcu)
                LFBGA292 (HwResourcePackage)
            TC29X
              3 x HwResourceMcu:
                TC297T
                  LFBGA292 (HwResourcePackage)
                TC298T
                  BGA416 (HwResourcePackage)
                TC299T
                  LFBGA516 (HwResourcePackage)
            TC38X
              TC387x (HwResourceMcu)
                LFBGA292 (HwResourcePackage)
              TC389x (HwResourceMcu)
                LFBGA516 (HwResourcePackage)
            TC39X
              3 x HwResourceMcu:
                TC397x
                  LFBGA292 (HwResourcePackage)
                TC397x_ADAS
                  LFBGA292 (HwResourcePackage)
                TC399x
                  LFBGA516 (HwResourcePackage)
        RENESAS
          RH850F1X (HwResourceFamily)
            4 x HwResourceMcu:
              RH850F1H
                3 x HwResourcePackage:
                  LQFP176
                  FPBGA233
                  FPBGA272
              RH850F1L
                6 x HwResourcePackage:
                  LQFP48
                  LQFP64
                  LQFP80
                  LQFP100
                  LQFP144
                  LQFP176
              RH850F1K
                6 x HwResourcePackage:
                  LQFP48
                  LQFP64
                  LQFP80
                  LQFP100
                  LQFP144
                  LQFP176
              RH850F1KM
                5 x HwResourcePackage:
                  LQFP100
                  LQFP144
                  LQFP176
                  FPBGA233
                  FPBGA272
        CYPRESS
          4 x HwResourceFamily:
            S6J32XX
              S6J320A (HwResourceMcu)
                TEQFP208 (HwResourcePackage)
                TEQFP216 (HwResourcePackage)
              S6J320C (HwResourceMcu)
                3 x HwResourcePackage:
                  TEQFP208
                  TEQFP216
                  TEQFP256
            S6J33XX
              S6J331E (HwResourceMcu)
                3 x HwResourcePackage:
                  TEQFP144
                  TEQFP176
                  TEQFP208
            CYT2BXX
              3 x HwResourceMcu:
                CYT2B7XX
                  6 x HwResourcePackage:
                    QFP48
                    QFP64
                    QFP80
                    QFP100
                    QFP144
                    QFP176
                CYT2B9XX
                  6 x HwResourcePackage:
                    QFP48
                    QFP64
                    QFP80
                    QFP100
                    QFP144
                    QFP176
                CYT2BLXX
                  6 x HwResourcePackage:
                    QFP48
                    QFP64
                    QFP80
                    QFP100
                    QFP144
                    QFP176
            CYT4BXX
              CYT4BBXX (HwResourceMcu)
                4 x HwResourcePackage:
                  QFP100
                  QFP144
                  QFP176
                  BGA272
              CYT4BFXX (HwResourceMcu)
                3 x HwResourcePackage:
                  QFP176
                  BGA272
                  BGA320
        ST
          3 x HwResourceFamily:
            SPC58XB
              SPC584B (HwResourceMcu)
                4 x HwResourcePackage:
                  eTQFP64
                  eTQFP100
                  eTQFP144
                  eLQFP176
            SPC58XC
              SPC584C (HwResourceMcu)
                5 x HwResourcePackage:
                  eTQFP64
                  eTQFP100
                  eTQFP144
                  eLQFP176
                  BGA292
              SPC58EC (HwResourceMcu)
                5 x HwResourcePackage:
                  eTQFP64
                  eTQFP100
                  eTQFP144
                  eLQFP176
                  BGA292
            SPC58XG
              3 x HwResourceMcu:
                SPC584G
                  3 x HwResourcePackage:
                    eTQFP144
                    eLQFP176
                    BGA292
                SPC58EG
                  3 x HwResourcePackage:
                    eTQFP144
                    eLQFP176
                    BGA292
                SPC58NG
                  3 x HwResourcePackage:
                    eTQFP144
                    eLQFP176
                    BGA292
        NXP
          3 x HwResourceFamily:
            S32K11x
              S32K116 (HwResourceMcu)
                QFN32 (HwResourcePackage)
                LQFP48 (HwResourcePackage)
              S32K118 (HwResourceMcu)
                LQFP48 (HwResourcePackage)
                LQFP64 (HwResourcePackage)
            S32K14x
              4 x HwResourceMcu:
                S32K142
                  LQFP64 (HwResourcePackage)
                  LQFP100 (HwResourcePackage)
                S32K144
                  3 x HwResourcePackage:
                    LQFP64
                    LQFP100
                    MAPBGA100
                S32K146
                  4 x HwResourcePackage:
                    LQFP64
                    LQFP100
                    LQFP144
                    MAPBGA100
                S32K148
                  3 x HwResourcePackage:
                    LQFP144
                    LQFP176
                    MAPBGA100
            S32G2x
              S32G274A (HwResourceMcu)
                BGA525 (HwResourcePackage)
        TI
          TDA4XX (HwResourceFamily)
            TDA4VM (HwResourceMcu)
              FCBGA827 (HwResourcePackage)
    5 x FeatureDefinition, all with HwResourceFeatureValue=STD_ON:
      SWP_USE_RAMTST
      SWP_USE_ROMTST
      SWP_USE_IOHWAB
      SWP_USE_NVM
      SWP_USE_DATALOG

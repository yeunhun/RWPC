AUTOSAR XML (schema 4-0-3)
package /AUTOSAR
  module config Nm: implementation-config-variant=VARIANT-PRE-COMPILE, module-description=BswImplementation_Nm
    NmGlobalConfig
      NmGlobalConstants: category=TOOL_CONFIGURED, NmNumberOfChannels=2
      NmGlobalFeatures:
        category = TOOL_CONFIGURED
        NmBusSynchronizationEnabled = 0
        NmCarWakeUpRxEnabled = 0
        NmComControlEnabled = 1
        NmComUserDataSupport = 1
        NmCoordinatorSupportEnabled = 0
        NmNodeDetectionEnabled = 1
        NmNodeIdEnabled = 1
        NmPduRxIndicationEnabled = 0
        NmRemoteSleepIndEnabled = 0
        NmRepeatMsgIndEnabled = 0
        NmStateChangeIndEnabled = 1
        NmUserDataEnabled = 1
        NmCoordinatorSyncSupport = 0
      NmGlobalProperties: category=TOOL_CONFIGURED, NmCycletimeMainFunction=0.01, NmDevErrorDetect=1, NmVersionInfoApi=0
    NmChannel_BCAN (NmChannelConfig):
      NmActiveCoordinator = 0
      NmChannelSleepMaster = 0
      NmPassiveModeEnabled = 0
      NmShutdownDelayTimer = 0
      NmStateReportEnabled = 0
      NmSynchronizingNetwork = 0
      NmChannelId = 0
      NmComMChannelRef = ComMChannel_BCAN
      NmBusType: category=TOOL_CONFIGURED
        NmGenericBusNmConfig: category=TOOL_CONFIGURED, NmGenericBusNmPrefix=OsekNm
    NmChannel_LOCALCAN (NmChannelConfig):
      NmActiveCoordinator = 0
      NmChannelSleepMaster = 0
      NmPassiveModeEnabled = 0
      NmShutdownDelayTimer = 0
      NmStateReportEnabled = 0
      NmSynchronizingNetwork = 0
      NmChannelId = 1
      NmComMChannelRef = ComMChannel_LOCALCAN
      NmBusType: category=TOOL_CONFIGURED
        NmGenericBusNmConfig: category=TOOL_CONFIGURED, NmGenericBusNmPrefix=OsekNm

AUTOSAR XML (schema 4-1-2)
package /EcucValueCollection
  ecuc value collection EcucValueCollection: category=MANAGED_ECUC_MODULES, ecu-extract=EcuExtract
    ecuc-values:
      Wdg_76_Acw
      Mcu
      CanIf
      Det
      Nm
      WdgIf
      Com
      Crc
      WdgM
      Rte
      Wdg
      Dem
      NvM
      Os
      Can
      CanSM
      HwResource
      EcuM
      BswM
      CanCM
      CanTp
      ComM
      Dio
      OsProfiler
      Resource
      Dcm
      Fee
      RomTst
      Ocu
      Fbl
      OsekNm
      FiM
      CryptoLib
      Csm
      CanTrcv_255_Autron
      MemIf
      IoHwAb
      OsImp
      Pwm
      Icu
      Gpt
      Port
      RamTst
      Fls
      EcuC
      PduR
      Spi
      Adc

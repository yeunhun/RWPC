AUTOSAR XML (schema 4-0-3)
package /AUTOSAR
  module config Csm: implementation-config-variant=VARIANT-PRE-COMPILE, module-description=BswImplementation_Csm
    CsmGeneral:
      CsmDevErrorDetect = 1
      CsmMaxAlignScalarType = uint8
      CsmMaximumBlockingTime = 1
      CsmUseInterruption = 0
      CsmUseSyncJobProcessing = 0
      CsmVersionInfoApi = 0
      CsmMainFunctionPeriod = 0.01
      CsmUseCommonFblCryptoLib = 0
      CsmSeedRefAddr = 0x40390008
    CsmHash: CsmHashMaxResultBufferSize=8, CsmHashMaxDataBufferSize=8
      3 x CsmHashConfig, all with CsmHashInitConfiguration=NULL_PTR, CsmHashUsePort=1, CsmHashUseExternalTask=0:
        HaeAdvSeedKey_L9: CsmHashPrimitiveName=HaeAdvSeedKey
        HaeSha1: CsmHashPrimitiveName=HaeSha1
        HaeSha256: CsmHashPrimitiveName=HaeSha256
    CsmMacGenerate: CsmMacGenerateMaxKeySize=1, CsmMacGenerateMaxResultBufferSize=32, CsmMacGenerateMaxDataBufferSize=1
      HaeHmacSha256Generate (CsmMacGenerateConfig):
        CsmMacGenerateInitConfiguration = NULL_PTR
        CsmMacGeneratePrimitiveName = HaeHmacSha256Generate
        CsmMacGenerateUsePort = 1
        CsmMacGenerateUseExternalTask = 0
    CsmMacVerify: CsmMacVerifyMaxKeySize=1, CsmMacVerifyMaxCompareBufferSize=32, CsmMacVerifyMaxDataBufferSize=1
      HaeHmacSha256Verify (CsmMacVerifyConfig): CsmMacVerifyInitConfiguration=NULL_PTR, CsmMacVerifyPrimitiveName=HaeHmacSha256Verify, CsmMacVerifyUsePort=1, CsmMacVerifyUseExternalTask=0
    CsmRandomGenerate: CsmRandomGenerateMaxResultBufferSize=8
      3 x CsmRandomGenerateConfig, all with CsmRandomGenerateInitConfiguration=NULL_PTR, CsmRandomGenerateUseExternalTask=0, CsmRandomGenerateUsePort=1:
        HaeHsmPseudoRandomGenerate_L9: CsmRandomGeneratePrimitiveName=HaeHsmPseudoRandomGenerate
        HaePseudoRandomGenerate_L9: CsmRandomGeneratePrimitiveName=HaePseudoRandomGenerate
        HaePseudoRandomGenerate: CsmRandomGeneratePrimitiveName=HaePseudoRandomGenerate
    CsmRandomSeed: CsmRandomSeedMaxDataBufferSize=16
      HaePseudoRandomSeed_L9 (CsmRandomSeedConfig): CsmRandomSeedInitConfiguration=NULL_PTR, CsmRandomSeedPrimitiveName=HaePseudoRandomSeed, CsmRandomSeedUsePort=1, CsmRandomSeedUseExternalTask=0
      HaePseudoRandomSeed (CsmRandomSeedConfig): CsmRandomSeedInitConfiguration=NULL_PTR, CsmRandomSeedPrimitiveName=HaePseudoRandomSeed, CsmRandomSeedUsePort=1, CsmRandomSeedUseExternalTask=0
    CsmSignatureGenerate: CsmSignatureGenerateMaxKeySize=512, CsmSignatureGenerateMaxDataBufferSize=1, CsmSignatureGenerateMaxResultBufferSize=256
      HaePkcs1V15Sha256Generate (CsmSignatureGenerateConfig):
        CsmSignatureGenerateInitConfiguration = NULL_PTR
        CsmSignatureGeneratePrimitiveName = HaePkcs1V15Sha256Generate
        CsmSignatureGenerateUseExternalTask = 0
        CsmSignatureGenerateUsePort = 1
    CsmSymBlockDecrypt: CsmSymBlockDecryptMaxKeySize=16, CsmSymBlockDecryptMaxResultBufferSize=1, CsmSymBlockDecryptMaxDataBufferSize=1
      HaeAesEcbDecrypt (CsmSymBlockDecryptConfig):
        CsmSymBlockDecryptInitConfiguration = NULL_PTR
        CsmSymBlockDecryptPrimitiveName = HaeAesEcbDecrypt
        CsmSymBlockDecryptUsePort = 1
        CsmSymBlockDecryptUseExternalTask = 0
    CsmSymBlockEncrypt: CsmSymBlockEncryptMaxKeySize=16, CsmSymBlockEncryptMaxResultBufferSize=1, CsmSymBlockEncryptMaxDataBufferSize=1
      HaeAesEcbEncrypt (CsmSymBlockEncryptConfig):
        CsmSymBlockEncryptInitConfiguration = NULL_PTR
        CsmSymBlockEncryptPrimitiveName = HaeAesEcbEncrypt
        CsmSymBlockEncryptUsePort = 1
        CsmSymBlockEncryptUseExternalTask = 0
    CsmSymDecrypt: CsmSymDecryptMaxKeySize=16, CsmSymDecryptMaxInitVectorBufferSize=16, CsmSymDecryptMaxResultBufferSize=1, CsmSymDecryptMaxDataBufferSize=1
      HaeAesCbcDecrypt (CsmSymDecryptConfig): CsmSymDecryptInitConfiguration=NULL_PTR, CsmSymDecryptPrimitiveName=HaeAesCbcDecrypt, CsmSymDecryptUsePort=1, CsmSymDecryptUseExternalTask=0
      HaeAesCtrDecrypt (CsmSymDecryptConfig): CsmSymDecryptInitConfiguration=NULL_PTR, CsmSymDecryptPrimitiveName=HaeAesCtrDecrypt, CsmSymDecryptUsePort=1, CsmSymDecryptUseExternalTask=0
    CsmSymEncrypt: CsmSymEncryptMaxKeySize=16, CsmSymEncryptMaxInitVectorBufferSize=16, CsmSymEncryptMaxResultBufferSize=1, CsmSymEncryptMaxDataBufferSize=1
      HaeAesCbcEncrypt (CsmSymEncryptConfig): CsmSymEncryptInitConfiguration=NULL_PTR, CsmSymEncryptPrimitiveName=HaeAesCbcEncrypt, CsmSymEncryptUsePort=1, CsmSymEncryptUseExternalTask=0
      HaeAesCtrEncrypt (CsmSymEncryptConfig): CsmSymEncryptInitConfiguration=NULL_PTR, CsmSymEncryptPrimitiveName=HaeAesCtrEncrypt, CsmSymEncryptUsePort=1, CsmSymEncryptUseExternalTask=0

AUTOSAR XML (schema 4-0-3)
package /AUTOSAR
  module config Dcm: implementation-config-variant=VARIANT-PRE-COMPILE, module-description=BswImplementation_Dcm
    DcmConfigSet
      DcmDsd
        ES95486_SERVICE (DcmDsdServiceTable): DcmDsdSidTabId=0
          18 x DcmDsdService:
            SID10_DiagnosticSessionControl: DcmDsdSidTabServiceId=0x10, DcmDsdSidTabSubfuncAvail=1, DcmDsdSidTabSessionLevelRef=DCM_ALL_SESSION_LEVEL
              5 x DcmDsdSubService:
                defaultSession: DcmDsdSubServiceId=0x01
                programmingSession: DcmDsdSubServiceId=0x02, DcmDsdSubServiceSessionLevelRef=DCM_DEFAULT_SESSION, DcmDsdSubServiceSessionLevelRef=DCM_PROGRAMMING_SESSION, DcmDsdSubServiceSessionLevelRef=DCM_EXTENDED_DIAGNOSTIC_SESSION, DcmDsdSubServiceSessionLevelRef=DCM_ECU_PROGRAMMING_MODE, DcmDsdSubServiceSessionLevelRef=DCM_EXTENDED_DIAGNOSTIC_MODE
                extendedDiagnosticSession: DcmDsdSubServiceId=0x03, DcmDsdSubServiceSessionLevelRef=DCM_DEFAULT_SESSION, DcmDsdSubServiceSessionLevelRef=DCM_EXTENDED_DIAGNOSTIC_MODE, DcmDsdSubServiceSessionLevelRef=DCM_EXTENDED_DIAGNOSTIC_SESSION, DcmDsdSubServiceSessionLevelRef=DCM_SAFETY_SYSTEM_DIAGNOSTIC_SESSION
                quiescent_current_diagnostic_mode: DcmDsdSubServiceId=0x50, DcmDsdSubServiceSessionLevelRef=DCM_DEFAULT_SESSION, DcmDsdSubServiceSessionLevelRef=DCM_QUIESCENT_CURRENT_DIAGNOSTIC_MODE
                sleep_mode_start_request: DcmDsdSubServiceId=0x51
            SID11_ECUReset: DcmDsdSidTabServiceId=0x11, DcmDsdSidTabSubfuncAvail=1, DcmDsdSidTabSessionLevelRef=DCM_DEFAULT_SESSION, DcmDsdSidTabSessionLevelRef=DCM_PROGRAMMING_SESSION, DcmDsdSidTabSessionLevelRef=DCM_ECU_PROGRAMMING_MODE, DcmDsdSidTabSessionLevelRef=DCM_EXTENDED_DIAGNOSTIC_MODE, DcmDsdSidTabSessionLevelRef=DCM_EXTENDED_DIAGNOSTIC_SESSION, DcmDsdSidTabSessionLevelRef=DCM_SAFETY_SYSTEM_DIAGNOSTIC_SESSION
              hardReset (DcmDsdSubService): DcmDsdSubServiceId=0x01
            SID27_SecurityAccess: DcmDsdSidTabServiceId=0x27, DcmDsdSidTabSubfuncAvail=1, DcmDsdSidTabSessionLevelRef=DCM_PROGRAMMING_SESSION, DcmDsdSidTabSessionLevelRef=DCM_ECU_PROGRAMMING_MODE, DcmDsdSidTabSessionLevelRef=DCM_EXTENDED_DIAGNOSTIC_MODE, DcmDsdSidTabSessionLevelRef=DCM_EXTENDED_DIAGNOSTIC_SESSION, DcmDsdSidTabSessionLevelRef=DCM_SAFETY_SYSTEM_DIAGNOSTIC_SESSION
              GetSeed_HSAC (DcmDsdSubService): DcmDsdSubServiceId=0x11
              CompareKey_HSAC (DcmDsdSubService): DcmDsdSubServiceId=0x12
            SID28_CommunicationControl: DcmDsdSidTabServiceId=0x28, DcmDsdSidTabSubfuncAvail=1, DcmDsdSidTabSessionLevelRef=DCM_PROGRAMMING_SESSION, DcmDsdSidTabSessionLevelRef=DCM_ECU_PROGRAMMING_MODE, DcmDsdSidTabSessionLevelRef=DCM_EXTENDED_DIAGNOSTIC_MODE, DcmDsdSidTabSessionLevelRef=DCM_EXTENDED_DIAGNOSTIC_SESSION
              4 x DcmDsdSubService:
                enableRxAndTx: DcmDsdSubServiceId=0
                disableNormalMessageTransmission: DcmDsdSubServiceId=1
                disableRxAndEnableTx: DcmDsdSubServiceId=2
                disableRxAndTx: DcmDsdSubServiceId=3
            SID3E_TesterPresent: DcmDsdSidTabServiceId=0x3E, DcmDsdSidTabSubfuncAvail=1, DcmDsdSidTabSessionLevelRef=DCM_DEFAULT_SESSION, DcmDsdSidTabSessionLevelRef=DCM_PROGRAMMING_SESSION, DcmDsdSidTabSessionLevelRef=DCM_ECU_PROGRAMMING_MODE, DcmDsdSidTabSessionLevelRef=DCM_EXTENDED_DIAGNOSTIC_MODE, DcmDsdSidTabSessionLevelRef=DCM_EXTENDED_DIAGNOSTIC_SESSION, DcmDsdSidTabSessionLevelRef=DCM_SAFETY_SYSTEM_DIAGNOSTIC_SESSION
              zeroSubFunction (DcmDsdSubService): DcmDsdSubServiceId=0x0
            SID85_ControlDTCSetting: DcmDsdSidTabServiceId=0x85, DcmDsdSidTabSubfuncAvail=1, DcmDsdSidTabSessionLevelRef=DCM_PROGRAMMING_SESSION, DcmDsdSidTabSessionLevelRef=DCM_ECU_PROGRAMMING_MODE, DcmDsdSidTabSessionLevelRef=DCM_EXTENDED_DIAGNOSTIC_SESSION, DcmDsdSidTabSessionLevelRef=DCM_EXTENDED_DIAGNOSTIC_MODE
              On (DcmDsdSubService): DcmDsdSubServiceId=0x01
              Off (DcmDsdSubService): DcmDsdSubServiceId=0x02
            SID20_StopDiagnosticSession: DcmDsdSidTabServiceId=0x20, DcmDsdSidTabSubfuncAvail=0, DcmDsdSidTabSessionLevelRef=DCM_DEFAULT_SESSION, DcmDsdSidTabSessionLevelRef=DCM_PROGRAMMING_SESSION, DcmDsdSidTabSessionLevelRef=DCM_ECU_PROGRAMMING_MODE, DcmDsdSidTabSessionLevelRef=DCM_EXTENDED_DIAGNOSTIC_SESSION, DcmDsdSidTabSessionLevelRef=DCM_EXTENDED_DIAGNOSTIC_MODE
            SID22_ReadDataByIdentifier: DcmDsdSidTabServiceId=0x22, DcmDsdSidTabSubfuncAvail=0, DcmDsdSidTabSessionLevelRef=DCM_DEFAULT_SESSION, DcmDsdSidTabSessionLevelRef=DCM_EXTENDED_DIAGNOSTIC_MODE, DcmDsdSidTabSessionLevelRef=DCM_EXTENDED_DIAGNOSTIC_SESSION, DcmDsdSidTabSessionLevelRef=DCM_SAFETY_SYSTEM_DIAGNOSTIC_SESSION, DcmDsdSidTabSessionLevelRef=DCM_QUIESCENT_CURRENT_DIAGNOSTIC_MODE
            SID23_ReadMemoryByAddress: DcmDsdSidTabServiceId=0x23, DcmDsdSidTabSubfuncAvail=0, DcmDsdSidTabSessionLevelRef=DCM_DEFAULT_SESSION, DcmDsdSidTabSessionLevelRef=DCM_EXTENDED_DIAGNOSTIC_SESSION, DcmDsdSidTabSessionLevelRef=DCM_EXTENDED_DIAGNOSTIC_MODE
            SID2E_WriteDataByIdentifier: DcmDsdSidTabServiceId=0x2E, DcmDsdSidTabSubfuncAvail=0, DcmDsdSidTabSecurityLevelRef=L9, DcmDsdSidTabSessionLevelRef=DCM_DEFAULT_SESSION, DcmDsdSidTabSessionLevelRef=DCM_PROGRAMMING_SESSION, DcmDsdSidTabSessionLevelRef=DCM_ECU_PROGRAMMING_MODE, DcmDsdSidTabSessionLevelRef=DCM_EXTENDED_DIAGNOSTIC_MODE, DcmDsdSidTabSessionLevelRef=DCM_EXTENDED_DIAGNOSTIC_SESSION, DcmDsdSidTabSessionLevelRef=DCM_SAFETY_SYSTEM_DIAGNOSTIC_SESSION
            SID3D_WriteMemoryByAddress: DcmDsdSidTabServiceId=0x3D, DcmDsdSidTabSubfuncAvail=0, DcmDsdSidTabSecurityLevelRef=L9, DcmDsdSidTabSessionLevelRef=DCM_DEFAULT_SESSION, DcmDsdSidTabSessionLevelRef=DCM_PROGRAMMING_SESSION, DcmDsdSidTabSessionLevelRef=DCM_ECU_PROGRAMMING_MODE, DcmDsdSidTabSessionLevelRef=DCM_EXTENDED_DIAGNOSTIC_MODE, DcmDsdSidTabSessionLevelRef=DCM_EXTENDED_DIAGNOSTIC_SESSION
            SID19_ReadDTCInformation: DcmDsdSidTabServiceId=0x19, DcmDsdSidTabSubfuncAvail=1, DcmDsdSidTabFnc=Dcm_ReadDTCInformation, DcmDsdSidTabSessionLevelRef=DCM_DEFAULT_SESSION, DcmDsdSidTabSessionLevelRef=DCM_EXTENDED_DIAGNOSTIC_SESSION, DcmDsdSidTabSessionLevelRef=DCM_EXTENDED_DIAGNOSTIC_MODE
              reportNumberOfDTCByStatusMask (DcmDsdSubService): DcmDsdSubServiceId=0x01
              reportDTCByStatusMask (DcmDsdSubService): DcmDsdSubServiceId=0x02
            SID14_ClearDiagnosticInformation: DcmDsdSidTabServiceId=0x14, DcmDsdSidTabSubfuncAvail=0, DcmDsdSidTabFnc=Dcm_ClearDiagnosticInformation, DcmDsdSidTabSessionLevelRef=DCM_DEFAULT_SESSION, DcmDsdSidTabSessionLevelRef=DCM_EXTENDED_DIAGNOSTIC_SESSION, DcmDsdSidTabSessionLevelRef=DCM_EXTENDED_DIAGNOSTIC_MODE
            SID2F_InputOutputControlByIdentifier: DcmDsdSidTabServiceId=0x2F, DcmDsdSidTabSubfuncAvail=0, DcmDsdSidTabFnc=Dcm_InputOutputControlByIdentifier, DcmDsdSidTabSessionLevelRef=DCM_EXTENDED_DIAGNOSTIC_MODE, DcmDsdSidTabSessionLevelRef=DCM_EXTENDED_DIAGNOSTIC_SESSION
            SID31_RoutineControl: DcmDsdSidTabServiceId=0x31, DcmDsdSidTabSubfuncAvail=1, DcmDsdSidTabSessionLevelRef=DCM_DEFAULT_SESSION, DcmDsdSidTabSessionLevelRef=DCM_PROGRAMMING_SESSION, DcmDsdSidTabSessionLevelRef=DCM_ECU_PROGRAMMING_MODE, DcmDsdSidTabSessionLevelRef=DCM_EXTENDED_DIAGNOSTIC_MODE, DcmDsdSidTabSessionLevelRef=DCM_EXTENDED_DIAGNOSTIC_SESSION, DcmDsdSidTabSessionLevelRef=DCM_SAFETY_SYSTEM_DIAGNOSTIC_SESSION
              3 x DcmDsdSubService:
                startRoutine: DcmDsdSubServiceId=0x01
                stopRoutine: DcmDsdSubServiceId=0x02
                requestRoutineResults: DcmDsdSubServiceId=0x03
            SID34_RequestDownload: DcmDsdSidTabServiceId=0x34, DcmDsdSidTabSubfuncAvail=0, DcmDsdSidTabSecurityLevelRef=L9, DcmDsdSidTabSessionLevelRef=DCM_EXTENDED_DIAGNOSTIC_SESSION, DcmDsdSidTabSessionLevelRef=DCM_PROGRAMMING_SESSION
            SID36_TransferData: DcmDsdSidTabSubfuncAvail=0, DcmDsdSidTabServiceId=0x36, DcmDsdSidTabSecurityLevelRef=L9, DcmDsdSidTabSessionLevelRef=DCM_EXTENDED_DIAGNOSTIC_SESSION, DcmDsdSidTabSessionLevelRef=DCM_PROGRAMMING_SESSION
            SID37_RequestTransferExit: DcmDsdSidTabSubfuncAvail=0, DcmDsdSidTabServiceId=0x37, DcmDsdSidTabSecurityLevelRef=L9, DcmDsdSidTabSessionLevelRef=DCM_EXTENDED_DIAGNOSTIC_SESSION, DcmDsdSidTabSessionLevelRef=DCM_PROGRAMMING_SESSION
      DcmDsl: category=TOOL_CONFIGURED
        UDS_RX (DcmDslBuffer): DcmDslBufferSize=255
        UDS_TX (DcmDslBuffer): DcmDslBufferSize=255
        ECU1 (DcmDslCallbackDCMRequestService)
        DcmDslDiagResp: DcmDslDiagRespMaxNumRespPend=250, DcmDslDiagRespOnSecondDeclinedRequest=0
        Dcm_DiagCom_Protocol (DcmDslProtocol): category=TOOL_CONFIGURED
          UDS_ON_CAN (DcmDslProtocolRow):
            category = TOOL_CONFIGURED
            DcmDslProtocolEndiannessConvEnabled = 0
            DcmDslProtocolID = DCM_UDS_ON_CAN
            DcmDslProtocolIsParallelExecutab = 1
            DcmDslProtocolPreemptTimeout = 0.01
            DcmDslProtocolPriority = 1
            DcmDslProtocolTransType = TYPE2
            DcmSendRespPendOnTransToBoot = 1
            DcmTimStrP2ServerAdjust = 0.02
            DcmTimStrP2StarServerAdjust = 2.5
            DcmDslProtocolRxBufferID = UDS_RX
            DcmDslProtocolSIDTable = ES95486_SERVICE
            DcmDslProtocolSessionRef = ES95486_SESSION
            DcmDslProtocolTxBufferID = UDS_TX
            UDS_ON_CAN (DcmDslConnection): category=TOOL_CONFIGURED
              DcmDslMainConnection: category=TOOL_CONFIGURED, DcmDslProtocolRxTesterSourceAddr=0xf0
                PhysicalRequest (DcmDslProtocolRx):
                  category = TOOL_CONFIGURED
                  DcmDslProtocolRxAddrType = DCM_PHYSICAL_TYPE
                  DcmDslProtocolRxPduId = 0
                  DcmDslProtocolRxChannelId = 0
                  DcmDslProtocolRxComMChannelRef = ComMChannel_BCAN
                  DcmDslProtocolRxPduRef = Pdu_DcmIPdu_BCAN_GST_RWPC
                FunctionalRequest (DcmDslProtocolRx):
                  category = TOOL_CONFIGURED
                  DcmDslProtocolRxAddrType = DCM_FUNCTIONAL_TYPE
                  DcmDslProtocolRxPduId = 1
                  DcmDslProtocolRxChannelId = 0
                  DcmDslProtocolRxComMChannelRef = ComMChannel_BCAN
                  DcmDslProtocolRxPduRef = Pdu_DcmIPdu_BCAN_GST_ALL
                Response (DcmDslProtocolTx): category=TOOL_CONFIGURED, DcmDslTxConfirmationPduId=0, DcmDslProtocolTxPduRef=Pdu_DcmIPdu_BCAN_RWPC_GST
        DcmDslServiceRequestSupplierNotification0 (DcmDslServiceRequestSupplierNotification)
      DcmDsp: DcmDspMaxDidToRead=32, DcmDspPowerDownTime=10, DcmDspMaxPeriodicDidScheduler=2, DcmDspMaxPeriodicDidToRead=2, DcmDspDDDIDcheckPerSourceDID=0
        DcmDspCallbackPresentDate
        DcmDspComControl
          CommChannel_LOCALCAN (DcmDspComControlAllChannel): DcmDspAllComMChannelRef=ComMChannel_LOCALCAN
          CommChannel_BCAN (DcmDspComControlAllChannel): DcmDspAllComMChannelRef=ComMChannel_BCAN
          SpecificCommChannel_LOCALCAN (DcmDspComControlSpecificChannel): DcmDspSubnetNumber=1, DcmDspSpecificComMChannelRef=ComMChannel_LOCALCAN
          SpecificCommChannel_BCAN (DcmDspComControlSpecificChannel): DcmDspSubnetNumber=1, DcmDspSpecificComMChannelRef=ComMChannel_BCAN
        22 x DcmDspData, all with DcmDspDataType=UINT8, DcmDspDataInfoRef=NoScalingInfomation_FixedData:
          VehicleManufacturerSparePartNumberDataIdentifier_0xF187: DcmDspDataSize=80, DcmDspDataUsePort=USE_DATA_SYNCH_CLIENT_SERVER
          ECUManufacturingDateDataIdentifier_0xF18B: DcmDspDataSize=32, DcmDspDataUsePort=USE_DATA_SYNCH_CLIENT_SERVER
          ECUSerialNumberDataIdentifier_0xF18C: DcmDspDataSize=120, DcmDspDataUsePort=USE_DATA_SYNCH_CLIENT_SERVER
          ECUSupplierCodeDataIdentifier_0xF1A1: DcmDspDataSize=32, DcmDspDataUsePort=USE_DATA_SYNCH_CLIENT_SERVER
          ECUSoftwareUNITnumberDataIdentifier_0xF1B0: DcmDspDataSize=8, DcmDspDataUsePort=USE_DATA_SYNCH_CLIENT_SERVER
          ECUSoftwareUNIT1VersionDataIdentifier_0xF1B1: DcmDspDataSize=32, DcmDspDataUsePort=USE_DATA_SYNCH_CLIENT_SERVER
          VehicleManufacturerECUHardwareNumberDataIdentifier_0xF191: DcmDspDataSize=32, DcmDspDataUsePort=USE_DATA_SYNCH_CLIENT_SERVER
          SystemSupplierECUHardwareVersionNumberDataIdentifier_0xF193: DcmDspDataSize=32, DcmDspDataUsePort=USE_DATA_SYNCH_CLIENT_SERVER
          CANDataBaseVersionNumberDataIdentifier_0xF100: DcmDspDataSize=32, DcmDspDataUsePort=USE_DATA_SYNCH_CLIENT_SERVER
          ECUSoftwareInternalVersion_0xF189: DcmDspDataSize=56, DcmDspDataUsePort=USE_DATA_SYNCH_CLIENT_SERVER
          ECUSoftwareUnit1IVDDataIdentifier_0xF1C1: DcmDspDataSize=256, DcmDspDataUsePort=USE_DATA_ASYNCH_CLIENT_SERVER
          ReadECUIdentificationLocalRXSWINDataIdentifier_0xF1EF: DcmDspDataSize=320, DcmDspDataUsePort=USE_DATA_ASYNCH_CLIENT_SERVER
          ChargingECUSoftwareVersionMobase_0xF101: DcmDspDataSize=48, DcmDspDataUsePort=USE_DATA_SYNCH_CLIENT_SERVER
          UserOptionRecordLocalIdentifier_0xBE01: DcmDspDataSize=64, DcmDspDataUsePort=USE_DATA_SYNCH_CLIENT_SERVER
          InputOutputRecordLocalIdentifier_0xBE02: DcmDspDataSize=112, DcmDspDataUsePort=USE_DATA_SYNCH_CLIENT_SERVER
          InputOutputRecordLocalIdentifier_0xBE03: DcmDspDataSize=48, DcmDspDataUsePort=USE_DATA_SYNCH_CLIENT_SERVER
          WDBI_Factory_SerialNumber_0x12A3: DcmDspDataSize=120, DcmDspDataUsePort=USE_DATA_SYNCH_CLIENT_SERVER
          WDBI_ManufacturingDate_0x12A4: DcmDspDataSize=32, DcmDspDataUsePort=USE_DATA_SYNCH_CLIENT_SERVER
          SystemName_0xF197: DcmDspDataSize=32, DcmDspDataUsePort=USE_DATA_SYNCH_CLIENT_SERVER
          PlatformVersion_0xF17F: DcmDspDataSize=88, DcmDspDataUsePort=USE_DATA_SYNCH_CLIENT_SERVER
          PlatformHardwareVersion_0xF17D: DcmDspDataSize=88, DcmDspDataUsePort=USE_DATA_SYNCH_CLIENT_SERVER
          NonSleepCollectedEachEcuDataIdentifier_0xED90: DcmDspDataSize=120, DcmDspDataUsePort=USE_DATA_SYNCH_CLIENT_SERVER
        4 x DcmDspDataInfo:
          VehicleSpeed_FixedData: DcmDspDataFixedLength=1, DcmDspDataScalingInfoSize=9
          NoScalingInfomation_FixedData: DcmDspDataFixedLength=1
          NoScalingInfomation_VariableData: DcmDspDataFixedLength=0
          VIN_DataIdentifier: DcmDspDataFixedLength=1, DcmDspDataScalingInfoSize=2
        22 x DcmDspDid, all with DcmDspDidUsed=1:
          DID_0xBE01: DcmDspDidIdentifier=0xBE01, DcmDspDidInfoRef=DIDInfo_0xBE01
            Data (DcmDspDidSignal): DcmDspDidDataPos=0, DcmDspDidDataRef=UserOptionRecordLocalIdentifier_0xBE01
          DID_0xBE02: DcmDspDidIdentifier=0xBE02, DcmDspDidInfoRef=DIDInfo_0xBE02
            Data (DcmDspDidSignal): DcmDspDidDataPos=0, DcmDspDidDataRef=InputOutputRecordLocalIdentifier_0xBE02
          DID_0xBE03: DcmDspDidIdentifier=0xBE03, DcmDspDidInfoRef=DIDInfo_0xBE03
            Data (DcmDspDidSignal): DcmDspDidDataPos=0, DcmDspDidDataRef=InputOutputRecordLocalIdentifier_0xBE03
          DID_0xF197: DcmDspDidIdentifier=0xF197, DcmDspDidInfoRef=DIDinfo_0xF197
            Data (DcmDspDidSignal): DcmDspDidDataPos=0, DcmDspDidDataRef=SystemName_0xF197
          DID_0xF187: DcmDspDidIdentifier=0xF187, DcmDspDidInfoRef=DIDInfo_0xF187
            Data (DcmDspDidSignal): DcmDspDidDataPos=0, DcmDspDidDataRef=VehicleManufacturerSparePartNumberDataIdentifier_0xF187
          DID_0xF18B: DcmDspDidIdentifier=0xF18B, DcmDspDidInfoRef=DIDInfo_0xF18B
            Data (DcmDspDidSignal): DcmDspDidDataPos=0, DcmDspDidDataRef=ECUManufacturingDateDataIdentifier_0xF18B
          DID_0xF18C: DcmDspDidIdentifier=0xF18C, DcmDspDidInfoRef=DIDInfo_0xF18C
            Data (DcmDspDidSignal): DcmDspDidDataPos=0, DcmDspDidDataRef=ECUSerialNumberDataIdentifier_0xF18C
          DID_0xF1A1: DcmDspDidIdentifier=0xF1A1, DcmDspDidInfoRef=DIDInfo_0xF1A1
            Data (DcmDspDidSignal): DcmDspDidDataPos=0, DcmDspDidDataRef=ECUSupplierCodeDataIdentifier_0xF1A1
          DID_0xF1B0: DcmDspDidIdentifier=0xF1B0, DcmDspDidInfoRef=DIDInfo_0xF1B0
            Data (DcmDspDidSignal): DcmDspDidDataPos=0, DcmDspDidDataRef=ECUSoftwareUNITnumberDataIdentifier_0xF1B0
          DID_0xF1B1: DcmDspDidIdentifier=0xF1B1, DcmDspDidInfoRef=DIDInfo_0xF1B1
            Data (DcmDspDidSignal): DcmDspDidDataPos=0, DcmDspDidDataRef=ECUSoftwareUNIT1VersionDataIdentifier_0xF1B1
          DID_0xF191: DcmDspDidIdentifier=0xF191, DcmDspDidInfoRef=DIDInfo_0xF191
            Data (DcmDspDidSignal): DcmDspDidDataPos=0, DcmDspDidDataRef=VehicleManufacturerECUHardwareNumberDataIdentifier_0xF191
          DID_0xF193: DcmDspDidIdentifier=0xF193, DcmDspDidInfoRef=DIDInfo_0xF193
            Data (DcmDspDidSignal): DcmDspDidDataPos=0, DcmDspDidDataRef=SystemSupplierECUHardwareVersionNumberDataIdentifier_0xF193
          DID_0xF100: DcmDspDidIdentifier=0xF100, DcmDspDidInfoRef=DIDInfo_0xF100
            Data (DcmDspDidSignal): DcmDspDidDataPos=0, DcmDspDidDataRef=CANDataBaseVersionNumberDataIdentifier_0xF100
          DID_0xF1EF: DcmDspDidIdentifier=0xF1EF, DcmDspDidInfoRef=DIDInfo_0xF1EF
            Data (DcmDspDidSignal): DcmDspDidDataPos=0, DcmDspDidDataRef=ReadECUIdentificationLocalRXSWINDataIdentifier_0xF1EF
          DID_0xF1C1: DcmDspDidIdentifier=0xF1C1, DcmDspDidInfoRef=DIDInfo_0xF1C1
            Data (DcmDspDidSignal): DcmDspDidDataPos=0, DcmDspDidDataRef=ECUSoftwareUnit1IVDDataIdentifier_0xF1C1
          DID_0xF17F: DcmDspDidIdentifier=0xF17F, DcmDspDidInfoRef=DIDinfo_0xF17F
            Data (DcmDspDidSignal): DcmDspDidDataPos=0, DcmDspDidDataRef=PlatformVersion_0xF17F
          DID_0xF17D: DcmDspDidIdentifier=0xF17D, DcmDspDidInfoRef=DIDinfo_0xF17D
            Data (DcmDspDidSignal): DcmDspDidDataPos=0, DcmDspDidDataRef=PlatformHardwareVersion_0xF17D
          DID_0x12A3: DcmDspDidIdentifier=0x12A3, DcmDspDidInfoRef=DIDinfo_0x12A3
            Data (DcmDspDidSignal): DcmDspDidDataPos=0, DcmDspDidDataRef=WDBI_Factory_SerialNumber_0x12A3
          DID_0x12A4: DcmDspDidIdentifier=0x12A4, DcmDspDidInfoRef=DIDinfo_0x12A4
            Data (DcmDspDidSignal): DcmDspDidDataPos=0, DcmDspDidDataRef=WDBI_ManufacturingDate_0x12A4
          DID_0xF101: DcmDspDidIdentifier=0xF101, DcmDspDidInfoRef=DIDinfo_0xF101
            Data (DcmDspDidSignal): DcmDspDidDataPos=0, DcmDspDidDataRef=ChargingECUSoftwareVersionMobase_0xF101
          DID_0xF189: DcmDspDidIdentifier=0xF189, DcmDspDidInfoRef=DIDinfo_0xF189
            Data (DcmDspDidSignal): DcmDspDidDataPos=0, DcmDspDidDataRef=ECUSoftwareInternalVersion_0xF189
          DID_0xED90: DcmDspDidIdentifier=0xED90, DcmDspDidInfoRef=DIDinfo_0xED90
            Data (DcmDspDidSignal): DcmDspDidDataPos=0, DcmDspDidDataRef=NonSleepCollectedEachEcuDataIdentifier_0xED90
        23 x DcmDspDidInfo, all with DcmDspDidDynamicallyDefined=0:
          DIDs_0100h_0110h
            DcmDspDidAccess
              DcmDspDidRead
              DcmDspDidWrite: DcmDspDidWriteSessionRef=DCM_ALL_SESSION_LEVEL
          DIDInfo_0xBE01
            DcmDspDidAccess
              DcmDspDidRead:
                DcmDspDidReadSessionRef = DCM_DEFAULT_SESSION
                DcmDspDidReadSessionRef = DCM_EXTENDED_DIAGNOSTIC_MODE
                DcmDspDidReadSessionRef = DCM_EXTENDED_DIAGNOSTIC_SESSION
                DcmDspDidReadSessionRef = DCM_QUIESCENT_CURRENT_DIAGNOSTIC_MODE
                DcmDspDidReadSessionRef = DCM_SAFETY_SYSTEM_DIAGNOSTIC_SESSION
                DcmDspDidReadSessionRef = DCM_SLEEP_MODE_START_REQUEST
          DIDInfo_0xBE02
            DcmDspDidAccess
              DcmDspDidRead:
                DcmDspDidReadSessionRef = DCM_DEFAULT_SESSION
                DcmDspDidReadSessionRef = DCM_EXTENDED_DIAGNOSTIC_MODE
                DcmDspDidReadSessionRef = DCM_EXTENDED_DIAGNOSTIC_SESSION
                DcmDspDidReadSessionRef = DCM_QUIESCENT_CURRENT_DIAGNOSTIC_MODE
                DcmDspDidReadSessionRef = DCM_SAFETY_SYSTEM_DIAGNOSTIC_SESSION
                DcmDspDidReadSessionRef = DCM_SLEEP_MODE_START_REQUEST
          DIDInfo_0xBE03
            DcmDspDidAccess
              DcmDspDidRead:
                DcmDspDidReadSessionRef = DCM_DEFAULT_SESSION
                DcmDspDidReadSessionRef = DCM_EXTENDED_DIAGNOSTIC_MODE
                DcmDspDidReadSessionRef = DCM_EXTENDED_DIAGNOSTIC_SESSION
                DcmDspDidReadSessionRef = DCM_QUIESCENT_CURRENT_DIAGNOSTIC_MODE
                DcmDspDidReadSessionRef = DCM_SAFETY_SYSTEM_DIAGNOSTIC_SESSION
                DcmDspDidReadSessionRef = DCM_SLEEP_MODE_START_REQUEST
          DIDinfo_0xF197
            DcmDspDidAccess
              DcmDspDidRead:
                DcmDspDidReadSessionRef = DCM_DEFAULT_SESSION
                DcmDspDidReadSessionRef = DCM_EXTENDED_DIAGNOSTIC_MODE
                DcmDspDidReadSessionRef = DCM_EXTENDED_DIAGNOSTIC_SESSION
                DcmDspDidReadSessionRef = DCM_QUIESCENT_CURRENT_DIAGNOSTIC_MODE
                DcmDspDidReadSessionRef = DCM_SAFETY_SYSTEM_DIAGNOSTIC_SESSION
                DcmDspDidReadSessionRef = DCM_SLEEP_MODE_START_REQUEST
          DIDInfo_0xF187
            DcmDspDidAccess
              DcmDspDidRead:
                DcmDspDidReadSessionRef = DCM_DEFAULT_SESSION
                DcmDspDidReadSessionRef = DCM_EXTENDED_DIAGNOSTIC_MODE
                DcmDspDidReadSessionRef = DCM_EXTENDED_DIAGNOSTIC_SESSION
                DcmDspDidReadSessionRef = DCM_QUIESCENT_CURRENT_DIAGNOSTIC_MODE
                DcmDspDidReadSessionRef = DCM_SAFETY_SYSTEM_DIAGNOSTIC_SESSION
                DcmDspDidReadSessionRef = DCM_SLEEP_MODE_START_REQUEST
          DIDInfo_0xF18B
            DcmDspDidAccess
              DcmDspDidRead:
                DcmDspDidReadSessionRef = DCM_DEFAULT_SESSION
                DcmDspDidReadSessionRef = DCM_EXTENDED_DIAGNOSTIC_MODE
                DcmDspDidReadSessionRef = DCM_EXTENDED_DIAGNOSTIC_SESSION
                DcmDspDidReadSessionRef = DCM_QUIESCENT_CURRENT_DIAGNOSTIC_MODE
                DcmDspDidReadSessionRef = DCM_SAFETY_SYSTEM_DIAGNOSTIC_SESSION
                DcmDspDidReadSessionRef = DCM_SLEEP_MODE_START_REQUEST
          DIDInfo_0xF18C
            DcmDspDidAccess
              DcmDspDidRead:
                DcmDspDidReadSessionRef = DCM_DEFAULT_SESSION
                DcmDspDidReadSessionRef = DCM_EXTENDED_DIAGNOSTIC_MODE
                DcmDspDidReadSessionRef = DCM_EXTENDED_DIAGNOSTIC_SESSION
                DcmDspDidReadSessionRef = DCM_QUIESCENT_CURRENT_DIAGNOSTIC_MODE
                DcmDspDidReadSessionRef = DCM_SAFETY_SYSTEM_DIAGNOSTIC_SESSION
                DcmDspDidReadSessionRef = DCM_SLEEP_MODE_START_REQUEST
          DIDInfo_0xF1A1
            DcmDspDidAccess
              DcmDspDidRead:
                DcmDspDidReadSessionRef = DCM_DEFAULT_SESSION
                DcmDspDidReadSessionRef = DCM_EXTENDED_DIAGNOSTIC_MODE
                DcmDspDidReadSessionRef = DCM_EXTENDED_DIAGNOSTIC_SESSION
                DcmDspDidReadSessionRef = DCM_QUIESCENT_CURRENT_DIAGNOSTIC_MODE
                DcmDspDidReadSessionRef = DCM_SAFETY_SYSTEM_DIAGNOSTIC_SESSION
          DIDInfo_0xF1B0
            DcmDspDidAccess
              DcmDspDidRead:
                DcmDspDidReadSessionRef = DCM_DEFAULT_SESSION
                DcmDspDidReadSessionRef = DCM_EXTENDED_DIAGNOSTIC_MODE
                DcmDspDidReadSessionRef = DCM_EXTENDED_DIAGNOSTIC_SESSION
                DcmDspDidReadSessionRef = DCM_QUIESCENT_CURRENT_DIAGNOSTIC_MODE
                DcmDspDidReadSessionRef = DCM_SAFETY_SYSTEM_DIAGNOSTIC_SESSION
                DcmDspDidReadSessionRef = DCM_SLEEP_MODE_START_REQUEST
          DIDInfo_0xF1B1
            DcmDspDidAccess
              DcmDspDidRead:
                DcmDspDidReadSessionRef = DCM_DEFAULT_SESSION
                DcmDspDidReadSessionRef = DCM_EXTENDED_DIAGNOSTIC_MODE
                DcmDspDidReadSessionRef = DCM_EXTENDED_DIAGNOSTIC_SESSION
                DcmDspDidReadSessionRef = DCM_QUIESCENT_CURRENT_DIAGNOSTIC_MODE
                DcmDspDidReadSessionRef = DCM_SAFETY_SYSTEM_DIAGNOSTIC_SESSION
                DcmDspDidReadSessionRef = DCM_SLEEP_MODE_START_REQUEST
          DIDInfo_0xF191
            DcmDspDidAccess
              DcmDspDidRead:
                DcmDspDidReadSessionRef = DCM_DEFAULT_SESSION
                DcmDspDidReadSessionRef = DCM_EXTENDED_DIAGNOSTIC_MODE
                DcmDspDidReadSessionRef = DCM_EXTENDED_DIAGNOSTIC_SESSION
                DcmDspDidReadSessionRef = DCM_QUIESCENT_CURRENT_DIAGNOSTIC_MODE
                DcmDspDidReadSessionRef = DCM_SAFETY_SYSTEM_DIAGNOSTIC_SESSION
                DcmDspDidReadSessionRef = DCM_SLEEP_MODE_START_REQUEST
          DIDInfo_0xF193
            DcmDspDidAccess
              DcmDspDidRead:
                DcmDspDidReadSessionRef = DCM_DEFAULT_SESSION
                DcmDspDidReadSessionRef = DCM_EXTENDED_DIAGNOSTIC_MODE
                DcmDspDidReadSessionRef = DCM_EXTENDED_DIAGNOSTIC_SESSION
                DcmDspDidReadSessionRef = DCM_QUIESCENT_CURRENT_DIAGNOSTIC_MODE
                DcmDspDidReadSessionRef = DCM_SAFETY_SYSTEM_DIAGNOSTIC_SESSION
                DcmDspDidReadSessionRef = DCM_SLEEP_MODE_START_REQUEST
          DIDInfo_0xF100
            DcmDspDidAccess
              DcmDspDidRead:
                DcmDspDidReadSessionRef = DCM_DEFAULT_SESSION
                DcmDspDidReadSessionRef = DCM_EXTENDED_DIAGNOSTIC_MODE
                DcmDspDidReadSessionRef = DCM_EXTENDED_DIAGNOSTIC_SESSION
                DcmDspDidReadSessionRef = DCM_QUIESCENT_CURRENT_DIAGNOSTIC_MODE
                DcmDspDidReadSessionRef = DCM_SAFETY_SYSTEM_DIAGNOSTIC_SESSION
                DcmDspDidReadSessionRef = DCM_SLEEP_MODE_START_REQUEST
          DIDInfo_0xF1EF
            DcmDspDidAccess
              DcmDspDidRead:
                DcmDspDidReadSessionRef = DCM_DEFAULT_SESSION
                DcmDspDidReadSessionRef = DCM_EXTENDED_DIAGNOSTIC_MODE
                DcmDspDidReadSessionRef = DCM_EXTENDED_DIAGNOSTIC_SESSION
                DcmDspDidReadSessionRef = DCM_QUIESCENT_CURRENT_DIAGNOSTIC_MODE
                DcmDspDidReadSessionRef = DCM_SAFETY_SYSTEM_DIAGNOSTIC_SESSION
                DcmDspDidReadSessionRef = DCM_SLEEP_MODE_START_REQUEST
          DIDInfo_0xF1C1
            DcmDspDidAccess
              DcmDspDidRead:
                DcmDspDidReadSessionRef = DCM_DEFAULT_SESSION
                DcmDspDidReadSessionRef = DCM_EXTENDED_DIAGNOSTIC_MODE
                DcmDspDidReadSessionRef = DCM_EXTENDED_DIAGNOSTIC_SESSION
                DcmDspDidReadSessionRef = DCM_QUIESCENT_CURRENT_DIAGNOSTIC_MODE
                DcmDspDidReadSessionRef = DCM_SAFETY_SYSTEM_DIAGNOSTIC_SESSION
                DcmDspDidReadSessionRef = DCM_SLEEP_MODE_START_REQUEST
          DIDinfo_0xF17F
            DcmDspDidAccess
              DcmDspDidRead:
                DcmDspDidReadSessionRef = DCM_DEFAULT_SESSION
                DcmDspDidReadSessionRef = DCM_EXTENDED_DIAGNOSTIC_MODE
                DcmDspDidReadSessionRef = DCM_EXTENDED_DIAGNOSTIC_SESSION
                DcmDspDidReadSessionRef = DCM_QUIESCENT_CURRENT_DIAGNOSTIC_MODE
                DcmDspDidReadSessionRef = DCM_SAFETY_SYSTEM_DIAGNOSTIC_SESSION
                DcmDspDidReadSessionRef = DCM_SLEEP_MODE_START_REQUEST
          DIDinfo_0xF17D
            DcmDspDidAccess
              DcmDspDidRead:
                DcmDspDidReadSessionRef = DCM_DEFAULT_SESSION
                DcmDspDidReadSessionRef = DCM_EXTENDED_DIAGNOSTIC_MODE
                DcmDspDidReadSessionRef = DCM_EXTENDED_DIAGNOSTIC_SESSION
                DcmDspDidReadSessionRef = DCM_QUIESCENT_CURRENT_DIAGNOSTIC_MODE
                DcmDspDidReadSessionRef = DCM_SAFETY_SYSTEM_DIAGNOSTIC_SESSION
                DcmDspDidReadSessionRef = DCM_SLEEP_MODE_START_REQUEST
          DIDinfo_0x12A3
            DcmDspDidAccess
              DcmDspDidWrite:
                DcmDspDidWriteSessionRef = DCM_DEFAULT_SESSION
                DcmDspDidWriteSessionRef = DCM_PROGRAMMING_SESSION
                DcmDspDidWriteSessionRef = DCM_EXTENDED_DIAGNOSTIC_MODE
                DcmDspDidWriteSessionRef = DCM_EXTENDED_DIAGNOSTIC_SESSION
                DcmDspDidWriteSessionRef = DCM_SAFETY_SYSTEM_DIAGNOSTIC_SESSION
                DcmDspDidWriteSessionRef = DCM_ECU_PROGRAMMING_MODE
          DIDinfo_0x12A4
            DcmDspDidAccess
              DcmDspDidWrite:
                DcmDspDidWriteSessionRef = DCM_DEFAULT_SESSION
                DcmDspDidWriteSessionRef = DCM_ECU_PROGRAMMING_MODE
                DcmDspDidWriteSessionRef = DCM_EXTENDED_DIAGNOSTIC_MODE
                DcmDspDidWriteSessionRef = DCM_EXTENDED_DIAGNOSTIC_SESSION
                DcmDspDidWriteSessionRef = DCM_PROGRAMMING_SESSION
                DcmDspDidWriteSessionRef = DCM_SAFETY_SYSTEM_DIAGNOSTIC_SESSION
          DIDinfo_0xF101
            DcmDspDidAccess
              DcmDspDidRead:
                DcmDspDidReadSessionRef = DCM_DEFAULT_SESSION
                DcmDspDidReadSessionRef = DCM_EXTENDED_DIAGNOSTIC_MODE
                DcmDspDidReadSessionRef = DCM_EXTENDED_DIAGNOSTIC_SESSION
                DcmDspDidReadSessionRef = DCM_QUIESCENT_CURRENT_DIAGNOSTIC_MODE
                DcmDspDidReadSessionRef = DCM_SAFETY_SYSTEM_DIAGNOSTIC_SESSION
          DIDinfo_0xF189
            DcmDspDidAccess
              DcmDspDidRead:
                DcmDspDidReadSessionRef = DCM_DEFAULT_SESSION
                DcmDspDidReadSessionRef = DCM_EXTENDED_DIAGNOSTIC_MODE
                DcmDspDidReadSessionRef = DCM_EXTENDED_DIAGNOSTIC_SESSION
                DcmDspDidReadSessionRef = DCM_QUIESCENT_CURRENT_DIAGNOSTIC_MODE
                DcmDspDidReadSessionRef = DCM_SAFETY_SYSTEM_DIAGNOSTIC_SESSION
          DIDinfo_0xED90
            DcmDspDidAccess
              DcmDspDidRead:
                DcmDspDidReadSessionRef = DCM_DEFAULT_SESSION
                DcmDspDidReadSessionRef = DCM_EXTENDED_DIAGNOSTIC_MODE
                DcmDspDidReadSessionRef = DCM_EXTENDED_DIAGNOSTIC_SESSION
                DcmDspDidReadSessionRef = DCM_QUIESCENT_CURRENT_DIAGNOSTIC_MODE
                DcmDspDidReadSessionRef = DCM_SAFETY_SYSTEM_DIAGNOSTIC_SESSION
        DIDs_0100h_0110h (DcmDspDidRange):
          DcmDspDidRangeHasGaps = 1
          DcmDspDidRangeIdentifierLowerLimit = 0x0100
          DcmDspDidRangeIdentifierUpperLimit = 0x0110
          DcmDspDidRangeMaxDataLength = 30
          DcmDspDidRangeUsePort = 1
          DcmDspDidRangeInfoRef = DcmDsp/DIDs_0100h_0110h
        DcmDspMemory: DcmDspUseMemoryId=0
          3 x DcmDspAddressAndLengthFormatIdentifier:
            ALF_0x14h: DcmDspSupportedAddressAndLengthFormatIdentifier=0x14
            ALF_0x34h: DcmDspSupportedAddressAndLengthFormatIdentifier=0x34
            ALF_0x44h: DcmDspSupportedAddressAndLengthFormatIdentifier=0x44
          MemoryIdInfo (DcmDspMemoryIdInfo)
            RMA_21091968h (DcmDspReadMemoryRangeInfo): DcmDspReadMemoryRangeHigh=0x2109196C, DcmDspReadMemoryRangeLow=0x21091968
            WMA_20481309h (DcmDspWriteMemoryRangeInfo): DcmDspWriteMemoryRangeHigh=0x2048130E, DcmDspWriteMemoryRangeLow=0x20481309
        8 x DcmDspRoutine, all with DcmDspRequestResultsRoutineSupported=0, DcmDspRoutineUsePort=1, DcmDspRoutineUsed=1, DcmDspStopRoutineSupported=0:
          RID_0300h_OTAReady: DcmDspRoutineFixedLength=1, DcmDspRoutineIdentifier=0x0300, DcmDspRoutineInfoRef=RID_Info_0300h_OTAReady
          RID_B194h_HSMConfigLockSecureDebug: DcmDspRoutineFixedLength=0, DcmDspRoutineIdentifier=0xB194, DcmDspRoutineInfoRef=RID_Info_B194h_HSMConfigLockSecureDebug
          RID_B199h_HSMSecureBootEnable: DcmDspRoutineFixedLength=0, DcmDspRoutineIdentifier=0xB199, DcmDspRoutineInfoRef=RID_Info_B199h_HSMSecureBootEnable
          RID_B19Ah_HSMFTDDisable: DcmDspRoutineFixedLength=0, DcmDspRoutineIdentifier=0xB19A, DcmDspRoutineInfoRef=RID_Info_B19Ah_HSMFTDDisable
          RID_B19Bh_HSMSecureDebugEnable: DcmDspRoutineFixedLength=0, DcmDspRoutineIdentifier=0xB19B, DcmDspRoutineInfoRef=RID_Info_B19Bh_HSMSecureDebugEnable
          RID_B19Ch_HSMConfigurationLockEnable: DcmDspRoutineFixedLength=0, DcmDspRoutineIdentifier=0xB19C, DcmDspRoutineInfoRef=RID_Info_B19Ch_HSMConfigurationLockEnable
          RID_B19Dh_HSMChallengeRequest: DcmDspRoutineFixedLength=0, DcmDspRoutineIdentifier=0xB19D, DcmDspRoutineInfoRef=RID_Info_B19Dh_HSMChallengeRequest
          RID_B19Eh_HSMResponseData: DcmDspRoutineFixedLength=0, DcmDspRoutineIdentifier=0xB19E, DcmDspRoutineInfoRef=RID_Info_B19Eh_HSMResponseData
        8 x DcmDspRoutineInfo:
          RID_Info_0300h_OTAReady
            DcmDspRoutineAuthorization0 (DcmDspRoutineAuthorization):
              DcmDspRoutineSessionRef = DCM_EXTENDED_DIAGNOSTIC_MODE
              DcmDspRoutineSessionRef = DCM_EXTENDED_DIAGNOSTIC_SESSION
              DcmDspRoutineSessionRef = DCM_DEFAULT_SESSION
            DcmDspStartRoutineOut
              Out_RoutineStatus (DcmDspStartRoutineOutSignal): DcmDspRoutineStartOutEndianness=0, DcmDspRoutineSignalLength=8, DcmDspRoutineSignalPos=0, DcmDspRoutineSignalType=UINT8
          RID_Info_B194h_HSMConfigLockSecureDebug
            DcmDspRoutineAuthorization: DcmDspRoutineSessionRef=DCM_EXTENDED_DIAGNOSTIC_MODE, DcmDspRoutineSessionRef=DCM_EXTENDED_DIAGNOSTIC_SESSION
            B194h_StartRoutineOut (DcmDspStartRoutineOut)
              B194h_StartRoutineOutSignal (DcmDspStartRoutineOutSignal): DcmDspRoutineSignalLength=16, DcmDspRoutineSignalPos=0, DcmDspRoutineSignalType=VARIABLE_LENGTH, DcmDspRoutineStartOutEndianness=0
          RID_Info_B199h_HSMSecureBootEnable
            DcmDspRoutineAuthorization: DcmDspRoutineSessionRef=DCM_EXTENDED_DIAGNOSTIC_MODE, DcmDspRoutineSessionRef=DCM_EXTENDED_DIAGNOSTIC_SESSION
            B199h_StartRoutineOut (DcmDspStartRoutineOut)
              3 x DcmDspStartRoutineOutSignal, all with DcmDspRoutineStartOutEndianness=0:
                B199h_StartRoutineOutSignal_ReturnType: DcmDspRoutineSignalLength=8, DcmDspRoutineSignalPos=0, DcmDspRoutineSignalType=UINT8
                B199h_StartRoutineOutSignal_State: DcmDspRoutineSignalLength=8, DcmDspRoutineSignalPos=8, DcmDspRoutineSignalType=UINT8
                B199h_StartRoutineOutSignal_ErrorCode: DcmDspRoutineSignalLength=16, DcmDspRoutineSignalPos=16, DcmDspRoutineSignalType=UINT16
          RID_Info_B19Ah_HSMFTDDisable
            DcmDspRoutineAuthorization: DcmDspRoutineSessionRef=DCM_EXTENDED_DIAGNOSTIC_MODE, DcmDspRoutineSessionRef=DCM_EXTENDED_DIAGNOSTIC_SESSION
            B19Ah_StartRoutineOut (DcmDspStartRoutineOut)
              3 x DcmDspStartRoutineOutSignal, all with DcmDspRoutineStartOutEndianness=0:
                B19Ah_StartRoutineOutSignal_ReturnType: DcmDspRoutineSignalLength=8, DcmDspRoutineSignalPos=0, DcmDspRoutineSignalType=UINT8
                B19Ah_StartRoutineOutSignal_State: DcmDspRoutineSignalLength=8, DcmDspRoutineSignalPos=8, DcmDspRoutineSignalType=UINT8
                B19Ah_StartRoutineOutSignal_ErrorCode: DcmDspRoutineSignalLength=16, DcmDspRoutineSignalPos=16, DcmDspRoutineSignalType=UINT16
          RID_Info_B19Bh_HSMSecureDebugEnable
            DcmDspRoutineAuthorization: DcmDspRoutineSessionRef=DCM_EXTENDED_DIAGNOSTIC_MODE, DcmDspRoutineSessionRef=DCM_EXTENDED_DIAGNOSTIC_SESSION
            B19Bh_StartRoutineOut (DcmDspStartRoutineOut)
              3 x DcmDspStartRoutineOutSignal, all with DcmDspRoutineStartOutEndianness=0:
                B19Bh_StartRoutineOutSignal_ReturnType: DcmDspRoutineSignalLength=8, DcmDspRoutineSignalPos=0, DcmDspRoutineSignalType=UINT8
                B19Bh_StartRoutineOutSignal_State: DcmDspRoutineSignalLength=8, DcmDspRoutineSignalPos=8, DcmDspRoutineSignalType=UINT8
                B19Bh_StartRoutineOutSignal_ErrorCode: DcmDspRoutineSignalLength=16, DcmDspRoutineSignalPos=16, DcmDspRoutineSignalType=UINT16
          RID_Info_B19Ch_HSMConfigurationLockEnable
            DcmDspRoutineAuthorization: DcmDspRoutineSessionRef=DCM_EXTENDED_DIAGNOSTIC_MODE, DcmDspRoutineSessionRef=DCM_EXTENDED_DIAGNOSTIC_SESSION
            DcmDspStartRoutineOut
              3 x DcmDspStartRoutineOutSignal, all with DcmDspRoutineStartOutEndianness=0:
                B19Ch_StartRoutineOutSignal_ReturnType: DcmDspRoutineSignalLength=8, DcmDspRoutineSignalPos=0, DcmDspRoutineSignalType=UINT8
                B19Ch_StartRoutineOutSignal_State: DcmDspRoutineSignalLength=8, DcmDspRoutineSignalPos=8, DcmDspRoutineSignalType=UINT8
                B19Ch_StartRoutineOutSignal_ErrorCode: DcmDspRoutineSignalLength=16, DcmDspRoutineSignalPos=16, DcmDspRoutineSignalType=UINT16
          RID_Info_B19Dh_HSMChallengeRequest
            DcmDspRoutineAuthorization: DcmDspRoutineSessionRef=DCM_EXTENDED_DIAGNOSTIC_MODE, DcmDspRoutineSessionRef=DCM_EXTENDED_DIAGNOSTIC_SESSION
            DcmDspStartRoutineOut
              B19Dh_StartRoutineOutSignal_Data (DcmDspStartRoutineOutSignal): DcmDspRoutineSignalLength=128, DcmDspRoutineSignalPos=0, DcmDspRoutineSignalType=VARIABLE_LENGTH, DcmDspRoutineStartOutEndianness=0
          RID_Info_B19Eh_HSMResponseData
            DcmDspRoutineAuthorization: DcmDspRoutineSessionRef=DCM_EXTENDED_DIAGNOSTIC_MODE, DcmDspRoutineSessionRef=DCM_EXTENDED_DIAGNOSTIC_SESSION
            DcmDspStartRoutineIn
              B19Eh_StartRoutineInSignal_Data (DcmDspStartRoutineInSignal): DcmDspRoutineSignalLength=128, DcmDspRoutineSignalPos=0, DcmDspRoutineSignalType=VARIABLE_LENGTH, DcmDspRoutineStartInEndianness=0
        ES95486_SECURITY (DcmDspSecurity)
          L1 (DcmDspSecurityRow):
            DcmDspSecurityDelayTime = 10.0
            DcmDspSecurityDelayTimeOnBoot = 0
            DcmDspSecurityKeySize = 4
            DcmDspSecurityLevel = 1
            DcmDspSecurityNumAttDelay = 2
            DcmDspSecuritySeedSize = 4
            DcmDspSecurityUsePort = USE_ASYNCH_CLIENT_SERVER
          L9 (DcmDspSecurityRow):
            DcmDspSecurityDelayTime = 10.0
            DcmDspSecurityDelayTimeOnBoot = 0.0
            DcmDspSecurityKeySize = 8
            DcmDspSecurityLevel = 0x9
            DcmDspSecurityNumAttDelay = 2
            DcmDspSecuritySeedSize = 8
            DcmDspSecurityUsePort = USE_ASYNCH_CLIENT_SERVER
        ES95486_SESSION (DcmDspSession)
          9 x DcmDspSessionRow, all with DcmDspSessionP2ServerMax=0.05, DcmDspSessionP2StarServerMax=5.0:
            DCM_DEFAULT_SESSION: DcmDspSessionForBoot=DCM_NO_BOOT, DcmDspSessionLevel=0x01
            DCM_PROGRAMMING_SESSION: DcmDspSessionForBoot=DCM_OEM_BOOT, DcmDspSessionLevel=0x02
            DCM_EXTENDED_DIAGNOSTIC_SESSION: DcmDspSessionForBoot=DCM_NO_BOOT, DcmDspSessionLevel=0x03
            DCM_SAFETY_SYSTEM_DIAGNOSTIC_SESSION: DcmDspSessionForBoot=DCM_NO_BOOT, DcmDspSessionLevel=0x04
            DCM_ECU_PROGRAMMING_MODE: DcmDspSessionForBoot=DCM_OEM_BOOT, DcmDspSessionLevel=0x05
            DCM_EXTENDED_DIAGNOSTIC_MODE: DcmDspSessionForBoot=DCM_NO_BOOT, DcmDspSessionLevel=0x10
            DCM_QUIESCENT_CURRENT_DIAGNOSTIC_MODE: DcmDspSessionForBoot=DCM_NO_BOOT, DcmDspSessionLevel=0x50
            DCM_SLEEP_MODE_START_REQUEST: DcmDspSessionForBoot=DCM_NO_BOOT, DcmDspSessionLevel=0x51
            DCM_ALL_SESSION_LEVEL: DcmDspSessionForBoot=DCM_NO_BOOT, DcmDspSessionLevel=0xFF
      DcmGeneral:
        DcmDevErrorDetect = 1
        DcmRequestManufacturerNotificationEnabled = 0
        DcmRequestSupplierNotificationEnabled = 1
        DcmRespondAllRequest = 1
        DcmTaskTime = 0.01
        DcmVersionInfoApi = 0
        DcmStandardSupport = DCM_ES95486_02_SUPPORT
        DcmAutronFblUsed = 1
        DcmForcedEcuReset = 1
        DcmSecureFlashSupport = 1
        DcmHeaderFileInclusion = Cdd_UserDefinedService.h
      DcmPageBufferCfg: DcmPagedBufferEnabled=0

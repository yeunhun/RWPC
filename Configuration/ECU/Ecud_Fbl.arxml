AUTOSAR XML (schema 4-3-0)
package /EcucModules
  module config Fbl: module-description=BswImplementation_Fbl
    FblGeneral: FblSupportMcu=FBL_MCU_CYTXXX, FblSupportHsm=FBL_HSM_HAEHSM_2_0, FblDevErrorDetect=0, FblSoftwareVersionCheck=0
      FblOta: FblMemorySwapEnable=0, FblDecompressEnable=0
      FblSupportMcuName
        FblMcuCytxxx: FblMcuName=CYT2B9XX
    FblFlashConfig: FblFlashAlignment=32, FblMainSwEntryAddress1=0x10048001, FblStartupCommandAddress=0x800a000, FblCommonRamAddress=0x800a010
    FblDiagConfig:
      FblDiagResponseBeforeResetEnable = 1
      FblDiagMaxNumResponsePending = 50
      FblDiagResponseBeforeSessionChangeEnable = 1
      FblSupportDiagnosticStandard = FBL_ES95486_02
      FblDiagSignatureTxMode = FBL_TXDATA
      FblDiagMaxNumSignArea = 16
      FblDiagEraseRID = 65280
      FblDiagChkProgDepRID = 65281
      FblDiagOTAReadyRID = 768
      FblDiagTransferDataChunkMode = 0
      FblDiagMaxNumOfBlockLength = 2050
    ModuleInformation
      3 x SwModule:
        FBL: SwModuleIndex=0, StartAddress=0x10028000, EndAddress=0x10047FFF, ModuleInfoAddress=0x10028200, SpecialDataAddress=0x10028300, CrcInfoAddress=0x10028210
        MainSW: SwModuleIndex=1, StartAddress=0x10048000, EndAddress=0x1020FFFF, ModuleInfoAddress=0x10048800, SpecialDataAddress=0x10048900, CrcInfoAddress=0x10048810, SignatureAddress=0x10048A00
        RomTstArea: SwModuleIndex=2, EndAddress=268734207, ModuleInfoAddress=268733696, SpecialDataAddress=268733728, CrcInfoAddress=268733708, StartAddress=0x10048d00
      SwVersionInfo: CustomerId=02, ProductId=00, ProductVariant=00, SwVersion=01, IntSwVersion=00, Synchro1=00, Synchro2=00, BuildDate=2020-04-17
    FblWatchdogConfig: FblIntWdgEnable=1, FblIntWdgTimeoutMs=200
    FblCommConfig
      FblCanConfig: FblReceivedDataBufferSize=2050, FblProgramDataBufferSize=32, FblCanType=FBL_CAN_CLASSIC
        FblCanDiagMessageConfig
          FblCanDiagMsgFuncConfig: FblCanDiagMsgFuncAddrFormat=FBL_CAN_ADDR_STANDARD, FblCanDiagMsgFuncId=0x7DF
          FblCanDiagMsgPhysReqConfig: FblCanDiagMsgPhysReqAddrFormat=FBL_CAN_ADDR_STANDARD, FblCanDiagMsgPhysReqId=0x724, FblCanDiagMsgPhysReqSTmin=0
          FblCanDiagMsgPhysResConfig: FblCanDiagMsgPhysResAddrFormat=FBL_CAN_ADDR_STANDARD, FblCanDiagMsgPhysResId=0x72C
        FblCanBaudRateConfig: FblCanBaudRate=FBL_CAN_500KBPS, FblCanPropSeg=0, FblCanSeg1=14, FblCanSeg2=5, FblCanSyncJumpWith=1, FblCanPrescaler=4
        FblCanDrvConfig
          FblCanDrvCytxxx: FblCanCell=FBL_CAN0, FblCanNode=FBL_CAN_NODE2, FblCanTxPort=P6_2_CAN0_2_TX, FblCanRxPort=P6_3_CAN0_2_RX
        FblCanTrcvConfig
          FblCanTrcvCytxxx
      FblCanIfConfig: FblCanIfCANFDDiscreteDlcSupport=0
      FblGpioPortPinControl_BCAN_STB (FblGpioPortPinControl): PortPinIndex=0, FblPortNum=6, FblPinNum=4, FblPortPinVal=0
    FblSecurityConfig: FblCrc16BlockSize=FBL_CRC16_BLOCK_4096_BYTES
      FblSecurityAccess:
        FblSecurityAccessLevel = FBL_SA_ADVANCED_SEEDKEY
        FblSecureAccessCertificateHashAlgorithm = FBL_SA_HASH_SHA160
        FblSecurityNumAttDelay = 3
        FblSecurityDelayTime = 180
      FblSecureFlash:
        FblSecureFlashVersion = FBL_SF_VER_2_0
        FblSecureFlashSignatureHashAlgorithm = FBL_SF_HASH_SHA256
        FblWriteSignature = 0
        FblWriteSignatureDelimiter = 0
        FblRevisedSecureFlash_2_0 = 1
    FblPllConfig:
      FblCpuClock = FBL_CPU_160MHZ
      FblQuartzClock = FBL_QUARTZ_16MHZ
      CLK_ECO_AGC_EN = 0
      CLK_TRIM_ECO_ATRIM = 0
      CLK_TRIM_ECO_FTRIM = 3
      CLK_TRIM_ECO_GTRIM = 1
      CLK_TRIM_ECO_RTRIM = 2
      CLK_TRIM_ECO_WDTRIM = 7
      FblTimerPrescaler = 159

AUTOSAR XML (schema 4-0-3)
package /AUTOSAR
  module config IoHwAb: implementation-config-variant=VARIANT-PRE-COMPILE, module-description=BswImplementation_IoHwAb
    IoHwAbGeneral: IoHwAbDevErrorDetect=1, IoHwAbVersionInfoApi=0, IoHwAbMcalVendorVersion=CYPRESS_CYT2B9XX
      IoHwAbPortPinChs
        13 x IoHwAbPortPinCh, all with IoHwAbPolarity=HighActive:
          IoHwAbPortPinCh_PortPin_P000_3: IoHwAbHwDioChRef=DioChannel_P000_3, IoHwAbHwPortPinRef=PortPin_P000_3
          IoHwAbPortPinCh_PortPin_P002_1: IoHwAbHwDioChRef=DioChannel_P002_1, IoHwAbHwPortPinRef=PortPin_P002_1
          IoHwAbPortPinCh_PortPin_P006_0: IoHwAbHwDioChRef=DioChannel_P006_0, IoHwAbHwPortPinRef=PortPin_P006_0
          IoHwAbPortPinCh_PortPin_P006_3: IoHwAbHwDioChRef=DioChannel_P006_3, IoHwAbHwPortPinRef=PortPin_P006_3
          IoHwAbPortPinCh_PortPin_P006_5: IoHwAbHwDioChRef=DioChannel_P006_5, IoHwAbHwPortPinRef=PortPin_P006_5
          IoHwAbPortPinCh_PortPin_P007_1: IoHwAbHwDioChRef=DioChannel_P007_1, IoHwAbHwPortPinRef=PortPin_P007_1
          IoHwAbPortPinCh_PortPin_P008_1: IoHwAbHwDioChRef=DioChannel_P008_1, IoHwAbHwPortPinRef=PortPin_P008_1
          IoHwAbPortPinCh_PortPin_P012_1: IoHwAbHwDioChRef=DioChannel_P012_1, IoHwAbHwPortPinRef=PortPin_P012_1
          IoHwAbPortPinCh_PortPin_P018_0: IoHwAbHwDioChRef=DioChannel_P018_0, IoHwAbHwPortPinRef=PortPin_P018_0
          IoHwAbPortPinCh_PortPin_P018_1: IoHwAbHwDioChRef=DioChannel_P018_1, IoHwAbHwPortPinRef=PortPin_P018_1
          IoHwAbPortPinCh_PortPin_P021_0: IoHwAbHwDioChRef=DioChannel_P021_0, IoHwAbHwPortPinRef=PortPin_P021_0
          IoHwAbPortPinCh_PortPin_P022_0: IoHwAbHwDioChRef=DioChannel_P022_0, IoHwAbHwPortPinRef=PortPin_P022_0
          IoHwAbPortPinCh_PortPin_P023_3: IoHwAbHwDioChRef=DioChannel_P023_3, IoHwAbHwPortPinRef=PortPin_P023_3
      IoHwAbAdcSetting: IoHwAbAdcReadDirectMaxDelay=10000
        IoHwAbAdcAllGroups: IoHwAbHwAdcAllGroupRef=AdcGroup_U0All, IoHwAbHwAdcAllGroupRef=AdcGroup_U2All
          3 x IoHwAbAdcGroupInAll:
            IoHwAbAdcGroupInAll_U0C6: IoHwAbHwAdcGroupRef=AdcGroup_U0C6
            IoHwAbAdcGroupInAll_U0C8: IoHwAbHwAdcGroupRef=AdcGroup_U0C8
            IoHwAbAdcGroupInAll_U2C7: IoHwAbHwAdcGroupRef=AdcGroup_U2C7
        IoHwAbAdcGroups
          5 x IoHwAbAdcGroup:
            IoHwAbAdcGroup_U0C6: IoHwAbHwAdcGroupRef=AdcGroup_U0C6
            IoHwAbAdcGroup_U0C8: IoHwAbHwAdcGroupRef=AdcGroup_U0C8
            IoHwAbAdcGroup_U2C{5..7}: IoHwAbHwAdcGroupRef=AdcGroup_U2C{5..7}
      IoHwAbPrefixConfig
    IoHwAbConfig: IoHwAbUseDigitalDirect=1, IoHwAbUseGpt=1, IoHwAbUseAnalogInputDirect=1, IoHwAbUseOcu=0, IoHwAbUseIOManager=1, IoHwAbUsePwm=1, IoHwAbUseIcu=1
      IoHwAbDemEventParameterRefs:
        IOHWAB_E_WRONG_STATE = IOHWAB_E_WRONG_STATE
        IOHWAB_E_WRONG_SETTING = IOHWAB_E_WRONG_SETTING
        IOHWAB_E_WRONG_PARAM = IOHWAB_E_WRONG_PARAM
        IOHWAB_E_SETUP_FAIL = IOHWAB_E_SETUP_FAIL
        IOHWAB_E_PROC_FAIL = IOHWAB_E_PROC_FAIL
        IOHWAB_E_BUSY = IOHWAB_E_BUSY
      IoHwAbIOManager:
        IoHwAbUseLowPowerFlag = 0
        IoHwAbUsePmModule = 0
        IoHwAbUseAnalogInput = 1
        IoHwAbUseDigitalInput = 1
        IoHwAbUseDigitalOutput = 1
        IoHwAbUseInputSupplySwitch = 1
        IoHwAbUseVoltageMonitoring = 1
        IoHwAbMultipleActivationDelay = 200
        IoHwAbTaskFG1Ref = OsTask_BSW_FG1_IOManager
        IoHwAbTaskFG2Ref = OsTask_BSW_FG2_IOManager
        IoHwAbIOMTimer: IoHwAbGptChRef=GptChannelConfiguration_IOManager
        IoHwAbAnalogInput
          3 x IoHwAbAnalogInputLogical, all with IoHwAbDirectAccess=0, IoHwAbDefaultValue=0, IoHwAbFilterConstant=0:
            AnaIn_Battery_Real: IoHwAbAdcGroupRef=IoHwAbAdcGroupInAll_U0C6
            AnaIn_ACC_Real: IoHwAbAdcGroupRef=IoHwAbAdcGroupInAll_U0C8
            AnaIn_Thermistor: IoHwAbAdcGroupRef=IoHwAbAdcGroupInAll_U2C7
        IoHwAbInputSupplySwitch
        IoHwAbVoltageMonitoring: IoHwAbVoltageMonHysteresis=50, IoHwAbVoltageMonDefaultValue=700, IoHwAbVoltageMonFilter=128, IoHwAbVoltageMonAdcGroupRef=IoHwAbAdcGroup_U0C6
          IoHwAbVoltageMonThreshold0 (IoHwAbVoltageMonThreshold): IoHwAbVoltageMonThresholdValue=600
          IoHwAbVoltageMonThreshold1 (IoHwAbVoltageMonThreshold): IoHwAbVoltageMonThresholdValue=700
      IoHwAbDigitalDirect
        13 x IoHwAbDigitalDirectLogical:
          DigDir_SPI_CS: IoHwAbPortPinChRef=IoHwAbPortPinCh_PortPin_P000_3
          DigDir_NFC_INTERRUPT_INT: IoHwAbPortPinChRef=IoHwAbPortPinCh_PortPin_P002_1
          DigDir_NFC_OPTION: IoHwAbPortPinChRef=IoHwAbPortPinCh_PortPin_P006_0
          IoHwAbDigitalDirectLogical_BCAN_RX: IoHwAbPortPinChRef=IoHwAbPortPinCh_PortPin_P006_3
          DigDir_BCAN_WakeUp_INT: IoHwAbPortPinChRef=IoHwAbPortPinCh_PortPin_P006_5
          DigDir_LCAN_WakeUp_INT: IoHwAbPortPinChRef=IoHwAbPortPinCh_PortPin_P007_1
          IoHwAbDigitalDirectLogical_LOCALCAN_RX: IoHwAbPortPinChRef=IoHwAbPortPinCh_PortPin_P008_1
          DigDir_VN7140AS_MULTI: IoHwAbPortPinChRef=IoHwAbPortPinCh_PortPin_P012_1
          DigDir_VBATSW_EN: IoHwAbPortPinChRef=IoHwAbPortPinCh_PortPin_P018_0
          DigDir_P9450_INTB_INT: IoHwAbPortPinChRef=IoHwAbPortPinCh_PortPin_P018_1
          DigDir_FAN_DIAG: IoHwAbPortPinChRef=IoHwAbPortPinCh_PortPin_P021_0
          DigDir_VN7140AS_SEN: IoHwAbPortPinChRef=IoHwAbPortPinCh_PortPin_P022_0
          DigDir_VN7140AS_IN: IoHwAbPortPinChRef=IoHwAbPortPinCh_PortPin_P023_3
      IoHwAbAnalogInputDirect
        5 x IoHwAbAnalogInputDirectLogical:
          AnaInDir_Battery_Real: IoHwAbAdcGroupRef=IoHwAbAdcGroup_U0C6
          AnaInDir_ACC_Real: IoHwAbAdcGroupRef=IoHwAbAdcGroup_U0C8
          AnaInDir_Thermistor: IoHwAbAdcGroupRef=IoHwAbAdcGroup_U2C7
          AnaInDir_Thermistor2: IoHwAbAdcGroupRef=IoHwAbAdcGroup_U2C6
          AnaInDir_Thermistor3: IoHwAbAdcGroupRef=IoHwAbAdcGroup_U2C5
      IoHwAbGpt
        Gpt_NFC_TickTimer (IoHwAbGptLogical): IoHwAbGptCallbackViaRte=1, IoHwAbHwGptChRef=GptChannelConfiguration_NFCTickTimer
      IoHwAbIcu
        Icu_NFC_INTERRUPT (IoHwAbIcuLogical): IoHwAbIcuCallbackViaRte=1, IoHwAbHwIcuChRef=IcuChannel_NFC_INTERRUPT
        Icu_P9450_INTB (IoHwAbIcuLogical): IoHwAbIcuCallbackViaRte=1, IoHwAbHwIcuChRef=IcuChannel_P9450_INTB
      IoHwAbPwm
        5 x IoHwAbPwmLogical, all with IoHwAbPwmCallbackViaRte=0:
          Pwm_AMBER_IND_OUT: IoHwAbHwPwmChRef=PwmChannel_AMBER_IND_OUT
          Pwm_GREEN_IND_OUT{1..3}: IoHwAbHwPwmChRef=PwmChannel_GREEN_IND_OUT{1..3}
          Pwm_FAN_OUT: IoHwAbHwPwmChRef=PwmChannel_FAN_OUT

AUTOSAR XML (schema 4-0-3)
package /AUTOSAR
  module config CanTp: implementation-config-variant=VARIANT-PRE-COMPILE, module-description=BswImplementation_CanTp
    CanTpGeneral:
      CanTpDevErrorDetect = 1
      CanTpPaddingByte = 0xAA
      CanTpReadParameterApi = 0
      CanTpVersionInfoApi = 0
      CanTpChangeParameterApi = 0
      CanTpFlexibleDataRateSupport = 0
    CanTpConfig: CanTpMainFunctionPeriod=0.005
      3 x CanTpChannel, all with category=TOOL_CONFIGURED, CanTpChannelMode=CANTP_MODE_HALF_DUPLEX:
        CanTpChannel_1_Pdu_ISignalIPdu_LOCALCAN_TP_BDC_C_WPC
          CanTpRxNSdu_1_Pdu_ISignalIPdu_LOCALCAN_TP_BDC_C_WPC (CanTpRxNSdu):
            category = TOOL_CONFIGURED
            CanTpRxPaddingActivation = CANTP_ON
            CanTpRxAddressingFormat = CANTP_STANDARD
            CanTpRxTaType = CANTP_PHYSICAL
            CanTpRxNSduId = 1
            CanTpRxDl = 1
            CanTpNcr = 1
            CanTpSTmin = 0.005
            CanTpBs = 0
            CanTpNar = 1
            CanTpNbr = 0
            CanTpRxWftMax = 0
            CanTpRxNSduRef = Pdu_ISignalIPdu_LOCALCAN_TP_BDC_C_WPC
            CanTpTxFcNPdu_1 (CanTpTxFcNPdu): category=TOOL_CONFIGURED, CanTpTxFcNPduConfirmationPduId=1, CanTpTxFcNPduRef=Pdu_NPdu_LOCALCAN_TP_WPC_C_BDC
            CanTpRxNPdu_1 (CanTpRxNPdu): category=TOOL_CONFIGURED, CanTpRxNPduId=1, CanTpRxNPduRef=Pdu_NPdu_LOCALCAN_TP_BDC_C_WPC
            CanTpNSa_1 (CanTpNSa): category=TOOL_CONFIGURED, CanTpNSa=8
            CanTpNTa_1 (CanTpNTa): category=TOOL_CONFIGURED, CanTpNTa=240
          CanTpTxNSdu_1_Pdu_ISignalIPdu_LOCALCAN_TP_WPC_C_BDC (CanTpTxNSdu):
            category = TOOL_CONFIGURED
            CanTpTxAddressingFormat = CANTP_STANDARD
            CanTpTxPaddingActivation = CANTP_ON
            CanTpTxDl = 1
            CanTpTxNSduId = 1
            CanTpTc = 1
            CanTpTxTaType = CANTP_PHYSICAL
            CanTpNcs = 0
            CanTpNbs = 1
            CanTpNas = 1
            CanTpTxNSduRef = Pdu_ISignalIPdu_LOCALCAN_TP_WPC_C_BDC
            CanTpTxNPdu_1 (CanTpTxNPdu): category=TOOL_CONFIGURED, CanTpTxNPduConfirmationPduId=1, CanTpTxNPduRef=Pdu_NPdu_LOCALCAN_TP_WPC_C_BDC
            CanTpRxFcNPdu_1 (CanTpRxFcNPdu): category=TOOL_CONFIGURED, CanTpRxFcNPduId=1, CanTpRxFcNPduRef=Pdu_NPdu_LOCALCAN_TP_BDC_C_WPC
            CanTpNSa_1 (CanTpNSa): category=TOOL_CONFIGURED, CanTpNSa=8
            CanTpNTa_1 (CanTpNTa): category=TOOL_CONFIGURED, CanTpNTa=240
        CanTpChannel_2_RxOnly_Pdu_DcmIPdu_BCAN_GST_ALL
          CanTpRxNSdu_2_Pdu_DcmIPdu_BCAN_GST_ALL (CanTpRxNSdu):
            category = TOOL_CONFIGURED
            CanTpRxPaddingActivation = CANTP_ON
            CanTpRxAddressingFormat = CANTP_STANDARD
            CanTpRxTaType = CANTP_FUNCTIONAL
            CanTpRxNSduId = 2
            CanTpRxDl = 1
            CanTpBs = 0
            CanTpNar = 1
            CanTpRxWftMax = 0
            CanTpSTmin = 0.005
            CanTpNcr = 1
            CanTpNbr = 0
            CanTpRxNSduRef = Pdu_DcmIPdu_BCAN_GST_ALL
            CanTpRxNPdu_2 (CanTpRxNPdu): category=TOOL_CONFIGURED, CanTpRxNPduId=2, CanTpRxNPduRef=Pdu_NPdu_BCAN_GST_ALL
            CanTpNSa_2 (CanTpNSa): category=TOOL_CONFIGURED, CanTpNSa=8
            CanTpNTa_2 (CanTpNTa): category=TOOL_CONFIGURED, CanTpNTa=240
        CanTpChannel_0_Pdu_DcmIPdu_BCAN_GST_RWPC
          CanTpTxNSdu_0_Pdu_DcmIPdu_BCAN_RWPC_GST (CanTpTxNSdu):
            category = TOOL_CONFIGURED
            CanTpTxAddressingFormat = CANTP_STANDARD
            CanTpTxPaddingActivation = CANTP_ON
            CanTpTxDl = 1
            CanTpTxNSduId = 0
            CanTpTc = 1
            CanTpTxTaType = CANTP_PHYSICAL
            CanTpNbs = 1
            CanTpNas = 1
            CanTpNcs = 0
            CanTpTxNSduRef = Pdu_DcmIPdu_BCAN_RWPC_GST
            CanTpTxNPdu_0 (CanTpTxNPdu): category=TOOL_CONFIGURED, CanTpTxNPduConfirmationPduId=0, CanTpTxNPduRef=Pdu_NPdu_BCAN_RWPC_GST
            CanTpRxFcNPdu_0 (CanTpRxFcNPdu): category=TOOL_CONFIGURED, CanTpRxFcNPduId=0, CanTpRxFcNPduRef=Pdu_NPdu_BCAN_GST_RWPC
            CanTpNSa_0 (CanTpNSa): category=TOOL_CONFIGURED, CanTpNSa=8
            CanTpNTa_0 (CanTpNTa): category=TOOL_CONFIGURED, CanTpNTa=240
          CanTpRxNSdu_0_Pdu_DcmIPdu_BCAN_GST_RWPC (CanTpRxNSdu):
            category = TOOL_CONFIGURED
            CanTpRxPaddingActivation = CANTP_ON
            CanTpRxAddressingFormat = CANTP_STANDARD
            CanTpRxTaType = CANTP_PHYSICAL
            CanTpRxNSduId = 0
            CanTpRxDl = 1
            CanTpNcr = 1
            CanTpBs = 0
            CanTpNar = 1
            CanTpNbr = 0
            CanTpSTmin = 0.005
            CanTpRxWftMax = 0
            CanTpRxNSduRef = Pdu_DcmIPdu_BCAN_GST_RWPC
            CanTpTxFcNPdu_0 (CanTpTxFcNPdu): category=TOOL_CONFIGURED, CanTpTxFcNPduConfirmationPduId=0, CanTpTxFcNPduRef=Pdu_NPdu_BCAN_RWPC_GST
            CanTpRxNPdu_0 (CanTpRxNPdu): category=TOOL_CONFIGURED, CanTpRxNPduId=0, CanTpRxNPduRef=Pdu_NPdu_BCAN_GST_RWPC
            CanTpNSa_0 (CanTpNSa): category=TOOL_CONFIGURED, CanTpNSa=8
            CanTpNTa_0 (CanTpNTa): category=TOOL_CONFIGURED, CanTpNTa=240

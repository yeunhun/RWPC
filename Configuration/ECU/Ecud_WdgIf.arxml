AUTOSAR XML (schema 4-0-3)
package /AUTOSAR
  module config WdgIf: implementation-config-variant=VARIANT-PRE-COMPILE, module-description=BswImplementation_WdgIf
    WdgIfGeneral: WdgIfDevErrorDetect=1, WdgIfVersionInfoApi=0
    WdgIfDevice_Int (WdgIfDevice): WdgIfDeviceIndex=0, WdgIfDriverRef=WdgGeneral
    WdgIfDevice_Ext (WdgIfDevice): WdgIfDeviceIndex=1, WdgIfDriverRef=WdgGeneral

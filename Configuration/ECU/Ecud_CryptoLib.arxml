AUTOSAR XML (schema 4-3-0)
package /AUTOSAR
  module config CryptoLib: implementation-config-variant=VARIANT-PRE-COMPILE, module-description=BswImplementation_CryptoLib
    CryptoLibGeneral: CryptoLibSupportHsm=HAE_HSM_2_X

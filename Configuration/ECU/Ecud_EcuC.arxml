AUTOSAR XML (schema 4-0-3)
package /AUTOSAR
  module config EcuC: implementation-config-variant=VARIANT-POST-BUILD
    EcucPduCollection: PduIdTypeEnum=UINT8, PduLengthTypeEnum=UINT16
      82 x Pdu, all with category=TOOL_CONFIGURED:
        Pdu_ISignalIPdu_BCAN_BCM_07_200ms: PduLength=8, SysTPduToFrameMappingRef=PduToFrame_BCAN_BCM_07_200ms
        Pdu_ISignalIPdu_BCAN_BCM_12_200ms: PduLength=8, SysTPduToFrameMappingRef=PduToFrame_BCAN_BCM_12_200ms
        Pdu_ISignalIPdu_BCAN_CLU_01_20ms_1: PduLength=8, SysTPduToFrameMappingRef=PduToFrame_BCAN_CLU_01_20ms_1
        Pdu_ISignalIPdu_BCAN_CLU_01_20ms_2: PduLength=8, SysTPduToFrameMappingRef=PduToFrame_BCAN_CLU_01_20ms_2
        Pdu_ISignalIPdu_BCAN_EMS_02_10ms_1: PduLength=8, SysTPduToFrameMappingRef=PduToFrame_BCAN_EMS_02_10ms_1
        Pdu_ISignalIPdu_BCAN_EMS_07_10ms_2: PduLength=8, SysTPduToFrameMappingRef=PduToFrame_BCAN_EMS_07_10ms_2
        Pdu_DcmIPdu_BCAN_GST_ALL: PduLength=8, SysTPduToFrameMappingRef=PduToFrame_BCAN_GST_ALL
        Pdu_NPdu_BCAN_GST_ALL: PduLength=8, SysTPduToFrameMappingRef=MapNPdu_BCAN_GST_ALL
        Pdu_ISignalIPdu_BCAN_HCU_03_10ms_2: PduLength=8, SysTPduToFrameMappingRef=PduToFrame_BCAN_HCU_03_10ms_2
        Pdu_ISignalIPdu_BCAN_HU_GW_PE_01: PduLength=8, SysTPduToFrameMappingRef=PduToFrame_BCAN_HU_GW_PE_01
        Pdu_ISignalIPdu_BCAN_HU_USM_E_02: PduLength=8, SysTPduToFrameMappingRef=PduToFrame_BCAN_HU_USM_E_02
        Pdu_ISignalIPdu_BCAN_HU_USM_E_04: PduLength=8, SysTPduToFrameMappingRef=PduToFrame_BCAN_HU_USM_E_04
        Pdu_ISignalIPdu_BCAN_IAU_16_200ms: PduLength=8, SysTPduToFrameMappingRef=PduToFrame_BCAN_IAU_16_200ms
        Pdu_ISignalIPdu_BCAN_ICU_02_200ms: PduLength=8, SysTPduToFrameMappingRef=PduToFrame_BCAN_ICU_02_200ms
        Pdu_UserDefinedPdu_BCAN_NM_ALBCU: PduLength=8, SysTPduToFrameMappingRef=PduToFrame_BCAN_NM_ALBCU
        Pdu_UserDefinedPdu_BCAN_NM_ASAU: PduLength=8, SysTPduToFrameMappingRef=PduToFrame_BCAN_NM_ASAU
        Pdu_UserDefinedPdu_BCAN_NM_ATS: PduLength=8, SysTPduToFrameMappingRef=PduToFrame_BCAN_NM_ATS
        Pdu_UserDefinedPdu_BCAN_NM_BLTN_CAM: PduLength=8, SysTPduToFrameMappingRef=PduToFrame_BCAN_NM_BLTN_CAM
        Pdu_UserDefinedPdu_BCAN_NM_CGW_CCU: PduLength=8, SysTPduToFrameMappingRef=PduToFrame_BCAN_NM_CGW_CCU
        Pdu_UserDefinedPdu_BCAN_NM_DSAU: PduLength=8, SysTPduToFrameMappingRef=PduToFrame_BCAN_NM_DSAU
        Pdu_UserDefinedPdu_BCAN_NM_EMCU: PduLength=8, SysTPduToFrameMappingRef=PduToFrame_BCAN_NM_EMCU
        Pdu_UserDefinedPdu_BCAN_NM_FCS: PduLength=8, SysTPduToFrameMappingRef=PduToFrame_BCAN_NM_FCS
        Pdu_UserDefinedPdu_BCAN_NM_HOD: PduLength=8, SysTPduToFrameMappingRef=PduToFrame_BCAN_NM_HOD
        Pdu_UserDefinedPdu_BCAN_NM_OHCL: PduLength=8, SysTPduToFrameMappingRef=PduToFrame_BCAN_NM_OHCL
        Pdu_UserDefinedPdu_BCAN_NM_PFSU: PduLength=8, SysTPduToFrameMappingRef=PduToFrame_BCAN_NM_PFSU
        Pdu_UserDefinedPdu_BCAN_NM_PSB: PduLength=8, SysTPduToFrameMappingRef=PduToFrame_BCAN_NM_PSB
        Pdu_UserDefinedPdu_BCAN_NM_RCM: PduLength=8, SysTPduToFrameMappingRef=PduToFrame_BCAN_NM_RCM
        Pdu_UserDefinedPdu_BCAN_NM_RCS: PduLength=8, SysTPduToFrameMappingRef=PduToFrame_BCAN_NM_RCS
        Pdu_UserDefinedPdu_BCAN_NM_RLHV: PduLength=8, SysTPduToFrameMappingRef=PduToFrame_BCAN_NM_RLHV
        Pdu_UserDefinedPdu_BCAN_NM_RRHV: PduLength=8, SysTPduToFrameMappingRef=PduToFrame_BCAN_NM_RRHV
        Pdu_UserDefinedPdu_BCAN_NM_RWPC: PduLength=8, SysTPduToFrameMappingRef=PduToFrame_BCAN_NM_RWPC
        Pdu_UserDefinedPdu_BCAN_NM_SCM: PduLength=8, SysTPduToFrameMappingRef=PduToFrame_BCAN_NM_SCM
        Pdu_UserDefinedPdu_BCAN_NM_SGU: PduLength=8, SysTPduToFrameMappingRef=PduToFrame_BCAN_NM_SGU
        Pdu_UserDefinedPdu_BCAN_NM_SHVU_FR: PduLength=8, SysTPduToFrameMappingRef=PduToFrame_BCAN_NM_SHVU_FR
        Pdu_UserDefinedPdu_BCAN_NM_SHVU_RR: PduLength=8, SysTPduToFrameMappingRef=PduToFrame_BCAN_NM_SHVU_RR
        Pdu_UserDefinedPdu_BCAN_NM_SLB: PduLength=8, SysTPduToFrameMappingRef=PduToFrame_BCAN_NM_SLB
        Pdu_UserDefinedPdu_BCAN_NM_SWRC: PduLength=8, SysTPduToFrameMappingRef=PduToFrame_BCAN_NM_SWRC
        Pdu_UserDefinedPdu_BCAN_NM_WPC: PduLength=8, SysTPduToFrameMappingRef=PduToFrame_BCAN_NM_WPC
        Pdu_ISignalIPdu_BCAN_SBCM_AST_02_200ms: PduLength=8, SysTPduToFrameMappingRef=PduToFrame_BCAN_SBCM_AST_02_200ms
        Pdu_ISignalIPdu_BCAN_SBCM_DRV_01_200ms: PduLength=8, SysTPduToFrameMappingRef=PduToFrame_BCAN_SBCM_DRV_01_200ms
        Pdu_ISignalIPdu_BCAN_SBCM_RL_01_200ms: PduLength=8, SysTPduToFrameMappingRef=PduToFrame_BCAN_SBCM_RL_01_200ms
        Pdu_ISignalIPdu_BCAN_SBCM_RR_01_200ms: PduLength=8, SysTPduToFrameMappingRef=PduToFrame_BCAN_SBCM_RR_01_200ms
        Pdu_ISignalIPdu_BCAN_SMK_06_200ms: PduLength=8, SysTPduToFrameMappingRef=PduToFrame_BCAN_SMK_06_200ms
        Pdu_ISignalIPdu_BCAN_VCU_01_10ms_1: PduLength=8, SysTPduToFrameMappingRef=PduToFrame_BCAN_VCU_01_10ms_1
        Pdu_ISignalIPdu_LOCALCAN_BDC_01: PduLength=8, SysTPduToFrameMappingRef=PduToFrame_LOCALCAN_BDC_01
        Pdu_ISignalIPdu_LOCALCAN_BDC_10: PduLength=8, SysTPduToFrameMappingRef=PduToFrame_LOCALCAN_BDC_10
        Pdu_UserDefinedPdu_LOCALCAN_NM_BDC: PduLength=8, SysTPduToFrameMappingRef=PduToFrame_LOCALCAN_NM_BDC
        Pdu_UserDefinedPdu_LOCALCAN_NM_DHL: PduLength=8, SysTPduToFrameMappingRef=PduToFrame_LOCALCAN_NM_DHL
        Pdu_UserDefinedPdu_LOCALCAN_NM_DHR: PduLength=8, SysTPduToFrameMappingRef=PduToFrame_LOCALCAN_NM_DHR
        Pdu_UserDefinedPdu_LOCALCAN_NM_Devtool: PduLength=8, SysTPduToFrameMappingRef=PduToFrame_LOCALCAN_NM_Devtool
        Pdu_UserDefinedPdu_LOCALCAN_NM_ROA: PduLength=8, SysTPduToFrameMappingRef=PduToFrame_LOCALCAN_NM_ROA
        Pdu_UserDefinedPdu_LOCALCAN_NM_UWB_BLE: PduLength=8, SysTPduToFrameMappingRef=PduToFrame_LOCALCAN_NM_UWB_BLE
        Pdu_UserDefinedPdu_LOCALCAN_NM_UWB_FL: PduLength=8, SysTPduToFrameMappingRef=PduToFrame_LOCALCAN_NM_UWB_FL
        Pdu_UserDefinedPdu_LOCALCAN_NM_UWB_FR: PduLength=8, SysTPduToFrameMappingRef=PduToFrame_LOCALCAN_NM_UWB_FR
        Pdu_UserDefinedPdu_LOCALCAN_NM_UWB_INT: PduLength=8, SysTPduToFrameMappingRef=PduToFrame_LOCALCAN_NM_UWB_INT
        Pdu_UserDefinedPdu_LOCALCAN_NM_UWB_RL: PduLength=8, SysTPduToFrameMappingRef=PduToFrame_LOCALCAN_NM_UWB_RL
        Pdu_UserDefinedPdu_LOCALCAN_NM_UWB_RR: PduLength=8, SysTPduToFrameMappingRef=PduToFrame_LOCALCAN_NM_UWB_RR
        Pdu_UserDefinedPdu_LOCALCAN_NM_UWB_TRNK: PduLength=8, SysTPduToFrameMappingRef=PduToFrame_LOCALCAN_NM_UWB_TRNK
        Pdu_UserDefinedPdu_LOCALCAN_NM_WPC: PduLength=8, SysTPduToFrameMappingRef=PduToFrame_LOCALCAN_NM_WPC
        Pdu_ISignalIPdu_LOCALCAN_TP_BDC_C_WPC: PduLength=512, SysTPduToFrameMappingRef=PduToFrame_LOCALCAN_TP_BDC_C_WPC
        Pdu_NPdu_LOCALCAN_TP_BDC_C_WPC: PduLength=8, SysTPduToFrameMappingRef=MapNPdu_LOCALCAN_TP_BDC_C_WPC
        Pdu_ISignalIPdu_LOCALCAN_TP_WPC_C_BDC: PduLength=512, SysTPduToFrameMappingRef=PduToFrame_LOCALCAN_TP_WPC_C_BDC
        Pdu_NPdu_LOCALCAN_TP_WPC_C_BDC: PduLength=8, SysTPduToFrameMappingRef=MapNPdu_LOCALCAN_TP_WPC_C_BDC
        Pdu_ISignalIPdu_LOCALCAN_WPC_01: PduLength=8, SysTPduToFrameMappingRef=PduToFrame_LOCALCAN_WPC_01
        Pdu_ISignalIPdu_LOCALCAN_WPC_10: PduLength=8, SysTPduToFrameMappingRef=PduToFrame_LOCALCAN_WPC_10
        Pdu_UserDefinedPdu_BCAN_NM_ARS: PduLength=8, SysTPduToFrameMappingRef=PduToFrame_BCAN_NM_ARS
        Pdu_UserDefinedPdu_BCAN_NM_WPC2: PduLength=8, SysTPduToFrameMappingRef=PduToFrame_BCAN_NM_WPC2
        Pdu_UserDefinedPdu_LOCALCAN_NM_UWB_FRNK: PduLength=8, SysTPduToFrameMappingRef=PduToFrame_LOCALCAN_NM_UWB_FRNK
        Pdu_ISignalIPdu_BCAN_RWPC_01_200ms: PduLength=8, SysTPduToFrameMappingRef=PduToFrame_BCAN_RWPC_01_200ms
        Pdu_ISignalIPdu_BCAN_ATS_00_00ms: PduLength=8, SysTPduToFrameMappingRef=PduToFrame_BCAN_ATS_00_00ms
        Pdu_DcmIPdu_BCAN_GST_RWPC: PduLength=8, SysTPduToFrameMappingRef=PduToFrame_BCAN_GST_RWPC
        Pdu_NPdu_BCAN_GST_RWPC: PduLength=8, SysTPduToFrameMappingRef=MapNPdu_BCAN_GST_RWPC
        Pdu_DcmIPdu_BCAN_RWPC_GST: PduLength=8, SysTPduToFrameMappingRef=PduToFrame_BCAN_RWPC_GST
        Pdu_NPdu_BCAN_RWPC_GST: PduLength=8, SysTPduToFrameMappingRef=MapNPdu_BCAN_RWPC_GST
        Pdu_ISignalIPdu_BCAN_WPC2_01_200ms: PduLength=8, SysTPduToFrameMappingRef=PduToFrame_BCAN_WPC2_01_200ms
        Pdu_ISignalIPdu_BCAN_WPC_01_200ms: PduLength=8, SysTPduToFrameMappingRef=PduToFrame_BCAN_WPC_01_200ms
        Pdu_ISignalIPdu_BCAN_HU_USM_E_14: PduLength=8, SysTPduToFrameMappingRef=PduToFrame_BCAN_HU_USM_E_14
        Pdu_UserDefinedPdu_BCAN_NM_GW_APSU: PduLength=8, SysTPduToFrameMappingRef=PduToFrame_BCAN_NM_GW_APSU
        Pdu_UserDefinedPdu_BCAN_NM_GW_DLBCU: PduLength=8, SysTPduToFrameMappingRef=PduToFrame_BCAN_NM_GW_DLBCU
        Pdu_UserDefinedPdu_BCAN_NM_GW_DPSU: PduLength=8, SysTPduToFrameMappingRef=PduToFrame_BCAN_NM_GW_DPSU
        Pdu_UserDefinedPdu_BCAN_NM_GW_RLPSU: PduLength=8, SysTPduToFrameMappingRef=PduToFrame_BCAN_NM_GW_RLPSU
        Pdu_UserDefinedPdu_BCAN_NM_GW_RRPSU: PduLength=8, SysTPduToFrameMappingRef=PduToFrame_BCAN_NM_GW_RRPSU
    EcucPartitionCollection

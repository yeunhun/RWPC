AUTOSAR XML (schema 4-0-3)
package /AUTOSAR
  module config Wdg_76_Acw: definition=Wdg, implementation-config-variant=VARIANT-PRE-COMPILE, module-description=BswImplementation_Wdg_76_Acw
    WdgGeneral:
      WdgDevErrorDetect = 1
      WdgDisableAllowed = 0
      WdgIndex = 1
      WdgInitialTimeout = 4.0
      WdgMaxTimeout = 4.2
      WdgRunArea = ROM
      WdgVersionInfoApi = 1
      WdgVendorMcalVersion = CYPRESS_Traveo2
    WdgSettingsConfig: WdgDefaultMode=WDGIF_SLOW_MODE, WdgDioChannelPrefix=DioConf_DioChannel_, WdgGptChannelPrefix=GptConf_GptChannelConfiguration_
      WdgSettingsOff
      WdgSettingsSlow: WdgPeriod=0.045
      WdgSettingsFast: WdgPeriod=0.045
      WdgExternalConfiguration: WdgGptChannelRef=GptChannelConfiguration_WdgExt
        WdgExternalDevice
          WdgDioTrigger: WdgDioTriggerDuty=50, WdgDioTriggerChannelRef=DioChannel_P005_1
    WdgPublishedInformation: WdgTriggerMode=WDG_TOGGLE
    WdgDemEventParameterRefs

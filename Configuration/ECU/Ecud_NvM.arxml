AUTOSAR XML (schema 4-0-3)
package /AUTOSAR
  module config NvM: implementation-config-variant=VARIANT-PRE-COMPILE, module-description=BswImplementation_NvM
    6 x NvMBlockDescriptor, all with NvMBlockCrcType=NVM_CRC16, NvMBlockJobPriority=1, NvMBlockManagementType=NVM_BLOCK_REDUNDANT, NvMBlockUseCrc=1, NvMBlockUseSyncMechanism=0, NvMBlockWriteProt=0, NvMBswMBlockStatusInformation=0, NvMCalcRamBlockCrc=1, NvMMaxNumOfReadRetries=1, NvMMaxNumOfWriteRetries=1, NvMNvBlockNum=2, NvMNvramDeviceId=0, NvMResistantToChangedSw=0, NvMRomBlockNum=0, NvMSelectBlockForReadAll=1, NvMSelectBlockForWriteAll=1, NvMStaticBlockIDCheck=0, NvMWriteBlockOnce=0, NvMDefaultROMCRCEnabled=0:
      NvMBlock_ConfigID: NvMNvBlockBaseNumber=1, NvMNvBlockLength=2, NvMNvramBlockIdentifier=1, NvMRamBlockDataAddress=ConfigIDRamBlock, NvMWriteVerification=1, NvMWriteVerificationDataSize=2
        NvMTargetBlockReference
          NvMFeeRef: NvMNameOfFeeBlock=FeeBlock_ConfigID
      NvMBlock_DemNonVolatileData: NvMNvBlockBaseNumber=2, NvMNvBlockLength=10, NvMNvramBlockIdentifier=2, NvMRamBlockDataAddress=Dem_NonVolatileData, NvMWriteVerification=0, NvMWriteVerificationDataSize=10
        NvMTargetBlockReference
          NvMFeeRef: NvMNameOfFeeBlock=FeeBlock_DemNonVolatileData
      NvMBlock_DemEventStatusNvRamBlock: NvMNvBlockBaseNumber=3, NvMNvBlockLength=6, NvMNvramBlockIdentifier=3, NvMWriteVerification=0, NvMWriteVerificationDataSize=6, NvMRamBlockDataAddress=Dem_EventStatusNvRamData
        NvMTargetBlockReference
          NvMFeeRef: NvMNameOfFeeBlock=FeeBlock_DemEventStatusNvRamBlock
      NvMBlock_DemPrimaryEventMemory_0: NvMWriteVerification=0, NvMWriteVerificationDataSize=14, NvMNvBlockBaseNumber=4, NvMNvBlockLength=14, NvMNvramBlockIdentifier=4, NvMRamBlockDataAddress=Dem_PrimaryEventMemory[0]
        NvMTargetBlockReference
          NvMFeeRef: NvMNameOfFeeBlock=FeeBlock_DemPrimaryEventMemory_0
      NvMBlock_DemPrimaryEventMemory_1: NvMWriteVerification=0, NvMWriteVerificationDataSize=14, NvMNvBlockBaseNumber=5, NvMNvBlockLength=14, NvMNvramBlockIdentifier=5, NvMRamBlockDataAddress=Dem_PrimaryEventMemory[1]
        NvMTargetBlockReference
          NvMFeeRef: NvMNameOfFeeBlock=FeeBlock_DemPrimaryEventMemory_1
      NvMBlock_DemPrimaryEventMemory_2: NvMWriteVerification=0, NvMWriteVerificationDataSize=14, NvMNvBlockBaseNumber=6, NvMNvBlockLength=14, NvMNvramBlockIdentifier=6, NvMRamBlockDataAddress=Dem_PrimaryEventMemory[2]
        NvMTargetBlockReference
          NvMFeeRef: NvMNameOfFeeBlock=FeeBlock_DemPrimaryEventMemory_2
    NvMCommon:
      NvMApiConfigClass = NVM_API_CONFIG_CLASS_3
      NvMBswMMultiBlockJobStatusInformation = 1
      NvMCompiledConfigId = 20
      NvMCrcNumOfBytes = 4
      NvMDatasetSelectionBits = 2
      NvMDevErrorDetect = 1
      NvMDrvModeSwitch = 1
      NvMDynamicConfiguration = 0
      NvMJobPrioritization = 1
      NvMMultiBlockCallback = BswM_NvM_CurrentJobMode
      NvMPollingMode = 0
      NvMRepeatMirrorOperations = 0
      NvMSetRamBlockStatusApi = 0
      NvMSizeImmediateJobQueue = 20
      NvMSizeStandardJobQueue = 20
      NvMMainFunctionCallCycle = 0.005
      NvMVersionInfoApi = 0
      NvMMainfunctionTriggerRef = OsAlarm_BSW_Mem_Process
      NvMUserIncludeFiles: NvMUserIncludeFile=Dem_Ram.h, NvMUserIncludeFile=Mem_Integration.h, NvMUserIncludeFile=App_NvM_RamBlock.h
    NvMDemEventParameterRefs_0 (NvMDemEventParameterRefs):
      NVM_E_INTEGRITY_FAILED = NVM_E_INTEGRITY_FAILED
      NVM_E_LOSS_OF_REDUNDANCY = NVM_E_LOSS_OF_REDUNDANCY
      NVM_E_QUEUE_OVERFLOW = NVM_E_QUEUE_OVERFLOW
      NVM_E_REQ_FAILED = NVM_E_REQ_FAILED
      NVM_E_VERIFY_FAILED = NVM_E_VERIFY_FAILED
      NVM_E_WRITE_PROTECTED = NVM_E_WRITE_PROTECTED
      NVM_E_WRONG_BLOCK_ID = NVM_E_WRONG_BLOCK_ID
    7 x NvMBlockDescriptor, all with NvMBlockManagementType=NVM_BLOCK_REDUNDANT, NvMNvBlockNum=2, NvMBlockCrcType=NVM_CRC16, NvMBlockUseCrc=1, NvMCalcRamBlockCrc=1, NvMBlockJobPriority=1, NvMSelectBlockForReadAll=1, NvMSelectBlockForWriteAll=1, NvMRomBlockNum=0, NvMResistantToChangedSw=0, NvMWriteBlockOnce=0, NvMBlockWriteProt=0, NvMStaticBlockIDCheck=0, NvMWriteVerification=0, NvMNvramDeviceId=0, NvMDefaultROMCRCEnabled=0, NvMBswMBlockStatusInformation=0, NvMBlockUseSyncMechanism=0, NvMMaxNumOfReadRetries=3, NvMMaxNumOfWriteRetries=3:
      NvMBlock_Option: NvMNvBlockBaseNumber=7, NvMNvramBlockIdentifier=7, NvMNvBlockLength=8, NvMWriteVerificationDataSize=8, NvMRamBlockDataAddress=rub_Option, NvMSingleBlockCallback=Rte_Call_NvM_PNJF_NvMBlock_Option_JobFinished
        NvMTargetBlockReference
          NvMFeeRef: NvMNameOfFeeBlock=FeeBlock_Option
      NvMBlock_Function: NvMNvBlockBaseNumber=8, NvMNvramBlockIdentifier=8, NvMNvBlockLength=16, NvMWriteVerificationDataSize=16, NvMRamBlockDataAddress=rub_Function, NvMSingleBlockCallback=Rte_Call_NvM_PNJF_NvMBlock_Function_JobFinished
        NvMTargetBlockReference
          NvMFeeRef: NvMNameOfFeeBlock=FeeBlock_Function
      NvMBlock_DTCInfo: NvMNvBlockBaseNumber=9, NvMNvramBlockIdentifier=9, NvMNvBlockLength=8, NvMWriteVerificationDataSize=8, NvMRamBlockDataAddress=rub_DTCInfo, NvMSingleBlockCallback=Rte_Call_NvM_PNJF_NvMBlock_DTCInfo_JobFinished
        NvMTargetBlockReference
          NvMFeeRef: NvMNameOfFeeBlock=FeeBlock_DTCInfo
      NvMBlock_SerialNO: NvMNvBlockBaseNumber=10, NvMNvramBlockIdentifier=10, NvMNvBlockLength=24, NvMWriteVerificationDataSize=24, NvMRamBlockDataAddress=rub_SerialNO, NvMSingleBlockCallback=Rte_Call_NvM_PNJF_NvMBlock_SerialNO_JobFinished
        NvMTargetBlockReference
          NvMFeeRef: NvMNameOfFeeBlock=FeeBlock_SerialNO
      NvMBlock_MDate: NvMNvBlockBaseNumber=11, NvMNvramBlockIdentifier=11, NvMNvBlockLength=8, NvMWriteVerificationDataSize=8, NvMRamBlockDataAddress=rub_MDate, NvMSingleBlockCallback=Rte_Call_NvM_PNJF_NvMBlock_MDate_JobFinished
        NvMTargetBlockReference
          NvMFeeRef: NvMNameOfFeeBlock=FeeBlock_MDate
      NvMBlock_PartNO: NvMNvBlockBaseNumber=12, NvMNvramBlockIdentifier=12, NvMNvBlockLength=16, NvMWriteVerificationDataSize=16, NvMRamBlockDataAddress=rub_PartNO, NvMSingleBlockCallback=Rte_Call_NvM_PNJF_NvMBlock_PartNO_JobFinished
        NvMTargetBlockReference
          NvMFeeRef: NvMNameOfFeeBlock=FeeBlock_PartNO
      NvMBlock_Dummy: NvMNvBlockBaseNumber=13, NvMNvramBlockIdentifier=13, NvMNvBlockLength=16, NvMWriteVerificationDataSize=16, NvMRamBlockDataAddress=rub_Dummy, NvMSingleBlockCallback=Rte_Call_NvM_PNJF_NvMBlock_Dummy_JobFinished
        NvMTargetBlockReference
          NvMFeeRef: NvMNameOfFeeBlock=FeeBlock_Dummy

AUTOSAR XML (schema 4-2-1)
package /AUTOSAR
  module config OsImp: implementation-config-variant=VARIANT-PRE-COMPILE, module-description=BswImplementation_OsImp
    OsImpGeneral: OsImpOpfUsed=1, OsImpErrmUsed=0, OsImpDebugStackdepth=1, OsImpCpuLoad=1
    OsImpConfiguration
      SRAM (OsImpRamSector): OsImpRamSectionSize=0x2F800, OsImpRamInitProperty=PowerOnReset, OsImpRamSectionBaseAddress=0x08010000, OsImpRamDefaultValue=0

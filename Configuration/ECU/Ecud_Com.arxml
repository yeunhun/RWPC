AUTOSAR XML (schema 4-0-3)
package /AUTOSAR
  module config Com: implementation-config-variant=VARIANT-PRE-COMPILE, module-description=BswImplementation_Com
    ComConfig: ComConfigurationId=0
      ComTimeBase: category=TOOL_CONFIGURED, ComGwTimeBase=0.005, ComRxTimeBase=0.005, ComTxTimeBase=0.005
      4 x ComIPduGroup, all with category=TOOL_CONFIGURED:
        ComIPduGroupRx_SCM_BCAN: ComIPduGroupHandleId=0
        ComIPduGroupTx_SCM_BCAN: ComIPduGroupHandleId=1
        ComIPduGroupRx_SCM_LOCALCAN: ComIPduGroupHandleId=2
        ComIPduGroupTx_SCM_LOCALCAN: ComIPduGroupHandleId=3
      24 x ComIPdu, all with category=TOOL_CONFIGURED, ComIPduSignalProcessing=DEFERRED:
        ComIPdu_BCAN_SMK_06_200ms: ComIPduDirection=RECEIVE, ComIPduHandleId=0, ComIPduType=NORMAL, ComIPduSignalRef=ComISignal_BCAN_SMK_06_200ms_LFAnt_SrchSta, ComPduIdRef=Pdu_ISignalIPdu_BCAN_SMK_06_200ms, ComIPduGroupRef=ComIPduGroupRx_SCM_BCAN
        ComIPdu_BCAN_BCM_12_200ms: ComIPduDirection=RECEIVE, ComIPduHandleId=1, ComIPduType=NORMAL, ComIPduSignalRef=ComISignal_BCAN_BCM_12_200ms_BCM_SmkOptTyp, ComPduIdRef=Pdu_ISignalIPdu_BCAN_BCM_12_200ms, ComIPduGroupRef=ComIPduGroupRx_SCM_BCAN
        ComIPdu_BCAN_EMS_02_10ms_1: ComIPduDirection=RECEIVE, ComIPduHandleId=2, ComIPduType=NORMAL, ComIPduSignalRef=ComISignal_BCAN_EMS_02_10ms_1_ENG_EngSta, ComPduIdRef=Pdu_ISignalIPdu_BCAN_EMS_02_10ms_1, ComIPduGroupRef=ComIPduGroupRx_SCM_BCAN
        ComIPdu_BCAN_BCM_07_200ms: ComIPduDirection=RECEIVE, ComIPduHandleId=3, ComIPduType=NORMAL, ComIPduSignalRef=ComISignal_BCAN_BCM_07_200ms_Lamp_IntTailLmpOnReq, ComPduIdRef=Pdu_ISignalIPdu_BCAN_BCM_07_200ms, ComIPduGroupRef=ComIPduGroupRx_SCM_BCAN
        ComIPdu_BCAN_ICU_02_200ms: ComIPduDirection=RECEIVE, ComIPduHandleId=4, ComIPduType=NORMAL, ComIPduSignalRef=ComISignal_BCAN_ICU_02_200ms_Warn_DrvDrSwSta, ComIPduSignalRef=ComISignal_BCAN_ICU_02_200ms_Warn_AsstDrSwSta, ComIPduSignalRef=ComISignal_BCAN_ICU_02_200ms_Warn_RrLftDrSwSta, ComIPduSignalRef=ComISignal_BCAN_ICU_02_200ms_Warn_RrRtDrSwSta, ComPduIdRef=Pdu_ISignalIPdu_BCAN_ICU_02_200ms, ComIPduGroupRef=ComIPduGroupRx_SCM_BCAN
        ComIPdu_BCAN_VCU_01_10ms_1: ComIPduDirection=RECEIVE, ComIPduHandleId=5, ComIPduType=NORMAL, ComIPduSignalRef=ComISignal_BCAN_VCU_01_10ms_1_VCU_EvDrvRdySta, ComPduIdRef=Pdu_ISignalIPdu_BCAN_VCU_01_10ms_1, ComIPduGroupRef=ComIPduGroupRx_SCM_BCAN
        ComIPdu_BCAN_IAU_16_200ms: ComIPduDirection=RECEIVE, ComIPduHandleId=6, ComIPduType=NORMAL, ComIPduSignalRef=ComISignal_BCAN_IAU_16_200ms_IAU_ProfileIDRVal, ComPduIdRef=Pdu_ISignalIPdu_BCAN_IAU_16_200ms, ComIPduGroupRef=ComIPduGroupRx_SCM_BCAN
        ComIPdu_BCAN_HU_GW_PE_01: ComIPduDirection=RECEIVE, ComIPduHandleId=7, ComIPduType=NORMAL, ComIPduSignalRef=ComISignal_BCAN_HU_GW_PE_01_CF_AVN_ProfileIDRValue, ComPduIdRef=Pdu_ISignalIPdu_BCAN_HU_GW_PE_01, ComIPduGroupRef=ComIPduGroupRx_SCM_BCAN
        ComIPdu_BCAN_HU_USM_E_04: ComIPduDirection=RECEIVE, ComIPduHandleId=8, ComIPduType=NORMAL, ComIPduSignalRef=ComISignal_BCAN_HU_USM_E_04_CF_AVN_CluUSMReset, ComPduIdRef=Pdu_ISignalIPdu_BCAN_HU_USM_E_04, ComIPduGroupRef=ComIPduGroupRx_SCM_BCAN
        ComIPdu_BCAN_HU_USM_E_02: ComIPduDirection=RECEIVE, ComIPduHandleId=9, ComIPduType=NORMAL, ComIPduSignalRef=ComISignal_BCAN_HU_USM_E_02_CF_Gway_RWPCNValueSet, ComPduIdRef=Pdu_ISignalIPdu_BCAN_HU_USM_E_02, ComIPduGroupRef=ComIPduGroupRx_SCM_BCAN
        ComIPdu_BCAN_EMS_07_10ms_2: ComIPduDirection=RECEIVE, ComIPduHandleId=10, ComIPduType=NORMAL, ComIPduSignalRef=ComISignal_BCAN_EMS_07_10ms_2_HEV_EngOpSta, ComPduIdRef=Pdu_ISignalIPdu_BCAN_EMS_07_10ms_2, ComIPduGroupRef=ComIPduGroupRx_SCM_BCAN
        ComIPdu_BCAN_SBCM_DRV_01_200ms: ComIPduDirection=RECEIVE, ComIPduHandleId=11, ComIPduType=NORMAL, ComIPduSignalRef=ComISignal_BCAN_SBCM_DRV_01_200ms_Warn_DrvDrSwSta_SBCM, ComIPduSignalRef=ComISignal_BCAN_SBCM_DRV_01_200ms_Latch_TypeOption_DRV, ComPduIdRef=Pdu_ISignalIPdu_BCAN_SBCM_DRV_01_200ms, ComIPduGroupRef=ComIPduGroupRx_SCM_BCAN
        ComIPdu_BCAN_CLU_01_20ms_1: ComIPduDirection=RECEIVE, ComIPduHandleId=12, ComIPduType=NORMAL, ComIPduSignalRef=ComISignal_BCAN_CLU_01_20ms_1_CLU_DtntOutSta, ComIPduSignalRef=ComISignal_BCAN_CLU_01_20ms_1_CLU_RhstaLvlSta, ComPduIdRef=Pdu_ISignalIPdu_BCAN_CLU_01_20ms_1, ComIPduGroupRef=ComIPduGroupRx_SCM_BCAN
        ComIPdu_BCAN_CLU_01_20ms_2: ComIPduDirection=RECEIVE, ComIPduHandleId=13, ComIPduType=NORMAL, ComIPduSignalRef=ComISignal_BCAN_CLU_01_20ms_2_CLU_DisSpdVal_KPH, ComIPduSignalRef=ComISignal_BCAN_CLU_01_20ms_2_CLU_AutoBrightSta, ComPduIdRef=Pdu_ISignalIPdu_BCAN_CLU_01_20ms_2, ComIPduGroupRef=ComIPduGroupRx_SCM_BCAN
        ComIPdu_BCAN_HCU_03_10ms_2: ComIPduDirection=RECEIVE, ComIPduHandleId=14, ComIPduType=NORMAL, ComIPduSignalRef=ComISignal_BCAN_HCU_03_10ms_2_HCU_HevRdySta, ComPduIdRef=Pdu_ISignalIPdu_BCAN_HCU_03_10ms_2, ComIPduGroupRef=ComIPduGroupRx_SCM_BCAN
        ComIPdu_BCAN_SBCM_AST_02_200ms: ComIPduDirection=RECEIVE, ComIPduHandleId=15, ComIPduType=NORMAL, ComIPduSignalRef=ComISignal_BCAN_SBCM_AST_02_200ms_Warn_AsstDrSwSta_SBCM, ComPduIdRef=Pdu_ISignalIPdu_BCAN_SBCM_AST_02_200ms, ComIPduGroupRef=ComIPduGroupRx_SCM_BCAN
        ComIPdu_BCAN_SBCM_RL_01_200ms: ComIPduDirection=RECEIVE, ComIPduHandleId=16, ComIPduType=NORMAL, ComIPduSignalRef=ComISignal_BCAN_SBCM_RL_01_200ms_Warn_RrLftDrSwSta_SBCM, ComPduIdRef=Pdu_ISignalIPdu_BCAN_SBCM_RL_01_200ms, ComIPduGroupRef=ComIPduGroupRx_SCM_BCAN
        ComIPdu_BCAN_SBCM_RR_01_200ms: ComIPduDirection=RECEIVE, ComIPduHandleId=17, ComIPduType=NORMAL, ComIPduSignalRef=ComISignal_BCAN_SBCM_RR_01_200ms_Warn_RrRtDrSwSta_SBCM, ComPduIdRef=Pdu_ISignalIPdu_BCAN_SBCM_RR_01_200ms, ComIPduGroupRef=ComIPduGroupRx_SCM_BCAN
        ComIPdu_LOCALCAN_WPC_01: ComIPduDirection=SEND, ComIPduHandleId=1, ComIPduType=NORMAL, ComIPduSignalRef=ComISignal_LOCALCAN_WPC_01_C_WPC_NFCReset, ComIPduSignalRef=ComISignal_LOCALCAN_WPC_01_C_WPC_NFCDetection, ComPduIdRef=Pdu_ISignalIPdu_LOCALCAN_WPC_01, ComIPduGroupRef=ComIPduGroupTx_SCM_LOCALCAN
          ComTxIpdu_ComIPdu_LOCALCAN_WPC_01 (ComTxIPdu): category=TOOL_CONFIGURED, ComTxIPduUnusedAreasDefault=0, ComMinimumDelayTime=0.02
            ComTxModeTrue_ComTxIpdu_ComIPdu_LOCALCAN_WPC_01 (ComTxModeTrue): category=TOOL_CONFIGURED
              ComTxMode_ComTxModeTrue_ComTxIpdu_ComIPdu_LOCALCAN_WPC_01 (ComTxMode): category=TOOL_CONFIGURED, ComTxModeNumberOfRepetitions=3, ComTxModeRepetitionPeriod=0.04, ComTxModeMode=DIRECT
        ComIPdu_LOCALCAN_BDC_01: ComIPduDirection=RECEIVE, ComIPduHandleId=18, ComIPduType=NORMAL, ComIPduSignalRef=ComISignal_LOCALCAN_BDC_01_C_WPCNFCcmd, ComIPduSignalRef=ComISignal_LOCALCAN_BDC_01_C_BDCWPCNFCCmd, ComPduIdRef=Pdu_ISignalIPdu_LOCALCAN_BDC_01, ComIPduGroupRef=ComIPduGroupRx_SCM_LOCALCAN
        ComIPdu_LOCALCAN_BDC_10: ComIPduDirection=RECEIVE, ComIPduHandleId=19, ComIPduType=NORMAL, ComIPduSignalRef=ComISignal_LOCALCAN_BDC_10_C_DeviceOnWPC, ComIPduSignalRef=ComISignal_LOCALCAN_BDC_10_C_BDC_Status, ComPduIdRef=Pdu_ISignalIPdu_LOCALCAN_BDC_10, ComIPduGroupRef=ComIPduGroupRx_SCM_LOCALCAN
        ComIPdu_LOCALCAN_WPC_10: ComIPduDirection=SEND, ComIPduHandleId=3, ComIPduType=NORMAL, ComIPduSignalRef=ComISignal_LOCALCAN_WPC_10_C_WPC_Status, ComIPduSignalRef=ComISignal_LOCALCAN_WPC_10_C_WPCNFC_Option, ComPduIdRef=Pdu_ISignalIPdu_LOCALCAN_WPC_10, ComIPduGroupRef=ComIPduGroupTx_SCM_LOCALCAN
          ComTxIpdu_ComIPdu_LOCALCAN_WPC_10 (ComTxIPdu): category=TOOL_CONFIGURED, ComTxIPduUnusedAreasDefault=0, ComMinimumDelayTime=0.02
            ComTxModeTrue_ComTxIpdu_ComIPdu_LOCALCAN_WPC_10 (ComTxModeTrue): category=TOOL_CONFIGURED
              ComTxMode_ComTxModeTrue_ComTxIpdu_ComIPdu_LOCALCAN_WPC_10 (ComTxMode):
                category = TOOL_CONFIGURED
                ComTxModeTimeOffset = 0.0
                ComTxModeTimePeriod = 0.2
                ComTxModeNumberOfRepetitions = 3
                ComTxModeRepetitionPeriod = 0.04
                ComTxModeMode = MIXED
        ComIPdu_LOCALCAN_TP_BDC_C_WPC: ComIPduDirection=RECEIVE, ComIPduHandleId=20, ComIPduType=TP, ComIPduSignalRef=ComISignal_LOCALCAN_TP_BDC_C_WPC_LOCALCAN_TP_BDC_C_WPC_signal, ComPduIdRef=Pdu_ISignalIPdu_LOCALCAN_TP_BDC_C_WPC, ComIPduGroupRef=ComIPduGroupRx_SCM_LOCALCAN
        ComIPdu_LOCALCAN_TP_WPC_C_BDC: ComIPduDirection=SEND, ComIPduHandleId=0, ComIPduType=TP, ComIPduSignalRef=ComISignal_LOCALCAN_TP_WPC_C_BDC_LOCALCAN_TP_WPC_C_BDC_signal, ComPduIdRef=Pdu_ISignalIPdu_LOCALCAN_TP_WPC_C_BDC, ComIPduGroupRef=ComIPduGroupTx_SCM_LOCALCAN
          ComTxIpdu_ComIPdu_LOCALCAN_TP_WPC_C_BDC (ComTxIPdu): category=TOOL_CONFIGURED, ComTxIPduUnusedAreasDefault=0, ComMinimumDelayTime=0.02
            ComTxModeTrue_ComTxIpdu_ComIPdu_LOCALCAN_TP_WPC_C_BDC (ComTxModeTrue): category=TOOL_CONFIGURED
              ComTxMode_ComTxModeTrue_ComTxIpdu_ComIPdu_LOCALCAN_TP_WPC_C_BDC (ComTxMode): category=TOOL_CONFIGURED, ComTxModeNumberOfRepetitions=3, ComTxModeRepetitionPeriod=0.04, ComTxModeMode=DIRECT
      32 x ComSignal, all with category=TOOL_CONFIGURED, ComSigReportIdsMEnable=0:
        ComISignal_BCAN_BCM_07_200ms_Lamp_IntTailLmpOnReq: ComBitPosition=36, ComBitSize=2, ComSignalEndianness=LITTLE_ENDIAN, ComSignalInitValue=0, ComSignalLength=1, ComSignalType=UINT8, ComTransferProperty=TRIGGERED_ON_CHANGE, ComHandleId=3, ComTimeout=1.5, ComNotification=Rte_COMCbk_ComISignal_BCAN_BCM_07_200ms_Lamp_IntTailLmpOnReq, ComTimeoutNotification=Rte_COMCbkRxTOut_ComISignal_BCAN_BCM_07_200ms_Lamp_IntTailLmpOnReq, ComSystemTemplateSystemSignalRef=Lamp_IntTailLmpOnReq
        ComISignal_BCAN_BCM_12_200ms_BCM_SmkOptTyp: ComBitPosition=24, ComBitSize=2, ComSignalEndianness=LITTLE_ENDIAN, ComSignalInitValue=0, ComSignalLength=1, ComSignalType=UINT8, ComTransferProperty=TRIGGERED_ON_CHANGE, ComHandleId=1, ComTimeout=1.5, ComNotification=Rte_COMCbk_ComISignal_BCAN_BCM_12_200ms_BCM_SmkOptTyp, ComTimeoutNotification=Rte_COMCbkRxTOut_ComISignal_BCAN_BCM_12_200ms_BCM_SmkOptTyp, ComSystemTemplateSystemSignalRef=BCM_SmkOptTyp
        ComISignal_BCAN_CLU_01_20ms_1_CLU_DtntOutSta: ComBitPosition=28, ComBitSize=2, ComSignalEndianness=LITTLE_ENDIAN, ComSignalInitValue=0, ComSignalLength=1, ComSignalType=UINT8, ComTransferProperty=PENDING, ComHandleId=16, ComTimeout=1.5, ComNotification=Rte_COMCbk_ComISignal_BCAN_CLU_01_20ms_1_CLU_DtntOutSta, ComTimeoutNotification=Rte_COMCbkRxTOut_ComISignal_BCAN_CLU_01_20ms_1_CLU_DtntOutSta, ComSystemTemplateSystemSignalRef=CLU_DtntOutSta
        ComISignal_BCAN_CLU_01_20ms_1_CLU_RhstaLvlSta: ComBitPosition=43, ComBitSize=5, ComSignalEndianness=LITTLE_ENDIAN, ComSignalInitValue=0, ComSignalLength=1, ComSignalType=UINT8, ComTransferProperty=PENDING, ComHandleId=17, ComTimeout=1.5, ComNotification=Rte_COMCbk_ComISignal_BCAN_CLU_01_20ms_1_CLU_RhstaLvlSta, ComSystemTemplateSystemSignalRef=CLU_RhstaLvlSta
        ComISignal_BCAN_CLU_01_20ms_2_CLU_DisSpdVal_KPH: ComBitPosition=0, ComBitSize=9, ComSignalEndianness=LITTLE_ENDIAN, ComSignalInitValue=0, ComSignalLength=2, ComSignalType=UINT16, ComTransferProperty=PENDING, ComHandleId=18, ComTimeout=1.5, ComNotification=Rte_COMCbk_ComISignal_BCAN_CLU_01_20ms_2_CLU_DisSpdVal_KPH, ComSystemTemplateSystemSignalRef=CLU_DisSpdVal_KPH
        ComISignal_BCAN_CLU_01_20ms_2_CLU_AutoBrightSta: ComBitPosition=15, ComBitSize=8, ComSignalEndianness=LITTLE_ENDIAN, ComSignalInitValue=0, ComSignalLength=1, ComSignalType=UINT8, ComTransferProperty=PENDING, ComHandleId=19, ComTimeout=1.5, ComNotification=Rte_COMCbk_ComISignal_BCAN_CLU_01_20ms_2_CLU_AutoBrightSta, ComTimeoutNotification=Rte_COMCbkRxTOut_ComISignal_BCAN_CLU_01_20ms_2_CLU_AutoBrightSta, ComSystemTemplateSystemSignalRef=CLU_AutoBrightSta
        ComISignal_BCAN_EMS_02_10ms_1_ENG_EngSta: ComBitPosition=61, ComBitSize=3, ComSignalEndianness=LITTLE_ENDIAN, ComSignalInitValue=0, ComSignalLength=1, ComSignalType=UINT8, ComTransferProperty=PENDING, ComHandleId=2, ComTimeout=0.5, ComNotification=Rte_COMCbk_ComISignal_BCAN_EMS_02_10ms_1_ENG_EngSta, ComTimeoutNotification=Rte_COMCbkRxTOut_ComISignal_BCAN_EMS_02_10ms_1_ENG_EngSta, ComSystemTemplateSystemSignalRef=ENG_EngSta
        ComISignal_BCAN_EMS_07_10ms_2_HEV_EngOpSta: ComBitPosition=28, ComBitSize=3, ComSignalEndianness=LITTLE_ENDIAN, ComSignalInitValue=0, ComSignalLength=1, ComSignalType=UINT8, ComTransferProperty=PENDING, ComHandleId=13, ComTimeout=0.5, ComNotification=Rte_COMCbk_ComISignal_BCAN_EMS_07_10ms_2_HEV_EngOpSta, ComTimeoutNotification=Rte_COMCbkRxTOut_ComISignal_BCAN_EMS_07_10ms_2_HEV_EngOpSta, ComSystemTemplateSystemSignalRef=HEV_EngOpSta
        ComISignal_BCAN_HCU_03_10ms_2_HCU_HevRdySta: ComBitPosition=6, ComBitSize=2, ComSignalEndianness=LITTLE_ENDIAN, ComSignalInitValue=0, ComSignalLength=1, ComSignalType=UINT8, ComTransferProperty=PENDING, ComHandleId=20, ComTimeout=0.5, ComNotification=Rte_COMCbk_ComISignal_BCAN_HCU_03_10ms_2_HCU_HevRdySta, ComTimeoutNotification=Rte_COMCbkRxTOut_ComISignal_BCAN_HCU_03_10ms_2_HCU_HevRdySta, ComSystemTemplateSystemSignalRef=HCU_HevRdySta
        ComISignal_BCAN_HU_GW_PE_01_CF_AVN_ProfileIDRValue: ComBitPosition=40, ComBitSize=4, ComSignalEndianness=LITTLE_ENDIAN, ComSignalInitValue=15, ComSignalLength=1, ComSignalType=UINT8, ComTransferProperty=TRIGGERED_ON_CHANGE, ComHandleId=10, ComTimeout=1.5, ComNotification=Rte_COMCbk_ComISignal_BCAN_HU_GW_PE_01_CF_AVN_ProfileIDRValue, ComTimeoutNotification=Rte_COMCbkRxTOut_ComISignal_BCAN_HU_GW_PE_01_CF_AVN_ProfileIDRValue, ComSystemTemplateSystemSignalRef=CF_AVN_ProfileIDRValue
        ComISignal_BCAN_HU_USM_E_04_CF_AVN_CluUSMReset: ComBitPosition=62, ComBitSize=2, ComSignalEndianness=LITTLE_ENDIAN, ComSignalInitValue=0, ComSignalLength=1, ComSignalType=UINT8, ComTransferProperty=TRIGGERED_ON_CHANGE, ComHandleId=11, ComTimeout=0.0, ComNotification=Rte_COMCbk_ComISignal_BCAN_HU_USM_E_04_CF_AVN_CluUSMReset, ComSystemTemplateSystemSignalRef=CF_AVN_CluUSMReset
        ComISignal_BCAN_IAU_16_200ms_IAU_ProfileIDRVal: ComBitPosition=10, ComBitSize=4, ComSignalEndianness=LITTLE_ENDIAN, ComSignalInitValue=0, ComSignalLength=1, ComSignalType=UINT8, ComTransferProperty=TRIGGERED_ON_CHANGE, ComHandleId=9, ComTimeout=1.5, ComNotification=Rte_COMCbk_ComISignal_BCAN_IAU_16_200ms_IAU_ProfileIDRVal, ComTimeoutNotification=Rte_COMCbkRxTOut_ComISignal_BCAN_IAU_16_200ms_IAU_ProfileIDRVal, ComSystemTemplateSystemSignalRef=IAU_ProfileIDRVal
        ComISignal_BCAN_ICU_02_200ms_Warn_DrvDrSwSta: ComBitPosition=24, ComBitSize=2, ComSignalEndianness=LITTLE_ENDIAN, ComSignalInitValue=0, ComSignalLength=1, ComSignalType=UINT8, ComTransferProperty=TRIGGERED_ON_CHANGE, ComHandleId=4, ComTimeout=1.5, ComNotification=Rte_COMCbk_ComISignal_BCAN_ICU_02_200ms_Warn_DrvDrSwSta, ComSystemTemplateSystemSignalRef=Warn_DrvDrSwSta
        ComISignal_BCAN_ICU_02_200ms_Warn_AsstDrSwSta: ComBitPosition=34, ComBitSize=2, ComSignalEndianness=LITTLE_ENDIAN, ComSignalInitValue=0, ComSignalLength=1, ComSignalType=UINT8, ComTransferProperty=TRIGGERED_ON_CHANGE, ComHandleId=5, ComTimeout=1.5, ComNotification=Rte_COMCbk_ComISignal_BCAN_ICU_02_200ms_Warn_AsstDrSwSta, ComTimeoutNotification=Rte_COMCbkRxTOut_ComISignal_BCAN_ICU_02_200ms_Warn_AsstDrSwSta, ComSystemTemplateSystemSignalRef=Warn_AsstDrSwSta
        ComISignal_BCAN_ICU_02_200ms_Warn_RrLftDrSwSta: ComBitPosition=52, ComBitSize=2, ComSignalEndianness=LITTLE_ENDIAN, ComSignalInitValue=0, ComSignalLength=1, ComSignalType=UINT8, ComTransferProperty=TRIGGERED_ON_CHANGE, ComHandleId=6, ComTimeout=1.5, ComNotification=Rte_COMCbk_ComISignal_BCAN_ICU_02_200ms_Warn_RrLftDrSwSta, ComTimeoutNotification=Rte_COMCbkRxTOut_ComISignal_BCAN_ICU_02_200ms_Warn_RrLftDrSwSta, ComSystemTemplateSystemSignalRef=Warn_RrLftDrSwSta
        ComISignal_BCAN_ICU_02_200ms_Warn_RrRtDrSwSta: ComBitPosition=56, ComBitSize=2, ComSignalEndianness=LITTLE_ENDIAN, ComSignalInitValue=0, ComSignalLength=1, ComSignalType=UINT8, ComTransferProperty=TRIGGERED_ON_CHANGE, ComHandleId=7, ComTimeout=1.5, ComNotification=Rte_COMCbk_ComISignal_BCAN_ICU_02_200ms_Warn_RrRtDrSwSta, ComSystemTemplateSystemSignalRef=Warn_RrRtDrSwSta
        ComISignal_BCAN_SBCM_AST_02_200ms_Warn_AsstDrSwSta_SBCM: ComBitPosition=20, ComBitSize=2, ComSignalEndianness=LITTLE_ENDIAN, ComSignalInitValue=0, ComSignalLength=1, ComSignalType=UINT8, ComTransferProperty=TRIGGERED_ON_CHANGE, ComHandleId=21, ComTimeout=1.5, ComNotification=Rte_COMCbk_ComISignal_BCAN_SBCM_AST_02_200ms_Warn_AsstDrSwSta_SBCM, ComTimeoutNotification=Rte_COMCbkRxTOut_ComISignal_BCAN_SBCM_AST_02_200ms_Warn_AsstDrSwSta_SBCM, ComSystemTemplateSystemSignalRef=Warn_AsstDrSwSta_SBCM
        ComISignal_BCAN_SBCM_DRV_01_200ms_Warn_DrvDrSwSta_SBCM: ComBitPosition=20, ComBitSize=2, ComSignalEndianness=LITTLE_ENDIAN, ComSignalInitValue=0, ComSignalLength=1, ComSignalType=UINT8, ComTransferProperty=TRIGGERED_ON_CHANGE, ComHandleId=14, ComTimeout=1.5, ComNotification=Rte_COMCbk_ComISignal_BCAN_SBCM_DRV_01_200ms_Warn_DrvDrSwSta_SBCM, ComTimeoutNotification=Rte_COMCbkRxTOut_ComISignal_BCAN_SBCM_DRV_01_200ms_Warn_DrvDrSwSta_SBCM, ComSystemTemplateSystemSignalRef=Warn_DrvDrSwSta_SBCM
        ComISignal_BCAN_SBCM_RL_01_200ms_Warn_RrLftDrSwSta_SBCM: ComBitPosition=16, ComBitSize=2, ComSignalEndianness=LITTLE_ENDIAN, ComSignalInitValue=0, ComSignalLength=1, ComSignalType=UINT8, ComTransferProperty=TRIGGERED_ON_CHANGE, ComHandleId=22, ComTimeout=1.5, ComNotification=Rte_COMCbk_ComISignal_BCAN_SBCM_RL_01_200ms_Warn_RrLftDrSwSta_SBCM, ComTimeoutNotification=Rte_COMCbkRxTOut_ComISignal_BCAN_SBCM_RL_01_200ms_Warn_RrLftDrSwSta_SBCM, ComSystemTemplateSystemSignalRef=Warn_RrLftDrSwSta_SBCM
        ComISignal_BCAN_SBCM_RR_01_200ms_Warn_RrRtDrSwSta_SBCM: ComBitPosition=16, ComBitSize=2, ComSignalEndianness=LITTLE_ENDIAN, ComSignalInitValue=0, ComSignalLength=1, ComSignalType=UINT8, ComTransferProperty=TRIGGERED_ON_CHANGE, ComHandleId=23, ComTimeout=1.5, ComNotification=Rte_COMCbk_ComISignal_BCAN_SBCM_RR_01_200ms_Warn_RrRtDrSwSta_SBCM, ComTimeoutNotification=Rte_COMCbkRxTOut_ComISignal_BCAN_SBCM_RR_01_200ms_Warn_RrRtDrSwSta_SBCM, ComSystemTemplateSystemSignalRef=Warn_RrRtDrSwSta_SBCM
        ComISignal_BCAN_SMK_06_200ms_LFAnt_SrchSta: ComBitPosition=42, ComBitSize=2, ComSignalEndianness=LITTLE_ENDIAN, ComSignalInitValue=0, ComSignalLength=1, ComSignalType=UINT8, ComTransferProperty=TRIGGERED_ON_CHANGE, ComHandleId=0, ComTimeout=1.5, ComNotification=Rte_COMCbk_ComISignal_BCAN_SMK_06_200ms_LFAnt_SrchSta, ComTimeoutNotification=Rte_COMCbkRxTOut_ComISignal_BCAN_SMK_06_200ms_LFAnt_SrchSta, ComSystemTemplateSystemSignalRef=LFAnt_SrchSta
        ComISignal_BCAN_VCU_01_10ms_1_VCU_EvDrvRdySta: ComBitPosition=28, ComBitSize=2, ComSignalEndianness=LITTLE_ENDIAN, ComSignalInitValue=0, ComSignalLength=1, ComSignalType=UINT8, ComTransferProperty=PENDING, ComHandleId=8, ComTimeout=0.5, ComNotification=Rte_COMCbk_ComISignal_BCAN_VCU_01_10ms_1_VCU_EvDrvRdySta, ComTimeoutNotification=Rte_COMCbkRxTOut_ComISignal_BCAN_VCU_01_10ms_1_VCU_EvDrvRdySta, ComSystemTemplateSystemSignalRef=VCU_EvDrvRdySta
        ComISignal_LOCALCAN_BDC_01_C_WPCNFCcmd: ComBitPosition=5, ComBitSize=3, ComSignalEndianness=BIG_ENDIAN, ComSignalInitValue=0, ComSignalLength=1, ComSignalType=UINT8, ComTransferProperty=TRIGGERED_ON_CHANGE, ComHandleId=24, ComTimeout=0.0, ComSystemTemplateSystemSignalRef=C_WPCNFCcmd
        ComISignal_LOCALCAN_BDC_01_C_BDCWPCNFCCmd: ComBitPosition=15, ComBitSize=2, ComSignalEndianness=BIG_ENDIAN, ComSignalInitValue=0, ComSignalLength=1, ComSignalType=UINT8, ComTransferProperty=TRIGGERED_ON_CHANGE, ComHandleId=25, ComTimeout=0.0, ComSystemTemplateSystemSignalRef=C_BDCWPCNFCCmd
        ComISignal_LOCALCAN_BDC_10_C_DeviceOnWPC: ComBitPosition=2, ComBitSize=2, ComSignalEndianness=BIG_ENDIAN, ComSignalInitValue=0, ComSignalLength=1, ComSignalType=UINT8, ComTransferProperty=TRIGGERED_ON_CHANGE, ComHandleId=26, ComTimeout=0.0, ComSystemTemplateSystemSignalRef=C_DeviceOnWPC
        ComISignal_LOCALCAN_BDC_10_C_BDC_Status: ComBitPosition=7, ComBitSize=3, ComSignalEndianness=BIG_ENDIAN, ComSignalInitValue=0, ComSignalLength=1, ComSignalType=UINT8, ComTransferProperty=TRIGGERED_ON_CHANGE, ComHandleId=27, ComTimeout=0.0, ComSystemTemplateSystemSignalRef=C_BDC_Status
        ComISignal_LOCALCAN_TP_BDC_C_WPC_LOCALCAN_TP_BDC_C_WPC_signal: ComBitPosition=0, ComSignalEndianness=opaque, ComSignalInitValue=0 0 0 0 0 0 0 0 0 0 0 0 0 0 0 0 0 0 0 0 0 0 0 0 0 0 0 0 0 0 0 0 0 0 0 0 0 0 0 0 0 0 0 0 0 0 0 0 0 0 0 0 0 0 0 0 0 0 0 0 0 0 0 0 0 0 0 0 0 0 0 0 0 0 0 0 0 0 0 0 0 0 0 0 0 0 0 0 0 0 0 0 0 0 0 0 0 0 0 0 0 0 0 0 0 0 0 0 0 0 0 0 0 0 0 0 0 0 0 0 0 0 0 0 0 0 0 0 0 0 0 0 0 0 0 0 0 0 0 0 0 0 0 0 0 0 0 0 0 0 0 0 0 0 0 0 0 0 0 0 0 0 0 0 0 0 0 0 0 0 0 0 0 0 0 0 0 0 0 0 0 0 0 0 0 0 0 0 0 0 0 0 0 0 0 0 0 0 0 0 0 0 0 0 0 0 0 0 0 0 0 0 0 0 0 0 0 0 0 0 0 0 0 0 0 0 0 0 0 0 0 0 0 0 0 0 0 0 0 0 0 0 0 0 0 0 0 0 0 0 0 0 0 0 0 0 0 0 0 0 0 0 0 0 0 0 0 0 0 0 0 0 0 0 0 0 0 0 0 0 0 0 0 0 0 0 0 0 0 0 0 0 0 0 0 0 0 0 0 0 0 0 0 0 0 0 0 0 0 0 0 0 0 0 0 0 0 0 0 0 0 0 0 0 0 0 0 0 0 0 0 0 0 0 0 0 0 0 0 0 0 0 0 0 0 0 0 0 0 0 0 0 0 0 0 0 0 0 0 0 0 0 0 0 0 0 0 0 0 0 0 0 0 0 0 0 0 0 0 0 0 0 0 0 0 0 0 0 0 0 0 0 0 0 0 0 0 0 0 0 0 0 0 0 0 0 0 0 0 0 0 0 0 0 0 0 0 0 0 0 0 0 0 0 0 0 0 0 0 0 0 0 0 0 0 0 0 0 0 0 0 0 0 0 0 0 0 0 0 0 0 0 0 0 0 0 0 0 0 0 0 0 0 0 0 0 0 0 0 0 0 0 0 0 0 0 0 0 0 0 0 0 0 0 0 0 0 0 0 0 0 0 0 0 0 0 0 0 0 0 0 0 0 0 0 0 0 0 0 0 0 0, ComSignalLength=512, ComSignalType=UINT8_DYN, ComTransferProperty=PENDING, ComHandleId=28, ComTimeout=0.0, ComSystemTemplateSystemSignalRef=LOCALCAN_TP_BDC_C_WPC_signal
        ComISignal_LOCALCAN_TP_WPC_C_BDC_LOCALCAN_TP_WPC_C_BDC_signal: ComBitPosition=0, ComSignalEndianness=opaque, ComSignalInitValue=0 0 0 0 0 0 0 0 0 0 0 0 0 0 0 0 0 0 0 0 0 0 0 0 0 0 0 0 0 0 0 0 0 0 0 0 0 0 0 0 0 0 0 0 0 0 0 0 0 0 0 0 0 0 0 0 0 0 0 0 0 0 0 0 0 0 0 0 0 0 0 0 0 0 0 0 0 0 0 0 0 0 0 0 0 0 0 0 0 0 0 0 0 0 0 0 0 0 0 0 0 0 0 0 0 0 0 0 0 0 0 0 0 0 0 0 0 0 0 0 0 0 0 0 0 0 0 0 0 0 0 0 0 0 0 0 0 0 0 0 0 0 0 0 0 0 0 0 0 0 0 0 0 0 0 0 0 0 0 0 0 0 0 0 0 0 0 0 0 0 0 0 0 0 0 0 0 0 0 0 0 0 0 0 0 0 0 0 0 0 0 0 0 0 0 0 0 0 0 0 0 0 0 0 0 0 0 0 0 0 0 0 0 0 0 0 0 0 0 0 0 0 0 0 0 0 0 0 0 0 0 0 0 0 0 0 0 0 0 0 0 0 0 0 0 0 0 0 0 0 0 0 0 0 0 0 0 0 0 0 0 0 0 0 0 0 0 0 0 0 0 0 0 0 0 0 0 0 0 0 0 0 0 0 0 0 0 0 0 0 0 0 0 0 0 0 0 0 0 0 0 0 0 0 0 0 0 0 0 0 0 0 0 0 0 0 0 0 0 0 0 0 0 0 0 0 0 0 0 0 0 0 0 0 0 0 0 0 0 0 0 0 0 0 0 0 0 0 0 0 0 0 0 0 0 0 0 0 0 0 0 0 0 0 0 0 0 0 0 0 0 0 0 0 0 0 0 0 0 0 0 0 0 0 0 0 0 0 0 0 0 0 0 0 0 0 0 0 0 0 0 0 0 0 0 0 0 0 0 0 0 0 0 0 0 0 0 0 0 0 0 0 0 0 0 0 0 0 0 0 0 0 0 0 0 0 0 0 0 0 0 0 0 0 0 0 0 0 0 0 0 0 0 0 0 0 0 0 0 0 0 0 0 0 0 0 0 0 0 0 0 0 0 0 0 0 0 0 0 0 0 0 0 0 0 0 0 0 0 0 0 0 0 0 0 0 0 0 0 0 0 0 0 0 0 0 0 0 0 0 0 0, ComSignalLength=512, ComSignalType=UINT8_DYN, ComTransferProperty=TRIGGERED_WITHOUT_REPETITION, ComHandleId=0, ComSystemTemplateSystemSignalRef=LOCALCAN_TP_WPC_C_BDC_signal
        ComISignal_LOCALCAN_WPC_01_C_WPC_NFCReset: ComBitPosition=3, ComBitSize=1, ComSignalEndianness=BIG_ENDIAN, ComSignalInitValue=0, ComSignalLength=1, ComSignalType=BOOLEAN, ComTransferProperty=TRIGGERED_ON_CHANGE, ComHandleId=1, ComSystemTemplateSystemSignalRef=C_WPC_NFCReset
        ComISignal_LOCALCAN_WPC_01_C_WPC_NFCDetection: ComBitPosition=7, ComBitSize=2, ComSignalEndianness=BIG_ENDIAN, ComSignalInitValue=0, ComSignalLength=1, ComSignalType=UINT8, ComTransferProperty=TRIGGERED_ON_CHANGE, ComHandleId=2, ComSystemTemplateSystemSignalRef=C_WPC_NFCDetection
        ComISignal_LOCALCAN_WPC_10_C_WPC_Status: ComBitPosition=7, ComBitSize=3, ComSignalEndianness=BIG_ENDIAN, ComSignalInitValue=0, ComSignalLength=1, ComSignalType=UINT8, ComTransferProperty=TRIGGERED_ON_CHANGE, ComHandleId=10, ComSystemTemplateSystemSignalRef=C_WPC_Status
        ComISignal_LOCALCAN_WPC_10_C_WPCNFC_Option: ComBitPosition=15, ComBitSize=2, ComSignalEndianness=BIG_ENDIAN, ComSignalInitValue=0, ComSignalLength=1, ComSignalType=UINT8, ComTransferProperty=TRIGGERED_ON_CHANGE, ComHandleId=11, ComSystemTemplateSystemSignalRef=C_WPCNFC_Option
      ComIPdu_BCAN_RWPC_01_200ms (ComIPdu):
        category = TOOL_CONFIGURED
        ComIPduDirection = SEND
        ComIPduHandleId = 2
        ComIPduType = NORMAL
        ComIPduSignalProcessing = DEFERRED
        ComIPduSignalRef = ComISignal_BCAN_RWPC_01_200ms_USM_ValCmdSta
        ComIPduSignalRef = ComISignal_BCAN_RWPC_01_200ms_WPC_PhnLftWrngRWPCSta
        ComIPduSignalRef = ComISignal_BCAN_RWPC_01_200ms_USM_ValCmdStaforATS
        ComIPduSignalRef = ComISignal_BCAN_RWPC_01_200ms_RWPC_SWVerMajor1
        ComIPduSignalRef = ComISignal_BCAN_RWPC_01_200ms_RWPC_SWVerMinor1
        ComIPduSignalRef = ComISignal_BCAN_RWPC_01_200ms_RWPC_SWVerMinor2
        ComIPduSignalRef = ComISignal_BCAN_RWPC_01_200ms_RWPC_IndSyncVal
        ComPduIdRef = Pdu_ISignalIPdu_BCAN_RWPC_01_200ms
        ComIPduGroupRef = ComIPduGroupTx_SCM_BCAN
        ComTxIpdu_ComIPdu_BCAN_RWPC_01_200ms (ComTxIPdu): category=TOOL_CONFIGURED, ComTxIPduUnusedAreasDefault=0, ComMinimumDelayTime=0.02
          ComTxModeTrue_ComTxIpdu_ComIPdu_BCAN_RWPC_01_200ms (ComTxModeTrue): category=TOOL_CONFIGURED
            ComTxMode_ComTxModeTrue_ComTxIpdu_ComIPdu_BCAN_RWPC_01_200ms (ComTxMode):
              category = TOOL_CONFIGURED
              ComTxModeTimeOffset = 0.0
              ComTxModeTimePeriod = 0.2
              ComTxModeNumberOfRepetitions = 3
              ComTxModeRepetitionPeriod = 0.04
              ComTxModeMode = MIXED
      ComIPdu_BCAN_ATS_00_00ms (ComIPdu):
        category = TOOL_CONFIGURED
        ComIPduDirection = RECEIVE
        ComIPduHandleId = 21
        ComIPduType = NORMAL
        ComIPduSignalProcessing = DEFERRED
        ComIPduSignalRef = ComISignal_BCAN_ATS_00_00ms_ATS_RWPC_RWPCNValueSet
        ComPduIdRef = Pdu_ISignalIPdu_BCAN_ATS_00_00ms
        ComIPduGroupRef = ComIPduGroupRx_SCM_BCAN
      8 x ComSignal, all with category=TOOL_CONFIGURED, ComSignalEndianness=LITTLE_ENDIAN, ComSignalInitValue=0, ComSignalLength=1, ComSignalType=UINT8, ComTransferProperty=TRIGGERED_ON_CHANGE, ComSigReportIdsMEnable=0:
        ComISignal_BCAN_ATS_00_00ms_ATS_RWPC_RWPCNValueSet: ComBitPosition=2, ComBitSize=3, ComHandleId=29, ComTimeout=0.0, ComNotification=Rte_COMCbk_ComISignal_BCAN_ATS_00_00ms_ATS_RWPC_RWPCNValueSet, ComSystemTemplateSystemSignalRef=ATS_RWPC_RWPCNValueSet
        ComISignal_BCAN_HU_USM_E_02_CF_Gway_RWPCNValueSet: ComBitPosition=40, ComBitSize=2, ComHandleId=12, ComTimeout=0.0, ComNotification=Rte_COMCbk_ComISignal_BCAN_HU_USM_E_02_CF_Gway_RWPCNValueSet, ComSystemTemplateSystemSignalRef=CF_Gway_RWPCNValueSet
        ComISignal_BCAN_RWPC_01_200ms_USM_ValCmdSta: ComBitPosition=0, ComBitSize=2, ComHandleId=3, ComSystemTemplateSystemSignalRef=USM_ValCmdSta
        ComISignal_BCAN_RWPC_01_200ms_WPC_PhnLftWrngRWPCSta: ComBitPosition=2, ComBitSize=3, ComHandleId=4, ComSystemTemplateSystemSignalRef=WPC_PhnLftWrngRWPCSta
        ComISignal_BCAN_RWPC_01_200ms_USM_ValCmdStaforATS: ComBitPosition=5, ComBitSize=2, ComHandleId=5, ComSystemTemplateSystemSignalRef=USM_ValCmdStaforATS
        ComISignal_BCAN_RWPC_01_200ms_RWPC_SWVerMajor1: ComBitPosition=8, ComBitSize=7, ComHandleId=6, ComTimeout=0.0, ComSystemTemplateSystemSignalRef=RWPC_SWVerMajor1
        ComISignal_BCAN_RWPC_01_200ms_RWPC_SWVerMinor1: ComBitPosition=16, ComBitSize=7, ComHandleId=7, ComSystemTemplateSystemSignalRef=RWPC_SWVerMinor1
        ComISignal_BCAN_RWPC_01_200ms_RWPC_SWVerMinor2: ComBitPosition=24, ComBitSize=7, ComHandleId=8, ComSystemTemplateSystemSignalRef=RWPC_SWVerMinor2
      ComIPdu_BCAN_WPC_01_200ms (ComIPdu):
        category = TOOL_CONFIGURED
        ComIPduDirection = RECEIVE
        ComIPduHandleId = 22
        ComIPduType = NORMAL
        ComIPduSignalProcessing = DEFERRED
        ComIPduSignalRef = ComISignal_BCAN_WPC_01_200ms_WPC_IndSyncVal
        ComIPduSignalRef = ComISignal_BCAN_WPC_01_200ms_USM_CmdWPCIndSta
        ComPduIdRef = Pdu_ISignalIPdu_BCAN_WPC_01_200ms
        ComIPduGroupRef = ComIPduGroupRx_SCM_BCAN
      ComIPdu_BCAN_WPC2_01_200ms (ComIPdu):
        category = TOOL_CONFIGURED
        ComIPduDirection = RECEIVE
        ComIPduHandleId = 23
        ComIPduType = NORMAL
        ComIPduSignalProcessing = DEFERRED
        ComIPduSignalRef = ComISignal_BCAN_WPC2_01_200ms_WPC2_IndSyncVal
        ComPduIdRef = Pdu_ISignalIPdu_BCAN_WPC2_01_200ms
        ComIPduGroupRef = ComIPduGroupRx_SCM_BCAN
      4 x ComSignal, all with category=TOOL_CONFIGURED, ComBitSize=3, ComSignalEndianness=LITTLE_ENDIAN, ComSignalLength=1, ComSignalType=UINT8, ComTransferProperty=TRIGGERED_ON_CHANGE, ComSigReportIdsMEnable=0:
        ComISignal_BCAN_RWPC_01_200ms_RWPC_IndSyncVal: ComBitPosition=40, ComSignalInitValue=0, ComHandleId=9, ComSystemTemplateSystemSignalRef=RWPC_IndSyncVal
        ComISignal_BCAN_WPC2_01_200ms_WPC2_IndSyncVal: ComBitPosition=40, ComSignalInitValue=0, ComHandleId=32, ComTimeout=1.5, ComNotification=Rte_COMCbk_ComISignal_BCAN_WPC2_01_200ms_WPC2_IndSyncVal, ComTimeoutNotification=Rte_COMCbkRxTOut_ComISignal_BCAN_WPC2_01_200ms_WPC2_IndSyncVal, ComSystemTemplateSystemSignalRef=WPC2_IndSyncVal
        ComISignal_BCAN_WPC_01_200ms_WPC_IndSyncVal: ComBitPosition=40, ComSignalInitValue=0, ComHandleId=30, ComTimeout=1.5, ComNotification=Rte_COMCbk_ComISignal_BCAN_WPC_01_200ms_WPC_IndSyncVal, ComTimeoutNotification=Rte_COMCbkRxTOut_ComISignal_BCAN_WPC_01_200ms_WPC_IndSyncVal, ComSystemTemplateSystemSignalRef=WPC_IndSyncVal
        ComISignal_BCAN_WPC_01_200ms_USM_CmdWPCIndSta: ComBitPosition=43, ComSignalInitValue=2, ComHandleId=31, ComTimeout=1.5, ComNotification=Rte_COMCbk_ComISignal_BCAN_WPC_01_200ms_USM_CmdWPCIndSta, ComTimeoutNotification=Rte_COMCbkRxTOut_ComISignal_BCAN_WPC_01_200ms_USM_CmdWPCIndSta, ComSystemTemplateSystemSignalRef=USM_CmdWPCIndSta
      ComIPdu_BCAN_HU_USM_E_14 (ComIPdu):
        category = TOOL_CONFIGURED
        ComIPduDirection = RECEIVE
        ComIPduHandleId = 24
        ComIPduType = NORMAL
        ComIPduSignalProcessing = DEFERRED
        ComIPduSignalRef = ComISignal_BCAN_HU_USM_E_14_CF_Gway_WPCAnimationNvalueSet
        ComPduIdRef = Pdu_ISignalIPdu_BCAN_HU_USM_E_14
        ComIPduGroupRef = ComIPduGroupRx_SCM_BCAN
      ComISignal_BCAN_HU_USM_E_14_CF_Gway_WPCAnimationNvalueSet (ComSignal):
        category = TOOL_CONFIGURED
        ComBitPosition = 40
        ComBitSize = 3
        ComSignalEndianness = LITTLE_ENDIAN
        ComSignalInitValue = 0
        ComSignalLength = 1
        ComSignalType = UINT8
        ComTransferProperty = TRIGGERED_ON_CHANGE
        ComSigReportIdsMEnable = 0
        ComHandleId = 33
        ComTimeout = 0.0
        ComNotification = Rte_COMCbk_ComISignal_BCAN_HU_USM_E_14_CF_Gway_WPCAnimationNvalueSet
        ComSystemTemplateSystemSignalRef = CF_Gway_WPCAnimationNvalueSet
      ComISignal_BCAN_SBCM_DRV_01_200ms_Latch_TypeOption_DRV (ComSignal):
        category = TOOL_CONFIGURED
        ComBitPosition = 36
        ComBitSize = 2
        ComSignalEndianness = LITTLE_ENDIAN
        ComSignalInitValue = 0
        ComSignalLength = 1
        ComSignalType = UINT8
        ComTransferProperty = TRIGGERED_ON_CHANGE
        ComSigReportIdsMEnable = 0
        ComHandleId = 15
        ComTimeout = 1.5
        ComNotification = Rte_COMCbk_ComISignal_BCAN_SBCM_DRV_01_200ms_Latch_TypeOption_DRV
        ComSystemTemplateSystemSignalRef = Latch_TypeOption_DRV
    ComGeneral:
      ComSupportedIPduGroups = 4
      ComVersionInfoApi = 0
      ComRetryFailedTransmitRequests = 0
      ComEnableMDTForCyclicTransmission = 1
      ComConfigurationUseDet = 1
      ComMainFunctionBasedTransmit = 1
      ComEnableSignalGroupArrayApi = 0
      ComRxInterruptBased = 0
      ComTxInterruptBased = 0

AUTOSAR XML (schema 4-0-3)
package /AUTOSAR
  module config CanTrcv_255_Autron: definition=CanTrcv, implementation-config-variant=VARIANT-PRE-COMPILE, module-description=BswImplementation_CanTrcv_255_Autron
    CanTrcvGeneral
    CanTrcvConfigSet
      CanTrcvChannel_BCAN (CanTrcvChannel): CanTrcvChannelId=0, CanTrcvChannelUsed=1, CanTrcvControlsPowerSupply=0, CanTrcvHwPnSupport=0
      CanTrcvChannel_LOCALCAN (CanTrcvChannel): CanTrcvChannelId=1, CanTrcvChannelUsed=1, CanTrcvControlsPowerSupply=0, CanTrcvHwPnSupport=0

AUTOSAR XML (schema 4-0-3)
package /AUTOSAR
  module config PduR: implementation-config-variant=VARIANT-PRE-COMPILE, module-description=BswImplementation_PduR
    PduRGeneral: PduRDevErrorDetect=1, PduRVersionInfoApi=0, PduRZeroCostOperation=0, PduRRxInterruptBased=0, PduRTxInterruptBased=0
    PduRRoutingTables: PduRConfigurationId=0
      PduRRoutingTable: category=TOOL_CONFIGURED, PduRIsMinimumRouting=0
        32 x PduRRoutingPath, all with category=TOOL_CONFIGURED:
          IN_BCAN_SMK_06_200ms_RoutingPath
            PduR_BCAN_SMK_06_200ms_DestPdu (PduRDestPdu): category=TOOL_CONFIGURED, PduRDestPduHandleId=0, PduRTransmissionConfirmation=1, PduRDestPduRef=Pdu_ISignalIPdu_BCAN_SMK_06_200ms
            PduR_BCAN_SMK_06_200ms_SrcPdu (PduRSrcPdu): category=TOOL_CONFIGURED, PduRSourcePduHandleId=0, PduRSrcPduRef=Pdu_ISignalIPdu_BCAN_SMK_06_200ms
          IN_BCAN_BCM_12_200ms_RoutingPath
            PduR_BCAN_BCM_12_200ms_DestPdu (PduRDestPdu): category=TOOL_CONFIGURED, PduRDestPduHandleId=1, PduRTransmissionConfirmation=1, PduRDestPduRef=Pdu_ISignalIPdu_BCAN_BCM_12_200ms
            PduR_BCAN_BCM_12_200ms_SrcPdu (PduRSrcPdu): category=TOOL_CONFIGURED, PduRSourcePduHandleId=1, PduRSrcPduRef=Pdu_ISignalIPdu_BCAN_BCM_12_200ms
          IN_BCAN_EMS_02_10ms_1_RoutingPath
            PduR_BCAN_EMS_02_10ms_1_DestPdu (PduRDestPdu): category=TOOL_CONFIGURED, PduRDestPduHandleId=2, PduRTransmissionConfirmation=1, PduRDestPduRef=Pdu_ISignalIPdu_BCAN_EMS_02_10ms_1
            PduR_BCAN_EMS_02_10ms_1_SrcPdu (PduRSrcPdu): category=TOOL_CONFIGURED, PduRSourcePduHandleId=2, PduRSrcPduRef=Pdu_ISignalIPdu_BCAN_EMS_02_10ms_1
          IN_BCAN_BCM_07_200ms_RoutingPath
            PduR_BCAN_BCM_07_200ms_DestPdu (PduRDestPdu): category=TOOL_CONFIGURED, PduRDestPduHandleId=3, PduRTransmissionConfirmation=1, PduRDestPduRef=Pdu_ISignalIPdu_BCAN_BCM_07_200ms
            PduR_BCAN_BCM_07_200ms_SrcPdu (PduRSrcPdu): category=TOOL_CONFIGURED, PduRSourcePduHandleId=3, PduRSrcPduRef=Pdu_ISignalIPdu_BCAN_BCM_07_200ms
          IN_BCAN_ICU_02_200ms_RoutingPath
            PduR_BCAN_ICU_02_200ms_DestPdu (PduRDestPdu): category=TOOL_CONFIGURED, PduRDestPduHandleId=4, PduRTransmissionConfirmation=1, PduRDestPduRef=Pdu_ISignalIPdu_BCAN_ICU_02_200ms
            PduR_BCAN_ICU_02_200ms_SrcPdu (PduRSrcPdu): category=TOOL_CONFIGURED, PduRSourcePduHandleId=4, PduRSrcPduRef=Pdu_ISignalIPdu_BCAN_ICU_02_200ms
          IN_BCAN_VCU_01_10ms_1_RoutingPath
            PduR_BCAN_VCU_01_10ms_1_DestPdu (PduRDestPdu): category=TOOL_CONFIGURED, PduRDestPduHandleId=5, PduRTransmissionConfirmation=1, PduRDestPduRef=Pdu_ISignalIPdu_BCAN_VCU_01_10ms_1
            PduR_BCAN_VCU_01_10ms_1_SrcPdu (PduRSrcPdu): category=TOOL_CONFIGURED, PduRSourcePduHandleId=5, PduRSrcPduRef=Pdu_ISignalIPdu_BCAN_VCU_01_10ms_1
          IN_BCAN_IAU_16_200ms_RoutingPath
            PduR_BCAN_IAU_16_200ms_DestPdu (PduRDestPdu): category=TOOL_CONFIGURED, PduRDestPduHandleId=6, PduRTransmissionConfirmation=1, PduRDestPduRef=Pdu_ISignalIPdu_BCAN_IAU_16_200ms
            PduR_BCAN_IAU_16_200ms_SrcPdu (PduRSrcPdu): category=TOOL_CONFIGURED, PduRSourcePduHandleId=6, PduRSrcPduRef=Pdu_ISignalIPdu_BCAN_IAU_16_200ms
          IN_BCAN_HU_GW_PE_01_RoutingPath
            PduR_BCAN_HU_GW_PE_01_DestPdu (PduRDestPdu): category=TOOL_CONFIGURED, PduRDestPduHandleId=7, PduRTransmissionConfirmation=1, PduRDestPduRef=Pdu_ISignalIPdu_BCAN_HU_GW_PE_01
            PduR_BCAN_HU_GW_PE_01_SrcPdu (PduRSrcPdu): category=TOOL_CONFIGURED, PduRSourcePduHandleId=7, PduRSrcPduRef=Pdu_ISignalIPdu_BCAN_HU_GW_PE_01
          IN_BCAN_HU_USM_E_04_RoutingPath
            PduR_BCAN_HU_USM_E_04_DestPdu (PduRDestPdu): category=TOOL_CONFIGURED, PduRDestPduHandleId=8, PduRTransmissionConfirmation=1, PduRDestPduRef=Pdu_ISignalIPdu_BCAN_HU_USM_E_04
            PduR_BCAN_HU_USM_E_04_SrcPdu (PduRSrcPdu): category=TOOL_CONFIGURED, PduRSourcePduHandleId=8, PduRSrcPduRef=Pdu_ISignalIPdu_BCAN_HU_USM_E_04
          IN_BCAN_HU_USM_E_02_RoutingPath
            PduR_BCAN_HU_USM_E_02_DestPdu (PduRDestPdu): category=TOOL_CONFIGURED, PduRDestPduHandleId=9, PduRTransmissionConfirmation=1, PduRDestPduRef=Pdu_ISignalIPdu_BCAN_HU_USM_E_02
            PduR_BCAN_HU_USM_E_02_SrcPdu (PduRSrcPdu): category=TOOL_CONFIGURED, PduRSourcePduHandleId=9, PduRSrcPduRef=Pdu_ISignalIPdu_BCAN_HU_USM_E_02
          IN_BCAN_EMS_07_10ms_2_RoutingPath
            PduR_BCAN_EMS_07_10ms_2_DestPdu (PduRDestPdu): category=TOOL_CONFIGURED, PduRDestPduHandleId=10, PduRTransmissionConfirmation=1, PduRDestPduRef=Pdu_ISignalIPdu_BCAN_EMS_07_10ms_2
            PduR_BCAN_EMS_07_10ms_2_SrcPdu (PduRSrcPdu): category=TOOL_CONFIGURED, PduRSourcePduHandleId=10, PduRSrcPduRef=Pdu_ISignalIPdu_BCAN_EMS_07_10ms_2
          IN_BCAN_SBCM_DRV_01_200ms_RoutingPath
            PduR_BCAN_SBCM_DRV_01_200ms_DestPdu (PduRDestPdu): category=TOOL_CONFIGURED, PduRDestPduHandleId=11, PduRTransmissionConfirmation=1, PduRDestPduRef=Pdu_ISignalIPdu_BCAN_SBCM_DRV_01_200ms
            PduR_BCAN_SBCM_DRV_01_200ms_SrcPdu (PduRSrcPdu): category=TOOL_CONFIGURED, PduRSourcePduHandleId=11, PduRSrcPduRef=Pdu_ISignalIPdu_BCAN_SBCM_DRV_01_200ms
          IN_BCAN_CLU_01_20ms_1_RoutingPath
            PduR_BCAN_CLU_01_20ms_1_DestPdu (PduRDestPdu): category=TOOL_CONFIGURED, PduRDestPduHandleId=12, PduRTransmissionConfirmation=1, PduRDestPduRef=Pdu_ISignalIPdu_BCAN_CLU_01_20ms_1
            PduR_BCAN_CLU_01_20ms_1_SrcPdu (PduRSrcPdu): category=TOOL_CONFIGURED, PduRSourcePduHandleId=12, PduRSrcPduRef=Pdu_ISignalIPdu_BCAN_CLU_01_20ms_1
          IN_BCAN_CLU_01_20ms_2_RoutingPath
            PduR_BCAN_CLU_01_20ms_2_DestPdu (PduRDestPdu): category=TOOL_CONFIGURED, PduRDestPduHandleId=13, PduRTransmissionConfirmation=1, PduRDestPduRef=Pdu_ISignalIPdu_BCAN_CLU_01_20ms_2
            PduR_BCAN_CLU_01_20ms_2_SrcPdu (PduRSrcPdu): category=TOOL_CONFIGURED, PduRSourcePduHandleId=13, PduRSrcPduRef=Pdu_ISignalIPdu_BCAN_CLU_01_20ms_2
          IN_BCAN_HCU_03_10ms_2_RoutingPath
            PduR_BCAN_HCU_03_10ms_2_DestPdu (PduRDestPdu): category=TOOL_CONFIGURED, PduRDestPduHandleId=14, PduRTransmissionConfirmation=1, PduRDestPduRef=Pdu_ISignalIPdu_BCAN_HCU_03_10ms_2
            PduR_BCAN_HCU_03_10ms_2_SrcPdu (PduRSrcPdu): category=TOOL_CONFIGURED, PduRSourcePduHandleId=14, PduRSrcPduRef=Pdu_ISignalIPdu_BCAN_HCU_03_10ms_2
          IN_BCAN_SBCM_AST_02_200ms_RoutingPath
            PduR_BCAN_SBCM_AST_02_200ms_DestPdu (PduRDestPdu): category=TOOL_CONFIGURED, PduRDestPduHandleId=15, PduRTransmissionConfirmation=1, PduRDestPduRef=Pdu_ISignalIPdu_BCAN_SBCM_AST_02_200ms
            PduR_BCAN_SBCM_AST_02_200ms_SrcPdu (PduRSrcPdu): category=TOOL_CONFIGURED, PduRSourcePduHandleId=15, PduRSrcPduRef=Pdu_ISignalIPdu_BCAN_SBCM_AST_02_200ms
          IN_BCAN_SBCM_RL_01_200ms_RoutingPath
            PduR_BCAN_SBCM_RL_01_200ms_DestPdu (PduRDestPdu): category=TOOL_CONFIGURED, PduRDestPduHandleId=16, PduRTransmissionConfirmation=1, PduRDestPduRef=Pdu_ISignalIPdu_BCAN_SBCM_RL_01_200ms
            PduR_BCAN_SBCM_RL_01_200ms_SrcPdu (PduRSrcPdu): category=TOOL_CONFIGURED, PduRSourcePduHandleId=16, PduRSrcPduRef=Pdu_ISignalIPdu_BCAN_SBCM_RL_01_200ms
          IN_BCAN_GST_ALL_RoutingPath
            PduR_DcmIPdu_BCAN_GST_ALL_DestPdu (PduRDestPdu): category=TOOL_CONFIGURED, PduRDestPduHandleId=0, PduRTransmissionConfirmation=1, PduRDestPduRef=Pdu_DcmIPdu_BCAN_GST_ALL
            PduR_DcmIPdu_BCAN_GST_ALL_SrcPdu (PduRSrcPdu): category=TOOL_CONFIGURED, PduRSourcePduHandleId=0, PduRSrcPduRef=Pdu_DcmIPdu_BCAN_GST_ALL
          IN_BCAN_SBCM_RR_01_200ms_RoutingPath
            PduR_BCAN_SBCM_RR_01_200ms_DestPdu (PduRDestPdu): category=TOOL_CONFIGURED, PduRDestPduHandleId=17, PduRTransmissionConfirmation=1, PduRDestPduRef=Pdu_ISignalIPdu_BCAN_SBCM_RR_01_200ms
            PduR_BCAN_SBCM_RR_01_200ms_SrcPdu (PduRSrcPdu): category=TOOL_CONFIGURED, PduRSourcePduHandleId=17, PduRSrcPduRef=Pdu_ISignalIPdu_BCAN_SBCM_RR_01_200ms
          IN_LOCALCAN_BDC_01_RoutingPath
            PduR_LOCALCAN_BDC_01_DestPdu (PduRDestPdu): category=TOOL_CONFIGURED, PduRDestPduHandleId=18, PduRTransmissionConfirmation=1, PduRDestPduRef=Pdu_ISignalIPdu_LOCALCAN_BDC_01
            PduR_LOCALCAN_BDC_01_SrcPdu (PduRSrcPdu): category=TOOL_CONFIGURED, PduRSourcePduHandleId=18, PduRSrcPduRef=Pdu_ISignalIPdu_LOCALCAN_BDC_01
          IN_LOCALCAN_BDC_10_RoutingPath
            PduR_LOCALCAN_BDC_10_DestPdu (PduRDestPdu): category=TOOL_CONFIGURED, PduRDestPduHandleId=19, PduRTransmissionConfirmation=1, PduRDestPduRef=Pdu_ISignalIPdu_LOCALCAN_BDC_10
            PduR_LOCALCAN_BDC_10_SrcPdu (PduRSrcPdu): category=TOOL_CONFIGURED, PduRSourcePduHandleId=19, PduRSrcPduRef=Pdu_ISignalIPdu_LOCALCAN_BDC_10
          IN_LOCALCAN_TP_BDC_C_WPC_RoutingPath
            PduR_LOCALCAN_TP_BDC_C_WPC_DestPdu (PduRDestPdu): category=TOOL_CONFIGURED, PduRDestPduHandleId=1, PduRTransmissionConfirmation=1, PduRDestPduRef=Pdu_ISignalIPdu_LOCALCAN_TP_BDC_C_WPC
            PduR_LOCALCAN_TP_BDC_C_WPC_SrcPdu (PduRSrcPdu): category=TOOL_CONFIGURED, PduRSourcePduHandleId=1, PduRSrcPduRef=Pdu_ISignalIPdu_LOCALCAN_TP_BDC_C_WPC
          OUT_LOCALCAN_WPC_01_RoutingPath
            PduR_LOCALCAN_WPC_01_DestPdu (PduRDestPdu): category=TOOL_CONFIGURED, PduRDestPduHandleId=0, PduRTransmissionConfirmation=1, PduRDestPduRef=Pdu_ISignalIPdu_LOCALCAN_WPC_01
            PduR_LOCALCAN_WPC_01_SrcPdu (PduRSrcPdu): category=TOOL_CONFIGURED, PduRSourcePduHandleId=0, PduRSrcPduRef=Pdu_ISignalIPdu_LOCALCAN_WPC_01
          OUT_LOCALCAN_WPC_10_RoutingPath
            PduR_LOCALCAN_WPC_10_DestPdu (PduRDestPdu): category=TOOL_CONFIGURED, PduRDestPduHandleId=1, PduRTransmissionConfirmation=1, PduRDestPduRef=Pdu_ISignalIPdu_LOCALCAN_WPC_10
            PduR_LOCALCAN_WPC_10_SrcPdu (PduRSrcPdu): category=TOOL_CONFIGURED, PduRSourcePduHandleId=1, PduRSrcPduRef=Pdu_ISignalIPdu_LOCALCAN_WPC_10
          OUT_LOCALCAN_TP_WPC_C_BDC_RoutingPath
            PduR_LOCALCAN_TP_WPC_C_BDC_DestPdu (PduRDestPdu): category=TOOL_CONFIGURED, PduRDestPduHandleId=0, PduRTransmissionConfirmation=1, PduRDestPduRef=Pdu_ISignalIPdu_LOCALCAN_TP_WPC_C_BDC
            PduR_LOCALCAN_TP_WPC_C_BDC_SrcPdu (PduRSrcPdu): category=TOOL_CONFIGURED, PduRSourcePduHandleId=2, PduRSrcPduRef=Pdu_ISignalIPdu_LOCALCAN_TP_WPC_C_BDC
          IN_BCAN_ATS_00_00ms_RoutingPath
            PduR_BCAN_ATS_00_00ms_DestPdu (PduRDestPdu): category=TOOL_CONFIGURED, PduRDestPduHandleId=20, PduRTransmissionConfirmation=1, PduRDestPduRef=Pdu_ISignalIPdu_BCAN_ATS_00_00ms
            PduR_BCAN_ATS_00_00ms_SrcPdu (PduRSrcPdu): category=TOOL_CONFIGURED, PduRSourcePduHandleId=20, PduRSrcPduRef=Pdu_ISignalIPdu_BCAN_ATS_00_00ms
          IN_BCAN_GST_RWPC_RoutingPath
            PduR_DcmIPdu_BCAN_GST_RWPC_DestPdu (PduRDestPdu): category=TOOL_CONFIGURED, PduRDestPduHandleId=2, PduRTransmissionConfirmation=1, PduRDestPduRef=Pdu_DcmIPdu_BCAN_GST_RWPC
            PduR_DcmIPdu_BCAN_GST_RWPC_SrcPdu (PduRSrcPdu): category=TOOL_CONFIGURED, PduRSourcePduHandleId=2, PduRSrcPduRef=Pdu_DcmIPdu_BCAN_GST_RWPC
          OUT_BCAN_RWPC_01_200ms_RoutingPath
            PduR_BCAN_RWPC_01_200ms_DestPdu (PduRDestPdu): category=TOOL_CONFIGURED, PduRDestPduHandleId=2, PduRTransmissionConfirmation=1, PduRDestPduRef=Pdu_ISignalIPdu_BCAN_RWPC_01_200ms
            PduR_BCAN_RWPC_01_200ms_SrcPdu (PduRSrcPdu): category=TOOL_CONFIGURED, PduRSourcePduHandleId=3, PduRSrcPduRef=Pdu_ISignalIPdu_BCAN_RWPC_01_200ms
          OUT_BCAN_RWPC_GST_RoutingPath
            PduR_DcmIPdu_BCAN_RWPC_GST_DestPdu (PduRDestPdu): category=TOOL_CONFIGURED, PduRDestPduHandleId=1, PduRTransmissionConfirmation=1, PduRDestPduRef=Pdu_DcmIPdu_BCAN_RWPC_GST
            PduR_DcmIPdu_BCAN_RWPC_GST_SrcPdu (PduRSrcPdu): category=TOOL_CONFIGURED, PduRSourcePduHandleId=4, PduRSrcPduRef=Pdu_DcmIPdu_BCAN_RWPC_GST
          IN_BCAN_WPC_01_200ms_RoutingPath
            PduR_BCAN_WPC_01_200ms_DestPdu (PduRDestPdu): category=TOOL_CONFIGURED, PduRDestPduHandleId=21, PduRTransmissionConfirmation=1, PduRDestPduRef=Pdu_ISignalIPdu_BCAN_WPC_01_200ms
            PduR_BCAN_WPC_01_200ms_SrcPdu (PduRSrcPdu): category=TOOL_CONFIGURED, PduRSourcePduHandleId=21, PduRSrcPduRef=Pdu_ISignalIPdu_BCAN_WPC_01_200ms
          IN_BCAN_WPC2_01_200ms_RoutingPath
            PduR_BCAN_WPC2_01_200ms_DestPdu (PduRDestPdu): category=TOOL_CONFIGURED, PduRDestPduHandleId=22, PduRTransmissionConfirmation=1, PduRDestPduRef=Pdu_ISignalIPdu_BCAN_WPC2_01_200ms
            PduR_BCAN_WPC2_01_200ms_SrcPdu (PduRSrcPdu): category=TOOL_CONFIGURED, PduRSourcePduHandleId=22, PduRSrcPduRef=Pdu_ISignalIPdu_BCAN_WPC2_01_200ms
          IN_BCAN_HU_USM_E_14_RoutingPath
            PduR_BCAN_HU_USM_E_14_DestPdu (PduRDestPdu): category=TOOL_CONFIGURED, PduRDestPduHandleId=23, PduRTransmissionConfirmation=1, PduRDestPduRef=Pdu_ISignalIPdu_BCAN_HU_USM_E_14
            PduR_BCAN_HU_USM_E_14_SrcPdu (PduRSrcPdu): category=TOOL_CONFIGURED, PduRSourcePduHandleId=23, PduRSrcPduRef=Pdu_ISignalIPdu_BCAN_HU_USM_E_14
      PduRRoutingPathGroup0 (PduRRoutingPathGroup): PduRIsEnabledAtInit=1, PduRRoutingPathGroupId=0
      PduRTxBufferTable (PduRTpBufferTable): PduRMaxTpBufferNumber=1
        PduRTxBuffer0 (PduRTpBuffer): PduRTpBufferLength=8
    4 x PduRBswModules, all with PduRChangeParameterRequestApi=0, PduRRetransmission=0, PduRTxConfirmation=1, PduRUseTag=0:
      PduRBswModules_CanIf: PduRCancelReceive=0, PduRCancelTransmit=0, PduRCommunicationInterface=1, PduRLowerModule=1, PduRTransportProtocol=0, PduRTriggertransmit=0, PduRUpperModule=0, PduRBswModuleRef=CanIf
      PduRBswModules_Com: PduRCancelReceive=0, PduRCancelTransmit=0, PduRCommunicationInterface=1, PduRLowerModule=0, PduRTransportProtocol=1, PduRTriggertransmit=1, PduRUpperModule=1, PduRBswModuleRef=Com
      PduRBswModules_Dcm: PduRCancelReceive=1, PduRCancelTransmit=1, PduRCommunicationInterface=0, PduRLowerModule=0, PduRTransportProtocol=1, PduRTriggertransmit=0, PduRUpperModule=1, PduRBswModuleRef=Dcm
      PduRBswModules_CanTp: PduRCancelReceive=1, PduRCancelTransmit=1, PduRCommunicationInterface=0, PduRLowerModule=1, PduRTransportProtocol=1, PduRTriggertransmit=0, PduRUpperModule=0, PduRBswModuleRef=CanTp

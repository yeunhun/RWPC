[part 3 of 5: package /AUTOSAR/EcucDefs]
AUTOSAR XML (schema 4-0-3)
# The material contained in this specification is protected by copyright and
# other types of Intellectual Property Rights. The commercial exploitation of
# the material contained in this specification requires a license to such
# Intellectual Property Rights.
# This specification may be utilized or reproduced without any modification, in
# any form or by any means, for informational purposes only.
# For any other purpose, no part of the specification may be utilized or
# reproduced, in any form or by any means, without permission in writing from
# the publisher.
# licensed under the same rules as applicable to the AUTOSAR Standard.
package /AUTOSAR/EcucDefs  (continued)
  module definition Dem [0..1]: variants post-build/pre-compile  # Configuration of the Dem (Diagnostic Event Manager) module.
    container DemConfigSet: multiple-configuration-container=true  # This container contains the configuration parameters and sub containers of the Dem module supporting multiple configuration sets. This container is a MultipleConfigurationContainer, i.e. this container and its sub-containers exist once per configuration set.
      container DemDTCClass [0..65535]  # This container contains the configuration (parameters) for DTCClass.
        integer DemDTCFunctionalUnit: 0..255, set at pre-compile  # DTCFuncitonalUnit is a 1-byte value which identifies the corresponding basic vehicle / system function which reports the DTC. This parameter is necessary for the report of severity informations.
        enumeration DemDTCSeverity [0..1]: {DEM_DTC_SEV_CHECK_AT_NEXT_HALT, DEM_DTC_SEV_IMMEDIATELY, DEM_DTC_SEV_MAINTENANCE_ONLY, DEM_DTC_SEV_NO_SEVERITY}, set at pre-compile  # DTC severity | This parameter depends on automotive manufacturer and is optional.
        boolean DemImmediateNvStorage: set at pre-compile  # Switch to enable immediate storage triggering of an according event memory entriy persistently to NVRAM. | true: immediate non-volatile storage triggering enabled false: immediate non-volatile storage triggering disabled
        integer DemObdDTC [0..1]: 1..65535, set at post-build in variant post-build / pre-compile in variant pre-compile  # Unique Diagnostic Trouble Code value for OBD
        integer DemUdsDTC [0..1]: 1..16777214, set at post-build in variant post-build / pre-compile in variant pre-compile  # Unique Diagnostic Trouble Code value for UDS | (Range: 0x000000 and 0xFFFFFF are reserved for DTC groups by ISO 14229-1)
        container DemCallbackInitMForF [0..*]  # The presence of this container indicates, that the Dem has access to an "InitMonitorForFunction" callback, which the Dem will call to initialize a monitor. | In case the container has a DemCallbackInitMForFFnc, this parameter defines the name of the function that the Dem will call. In case there is no DemCallbackInitMForFFnc, the Dem will have an R-Port requiring the interface CallbackInitMonitorForFunction, whose name is generated by using the unique callback-prefix followed by the event name.
          function name DemCallbackInitMForFFnc [0..1]: set at pre-compile  # Function name of prototype "InitMonitorForFunction".
      container DemEventParameter [1..65535]  # This container contains the configuaration (parameters) for events. | Note that this container definition does not explicitly define a symbolic name parameter. Instead, the short name of the container will be used in the Ecu Configuration Description to specify the symbolic name of the diagonstic event.
        integer DemEventId: 1..65535, set at pre-compile, symbolic-name-value=true  # Unique identifier of a diagnostic event. | This parameter should not be changeable by user, because the Id should be generated by Dem itself to prevent gaps and multiple use of an Id. The events should be sequentially ordered beginning with 1 and no gaps in between.
        enumeration DemEventKind: {DEM_EVENT_KIND_BSW, DEM_EVENT_KIND_SWC}, set at pre-compile  # This parameter is used to distinguish between SW-C and BSW events. SW-C events are reported by Dem_SetEventStatus API and BSW events are reported by Dem_ReportErrorStatus API.
        integer DemMaxNumberFreezeFrameRecords: 0..255, set at pre-compile  # This parameter defines the number of according freeze frame records, which can maximal be stored for this event. Therefore all these freeze frame records have the same freeze frame class. | This parameter is only required for calculated record numeration (refer to DemTypeOfFreezeFrameRecordNumeration).
        reference DemDTCClassRef [0..1]: set at pre-compile, destination=DemDTCClass  # This parameter defines the DTC configuration associated with the diagnostic event. | It is allowed to have events without a DTC (e.g. for ECU-internal events triggering safety reactions without being reported via diagnostic communication). The same DemDTCClass can be used from several events, to combine these (refer to chapter "Combination of diagonstic event").
        reference DemExtendedDataClassRef [0..1]: set at pre-compile, destination=DemExtendedDataClass  # This reference defines the link to an extended data class sampler.
        reference DemFreezeFrameClassRef [0..1]: set at pre-compile, destination=DemFreezeFrameClass  # These references define the links to a freeze frame class sampler.
        reference DemFreezeFrameRecNumClassRef: set at pre-compile, destination=DemFreezeFrameRecNumClass  # This parameter defines the list of dedicated freeze frame record numbers associated with the diagnostic event. These record numbers are assigned to the freeze frame records (instead of calculated record numbers). | This parameter is only required for configured record numeration (refer to DemTypeOfFreezeFrameRecordNumeration).
        container DemCallbackClearEventAllowed [0..1]  # The presence of this container indicates that the Dem has access to a "ClearEventAllowed" callback. | In case there is a DemCallbackClearEventAllowedFnc, this parameter defines the name of the function that the Dem will call. In case there is no DemCallbackClearEventAllowedFnc, the Dem will have an R-Port requiring the interface CallbackClearEventAllowed whose name is generated by using the unique callback-prefix followed by the event name.
          function name DemCallbackClearEventAllowedFnc [0..1]: set at pre-compile  # Function name of prototype "ClearEventAllowed".
        container DemCallbackEventDataChanged [0..1]  # The presence of this container indicates that the Dem has access to an "EventDataChanged" callback. | In case there is a DemCallbackEventDataChangedFnc, this parameter defines the name of the function that the Dem will call. In case there is no DemCallbackEventDataChangedFnc, the Dem will have an R-Port requiring the interface CallbackEventDataChanged whose name is generated by using the unique callback-prefix followed by the event name.
          function name DemCallbackEventDataChangedFnc [0..1]: set at pre-compile  # Function name of prototype "EventDataChanged"
        container DemCallbackEventStatusChanged [0..*]  # The presence of this container indicates, that the Dem has access to an "EventStatusChanged" callback, which the Dem will call to notify other components about the change in the status of an event. | In case there is a DemCallbackEvenStatusChangedFnc, this parameter defines the name of the function that the Dem will call. In case there is no DemCallbackEvenStatusChangedFnc, the Dem will have an R-Port requiring the interface CallbackEventStatusChanged, whose name is generated by using the unique callback-prefix followed by the event name.
          function name DemCallbackEventStatusChangedFnc [0..1]: set at pre-compile  # Function name of prototype "EventStatusChanged"
        container DemCallbackInitMForE [0..1]  # The presence of this container indicates, that the Dem has access to an "InitMonitorForEvent" callback, which the Dem will call to initialize a monitor. | In case the container has a DemCallbackInitMForEFnc, this parameter defines the name of the function that the Dem will call. In case there is no DemCallbackInitMForEFnc, the Dem will have an R-Port requiring the interface CallbackInitMonitorForEvent, whose name is generated by using the unique callback-prefix followed by the event name.
          function name DemCallbackInitMForEFnc [0..1]: set at pre-compile  # Function name of prototype "InitMonitorForEvent".
        container DemEventClass  # This container contains the configuaration (parameters) for EventClass
          boolean DemAgingAllowed: set at pre-compile  # Switch to allow aging/unlearning of the event or not. | true: aging allowed false: aging not allowed
          integer DemAgingCycleCounterThreshold [0..1]: 1..256, set at pre-compile  # Number ot aging cycles needed to unlearn/delete the event.
          boolean DemConsiderPtoStatus: set at pre-compile  # This parameter is TRUE, when the event is affected by the Dem PTO handling.
          enumeration DemEventDestination [0..4]: {DEM_DTC_ORIGIN_MIRROR_MEMORY, DEM_DTC_ORIGIN_PRIMARY_MEMORY, DEM_DTC_ORIGIN_SECONDARY_MEMORY}, set at pre-compile  # The event destination assigns events to none, one or multiple origins. | If no event destination is assigned to a specific event, the event is handled internally and is not visible externally to the Dcm. If more than one event destination is assigned to a specific event, the event can be present in the corresponding origins.
          integer DemEventFailureCycleCounterThreshold [0..1]: 1..256, set at pre-compile  # Defines the number of failure cycles for the event based fault confirmation.
          enumeration DemEventOBDReadinessGroup: {DEM_OBD_RDY_AC, DEM_OBD_RDY_BOOSTPR, DEM_OBD_RDY_CAT, DEM_OBD_RDY_CMPRCMPT, DEM_OBD_RDY_EGSENS, DEM_OBD_RDY_ERG, DEM_OBD_RDY_EVAP, DEM_OBD_RDY_FLSYS, DEM_OBD_RDY_HCCAT, DEM_OBD_RDY_HTCAT, DEM_OBD_RDY_MISF, DEM_OBD_RDY_NONE, DEM_OBD_RDY_NOXCAT, DEM_OBD_RDY_O2SENS, DEM_OBD_RDY_O2SENSHT, DEM_OBD_RDY_PMFLT, DEM_OBD_RDY_SECAIR}, set at pre-compile  # This parameter specifies the Event OBD Readiness group for PID $01 and PID $41 computation. | This parameter is only applicable for emission-related ECUs.
          integer DemEventPriority: 1..256, set at pre-compile  # Priority of the event, in view of full event buffer.
          enumeration DemEventSignificance [0..1]: {DEM_EVENT_SIGNIFICANCE_FAULT, DEM_EVENT_SIGNIFICANCE_OCCURRENCE}, set at pre-compile  # Significance of the event, which indicates additional information concerning fault classification and resolution. | It can be mapped as Dem-internal data element. It shall be configured, if it is a part of event related data.
          boolean DemFFPrestorageSupported: set at pre-compile  # If this parameter is set to true, then the Prestorage of FreezeFrames is supported by the assigned event. This parameter is useful to calculate the buffer size.
          choice reference DemAgingCycleRef [0..1]: set at pre-compile, origin=AUTOSAR_ECUC V1.0.0, destination=[DemAgingCycle, DemOperationCycle]  # Reference to the cycle which is triggering the aging of the event. This can either be the same as the operation cycle of the event, or a separate aging cycle reported via API Dem_SetAgingCycleState. If external aging is configured (refer to DemAgingCycleCounterProcessing), this parameter is not used.
          reference DemEnableConditionGroupRef [0..1]: set at pre-compile, origin=AUTOSAR_ECUC V1.0.0, destination=DemEnableConditionGroup  # References an enable condition group.
          reference DemEventFailureCycleRef [0..1]: set at pre-compile, origin=AUTOSAR_ECUC V1.0.0, destination=DemOperationCycle  # Kind of failure cycle for the event based fault confirmation.
          reference DemOperationCycleRef: set at pre-compile, origin=AUTOSAR_ECUC V1.0.0, destination=DemOperationCycle  # Kind of operation cycle for the event (e.g. power cycle, driving cycle, ...)
          reference DemStorageConditionGroupRef [0..1]: set at pre-compile, origin=AUTOSAR_ECUC V1.0.0, destination=DemStorageConditionGroup  # References a storage condition group.
          choice container DemDebounceAlgorithmClass  # Debounce algorithm class: counter based, time based, or monitor internal.
            container DemDebounceCounterBased [0..1]  # This container contains the configuration (parameters) for counter based debouncing.
              integer DemDebounceCounterDecrementStepSize: 0..32768, set at pre-compile  # Defines the step size for decrementation of the internal fault detection counter (PREPASSED).
              integer DemDebounceCounterFailedThreshold: 0..32767, set at pre-compile  # Defines the value of the internal fault detection counter, which indicates the failed status.
              integer DemDebounceCounterIncrementStepSize: 0..32767, set at pre-compile  # Defines the step size for incrementation of the internal fault detection counter (PREFAILED).
              boolean DemDebounceCounterJumpDown: set at pre-compile  # Switch for the activation of Jump-Down. | true: Jump-Down activated false: Jump-Down deactivated
              integer DemDebounceCounterJumpDownValue: -32768..32767, set at pre-compile  # Jump-Down value of the internal fault detection counter.
              boolean DemDebounceCounterJumpUp: set at pre-compile  # Switch for the activation of Jump-Up. | true: Jump-Up activated false: Jump-Up deactivated
              integer DemDebounceCounterJumpUpValue: -32768..32767, set at pre-compile  # Jump-Up value of the internal fault detection counter.
              integer DemDebounceCounterPassedThreshold: -32768..0, set at pre-compile  # Defines the value of the internal fault detection counter, which indicates the passed status.
            container DemDebounceMonitorInternal [0..1]  # This container contains the configuration (parameters) for monitor internal debouncing.
              container DemCallbackGetFDC  # The presence of this container indicates, that the Dem has access to a "GetFaultDetectionCounter" callback, which the Dem will call to obtain the value of the fault detection counter. | In case the container has a DemCallbackGetFDCFnc, this parameter defines the name of the function that the Dem will call. In case there is no DemCallbackGetFDCFnc, the Dem will have a R-Port requiring the interface CallbackGetFaultDetectionCounter, whose name is generated by using the unique callback-prefix followed by the event name.
                function name DemCallbackGetFDCFnc [0..1]: set at pre-compile  # Function name of prototype "GetFaultDetectionCounter".
            container DemDebounceTimeBase [0..1]  # This container contains the configuration (parameters) for time based debouncing.
              float DemDebounceTimeFailedThreshold: 0..3600, set at pre-compile  # Defines the time out duration for "Event Failed" qualification. | The AUTOSAR configuration standard is to use SI units, so this parameter is defined as float value in seconds. Dem configuration tools must convert this float value to the appropriate value format for the use in the software implementation of Dem.
              float DemDebounceTimePassedThreshold: 0..3600, set at pre-compile  # Defines the time out duration for "Event Passed" qualification. | The AUTOSAR configuration standard is to use SI units, so this parameter is defined as float value in seconds. Dem configuration tools must convert this float value to the appropriate value format for the use in the software implementation of Dem.
          container DemIndicatorAttribute [0..255]  # This container contains the event specific configuration of Indicators.
            enumeration DemIndicatorBehaviour: {DEM_INDICATOR_BLINKING, DEM_INDICATOR_BLINK_CONT, DEM_INDICATOR_CONTINUOUS}, set at post-build in variant post-build / pre-compile in variant pre-compile  # Behaviour of the linked indicator
            integer DemIndicatorFailureCycleCounterThreshold [0..1]: 0..255, set at pre-compile  # Defines the number of failure cycles for the WarningIndicatorOnCriteria.
            enumeration DemIndicatorFailureCycleSource: {DEM_FAILURE_CYCLE_EVENT, DEM_FAILURE_CYCLE_INDICATOR}, set at pre-compile  # This parameter defines, which failure cycle is used for the WarningIndicatorOnCriteria handling.
            integer DemIndicatorHealingCycleCounterThreshold: 0..255, set at pre-compile  # Defines the number of healing cycles for the WarningIndicatorOffCriteria.
            reference DemIndicatorFailureCycleRef [0..1]: set at pre-compile, destination=DemOperationCycle  # Kind of failure cycle for the indicator controlled by the according event used for the WarningIndicatorOnCriteria.
            reference DemIndicatorHealingCycleRef: set at pre-compile, destination=DemOperationCycle  # Kind of healing cycle for the indicator controlled by the according event used for the WarningIndicatorOffCriteria.
            reference DemIndicatorRef: set at pre-compile, destination=DemIndicator  # Reference to the used indicator.
      container DemPidClass [0..255]  # This container contains the different PIDs for the single global OBD relevant freeze frame class. It is assembled out of one or several data elements.
        integer DemPidIdentifier: 0..255, set at post-build in variant post-build / pre-compile in variant pre-compile  # identifier of the PID
        container DemPidDataElement [1..255]  # This container contains the different data elements contained in the specific PID.
          choice reference DemPidDataElementClassRef: set at post-build in variant post-build / pre-compile in variant pre-compile, destination=[DemExternalCSDataElementClass, DemExternalSRDataElementClass, DemInternalDataElementClass]  # This reference contains the link to a data element class.
    container DemGeneral  # This container contains the configuration (parameters) of the BSW Dem
      enumeration DemAgingCycleCounterProcessing: {DEM_PROCESS_AGINGCTR_EXTERN, DEM_PROCESS_AGINGCTR_INTERN}, set at pre-compile  # This configuration switch defines, whether the aging counter is calculated Dem-internally or provided via Dem_SetAgingCycleCounterValue.
      integer DemBswErrorBufferSize: 0..255, set at pre-compile  # Maximum number of elements in buffer for handling of BSW errors (ref. to Dem107).
      enumeration DemClearDTCBehavior: {DEM_CLRRESP_NONVOLATILE_FINISH, DEM_CLRRESP_NONVOLATILE_TRIGGER, DEM_CLRRESP_VOLATILE}, set at pre-compile  # Defines the clearing process of diagnostic information for volatile and non-volatile memory and the positive response handling for the Dcm module.
      boolean DemDTCSuppressionSupport: set at pre-compile  # This configuration switch defines, whether support for DTC suppression is enabled or not. | true: DTC suppression support is enabled false: DTC suppression support is disabled
      boolean DemDebounceCounterBasedSupport: set at pre-compile  # This configuration switch defines, whether support for counter based debouncing is enabled or not. | true: counter based debouncing support is enabled false: counter based debouncing support is disabled
      boolean DemDebounceTimeBasedSupport: set at pre-compile  # This configuration switch defines, whether support for time based debouncing is enabled or not. | true: time based debouncing support is enabled false: time based debouncing support is disabled
      boolean DemDevErrorDetect: set at pre-compile  # Activate/Deactivate the Development Error Detection and Notification. | true: Development Error Detection and Notification activated false: Development Error Detection and Notification deactivated
      integer DemDtcStatusAvailabilityMask: 0..255, set at pre-compile  # Mask for the supported DTC status bits by the Dem. This mask is used by UDS service 0x19.
      boolean DemEnableConditionSupport: set at pre-compile  # This configuration switch defines, whether support for enable conditions is enabled or not. | true: support for enable conditions is enabled false: support for enable conditions is disabled
      enumeration DemEventCombinationSupport: {DEM_EVCOMB_DISABLED, DEM_EVCOMB_TYPE1, DEM_EVCOMB_TYPE2}, set at pre-compile  # This parameter defines the type of event combination supported by the Dem.
      boolean DemEventDisplacementSupport: set at pre-compile  # This configuration switch defines, whether support for event displacement is enabled or not. | true: event displacement support is enabled false: event displacement support is disabled
      enumeration DemExtendedDataCapture [0..1]: {DEM_TRIGGER_EVENT_MEMORY_STORAGE, DEM_TRIGGER_TESTFAILED}, set at pre-compile  # This parameter defines the point in time, when the extended data collection is done for the initial event memory entry.
      enumeration DemFreezeFrameCapture [0..1]: {DEM_TRIGGER_EVENT_MEMORY_STORAGE, DEM_TRIGGER_TESTFAILED}, set at pre-compile  # This parameter defines the point in time, when the freeze frame data collection is done for the initial event memory entry.
      string DemHeaderFileInclusion [0..*]: set at pre-compile, regular-expression=[a-zA-Z0-9_]([a-zA-Z0-9\._])*  # Name of the header file(s) to be included by the Dem module containing the used C-callback declarations.
      integer DemImmediateNvStorageLimit [0..1]: 1..255, set at pre-compile  # This parameter defines the maximum number of occurrences, a specific event memory entry is allowed, to be stored in NVRAM immediately (refer to DemImmediateNvStorage).
      integer DemMaxNumberEventEntryMirror: 0..255, set at pre-compile  # Maximum number of events which can be stored in the mirror memory
      integer DemMaxNumberEventEntryPermanent: 0..255, set at pre-compile  # Maximum number of events which can be stored in the permanent memory. | The assignment of an event to this memory type is dynamic and used for emission-related events only.
      integer DemMaxNumberEventEntryPrimary: 1..255, set at pre-compile  # Maximum number of events which can be stored in the primary memory
      integer DemMaxNumberEventEntrySecondary: 0..255, set at pre-compile  # Maximum number of events which can be stored in the secondary memory
      integer DemMaxNumberPrestoredFF: 0..255, set at pre-compile  # Defines the maximum number for prestored freeze frames. | If set to 0, then freeze frame prestorage is not supported by the ECU.
      boolean DemOBDSupport: set at pre-compile  # This configuration switch defines whether OBD is supported or not
      enumeration DemOccurrenceCounterProcessing: {DEM_PROCESS_OCCCTR_CDTC, DEM_PROCESS_OCCCTR_TF}, set at pre-compile  # This configuration switch defines the consideration of the fault confirmation process for the occurrence counter. For OBD and mixed systems (OBD/non OBD, refer to DemOBDSupport) the fault confirmation process must not be considered.
      enumeration DemOperationCycleProcessing: {DEM_PROCESS_OPCYC_COUNTER, DEM_PROCESS_OPCYC_STATE}, set at pre-compile  # This configuration switch defines, whether the operation cycles are triggered by DEM_CYCLE_STATE_START or collecting an external counter value, which results in respective state changes.
      boolean DemOperationCycleStatusStorage: set at pre-compile  # Defines if the operation cycle state is available over the power cycle (stored non-volatile) or not. | true: the operation cycle state is stored non-volatile false: the operation cycle state is only stored volatile
      boolean DemPTOSupport: set at pre-compile  # This configuration switch defines, whether PTO support (and therefore PID $1E support) is enabled or not.
      enumeration DemStatusBitHandlingTestFailedSinceLastClear: {DEM_STATUS_BIT_AGING_AND_DISPLACEMENT, DEM_STATUS_BIT_NORMAL}, set at pre-compile  # This configuration switch defines, whether the aging and displacement mechanism shall be applied to the "TestFailedSinceLastClear" status bits.
      boolean DemStatusBitStorageTestFailed: set at pre-compile  # Activate/Deactivate the permanent storage of the "TestFailed" status bits. | true: storage activated false: storage deactivated
      boolean DemStorageConditionSupport: set at pre-compile  # This configuration switch defines, whether support for storage conditions is enabled or not. | true: support for storage conditions is enabled false: support for storage conditions is disabled
      float DemTaskTime: 0..0.1, set at pre-compile, origin=AUTOSAR_ECUC V1.0.0  # Allow to configure the time for the periodic cyclic task. Please note: This configuration value shall be equal to the value in the Basic Software Scheduler configuration of the RTE module. | The AUTOSAR configuration standard is to use SI units, so this parameter is defined as float value in seconds. Dem configuration tools must convert this float value to the appropriate value format for the use in the software implementation of Dem. min: A negative value is not allowed. max: After event status was reported, processing shall be completed within 100ms in order to have the fault entry status information updated as soon as possible (e.g. for PID $01). upperMultiplicity: Exactly one TaskTime must be specified per configuration. lowerMultiplicity: Exactly one TaskTime must be specified per configuration.
      boolean DemTriggerDcmReports: set at pre-compile  # Activate/Deactivate the notification to the Diagnostic Communication Manager for ROE processing. | true: Dcm ROE notification activated false: Dcm ROE notification deactivated
      boolean DemTriggerDltReports: set at pre-compile  # Activate/Deactivate the notification to the Diagnostic Log and Trace. | true: Dlt notification activated false: Dlt notification deactivated
      boolean DemTriggerFiMReports: set at pre-compile  # Activate/Deactivate the notification to the Funciton Inhibition Manager. | true: FiM notification activated false: FiM notification deactivated
      boolean DemTriggerMonitorInitBeforeClearOk: set at pre-compile  # Defines if the monitor re-initialization has to be triggered before or after the Dem module returns DEM_CLEAR_OK. | true: trigger re-initialization before DEM_CLEAR_OK false: trigger re-initialization after DEM_CLEAR_OK
      enumeration DemTypeOfDTCSupported: {DEM_DTC_TRANSLATION_ISO11992_4, DEM_DTC_TRANSLATION_ISO14229_1, DEM_DTC_TRANSLATION_ISO15031_6, DEM_DTC_TRANSLATION_SAEJ1939_73}, set at pre-compile  # This parameter defines the format returned by Dem_GetTranslationType and does not relate to/influence the supported Dem functionality.
      enumeration DemTypeOfFreezeFrameRecordNumeration: {DEM_FF_RECNUM_CALCULATED, DEM_FF_RECNUM_CONFIGURED}, set at pre-compile  # This parameter defines the type of assigning freeze frame record numbers for event-specific freeze frame records.
      boolean DemVersionInfoApi: set at pre-compile  # Activate/Deactivate the version information API. | true: version information activated false: version information deactivated
      reference DemMILIndicatorRef [0..1]: set at pre-compile, destination=DemIndicator  # This parameter defines the indicator representing the MIL. | This paramteter is mandatory for ECUs supporting OBD (refer to DemOBDSupport).
      container DemAgingCycle [0..256]  # Note that this container definition does not explicitly define a symbolic name parameter. Instead, the short name of the container will be used in the Ecu Configuration Description to specify the symbolic name of the aging cycle name. These aging cycles are reported via API Dem_SetAgingCycleState only.
      container DemCallbackDTCStatusChanged [0..*]  # The presence of this container indicates, that the Dem has access to a "DTCStatusChanged" callback, which the Dem will call to notify other components about the change in the status of a DTC. | In case there is a DemCallbackDTCStatusChangedFnc, this parameter defines the name of the function that the Dem will call. In case there is no DemCallbackDTCStatusChangedFnc, the Dem will have an R-Port requiring the interface CallbackDTCStatusChanged whose name is generated by using the unique callback-prefix followed by the event name.
        function name DemCallbackDTCStatusChangedFnc [0..1]: set at pre-compile  # Function name of prototype "DTCStatusChanged". | Note: If the parameter DemTriggerDcmReports is enabled, this parameter shall not be "Dcm_DemTriggerOnDTCStatus".
      choice container DemDataElementClass [0..255]  # This container contains the configuration (parameters) for an internal/external data element class.
        container DemExternalCSDataElementClass [0..1]  # This container contains the configuration (parameters) for an external client/server based data element class. | It defines, how the Dem can obtain the value of the data element from either a SW-C or another BSW module. Whether a client/server port or a C function-call is used, is defined by DemDataElementUsePort.
          integer DemDataElementDataSize: 1..255, set at pre-compile  # Defines the size of the data element in bytes.
          function name DemDataElementReadFnc [0..1]: set at pre-compile  # In case of DemDataElementUsePort is false, this parameter defines the prototype of the C function "ReadDataElement" used to get the according value.
          boolean DemDataElementUsePort: set at pre-compile  # If the parameter is set to True, a R-Port is generated, to obtain the data element (interface DataServices_<SyncDataElement>). | If the parameter is set to False, the information is obtained by C function-call on another BSW module specified by the parameter DemDataElementReadFnc.
        container DemExternalSRDataElementClass [0..1]  # This container contains the configuration (parameters) for an external sender/receiver based data element class. It defines, how the Dem can obtain the value of the data element from a SW-C, by using a sender/receiver port.
          integer DemDataElementDataSize: 1..255, set at pre-compile  # Defines the size of the data element in bits.
          instance reference DemDataElementInstanceRef: set at pre-compile, destination-context=ROOT-SW-COMPOSITION-PROTOTYP SW-COMPONENT-PROTOTYPE+ PORT-PROTOTYPE, destination-type=VARIABLE-DATA-PROTOTYPE  # Instance Reference to the actual OperationPrototype which shall be traced.
        container DemInternalDataElementClass [0..1]  # This container contains the configuration (parameters) for an internal data element class.
          integer DemDataElementDataSize: 1..255, set at pre-compile  # Defines the size of the data element in bytes.
          enumeration DemInternalDataElement: {DEM_AGINGCTR, DEM_OCCCTR, DEM_OVFLIND, DEM_SIGNIFICANCE}, set at pre-compile  # This parameter defines the Dem-internal data value, which is mapped to the data element.
      container DemDidClass [0..255]  # This container contains the configuration (parameters) for a data Id class. It is assembled out of one or several data elements.
        integer DemDidIdentifier: 0..65535, set at pre-compile  # Identifier of the Data ID.
        choice reference DemDidDataElementClassRef [1..255]: set at pre-compile, destination=[DemExternalCSDataElementClass, DemExternalSRDataElementClass, DemInternalDataElementClass]  # This reference contains the link to a data element class.
      container DemEnableCondition [0..255]  # This container contains the configuration (parameters) for enable conditions.
        integer DemEnableConditionId: 0..255, set at pre-compile, symbolic-name-value=true  # Defines a unique enable condition Id. | This parameter should not be changeable by user, because the Id should be generated by Dem itself to prevent gaps and multiple use of an Id. The enable conditions should be sequentially ordered beginning with 0 and no gaps in between.
        boolean DemEnableConditionStatus: set at pre-compile  # Defines the inital status for enable or disable of acceptance of event reports of a diagnostic event. | The value is the initialization after power up (before this condition is reported the first time). true: acceptance of a diagnostic event enabled false: acceptance of a diagnostic event disabled
      container DemEnableConditionGroup [0..255]  # This container contains the configuration (parameters) for enable condition groups.
        reference DemEnableConditionRef [1..255]: set at pre-compile, origin=AUTOSAR_ECUC V1.0.0, destination=DemEnableCondition  # References an enable condition.
      container DemExtendedDataClass [0..*]  # This class contains the combinations of extended data records for an extended data class.
        reference DemExtendedDataRecordClassRef [1..253]: set at pre-compile, destination=DemExtendedDataRecordClass  # This reference contains the link to an extended data class record.
      container DemExtendedDataRecordClass [0..253]  # This container contains the configuration (parameters) for an extended data record class. | It is assembled out of one or several data elements.
        integer DemExtendedDataRecordNumber: 0..253, set at pre-compile  # This configuration parameter specifies an unique identifier for an extended data record. | One or more extended data records can be assigned to one diagnostic event/DTC. 0xFF and 0xFE are resereved by ISO (therefore the maximal value equals 253).
        enumeration DemExtendedDataRecordUpdate [0..1]: {DEM_UPDATE_RECORD_NO, DEM_UPDATE_RECORD_YES}, set at pre-compile  # This parameter defines the case, when the extended data record is stored/updated.
        choice reference DemDataElementClassRef [1..255]: set at pre-compile, destination=[DemExternalCSDataElementClass, DemExternalSRDataElementClass, DemInternalDataElementClass]  # This reference contains the link to a data element class.
      container DemFreezeFrameClass [0..255]  # This container contains the combinations of DIDs for a non OBD relevant freeze frame class.
        reference DemDidClassRef [1..255]: set at pre-compile, destination=DemDidClass  # For OBD relevant data | Multiple PIDs can be relevant per freeze frame.
      container DemFreezeFrameRecNumClass [0..255]  # This container contains a list of dedicated, different freeze frame record numbers assigned to an event. The order of record numbers in this list is assigned to the chronological order of the according freeze frame records. | dependency: DemTypeOfFreezeFrameRecordNumeration
        integer DemFreezeFrameRecordNumber [1..254]: 1..254, set at pre-compile  # This parameter defines a record number for a freeze frame record. This record number is unique per freeze frame record number class. | The range of this value is defined by ISO 14229-1 (0x01 .. 0xFE).
      container DemGeneralOBD [0..1]  # This container contains the general OBD-specific configuration (parameters) of the Dem module.
        choice reference DemOBDInputAcceleratorPaddleInformation: set at pre-compile, destination=[DemExternalCSDataElementClass, DemExternalSRDataElementClass]  # Input variable for the accelerator paddle information, which is assigned to a specific data element used as interface for the Dem-internal PID calculations.
        choice reference DemOBDInputAmbientPressure: set at pre-compile, destination=[DemExternalCSDataElementClass, DemExternalSRDataElementClass]  # Input variable for the ambient pressure, which is assigned to a specific data element used as interface for the Dem-internal PID calculations.
        choice reference DemOBDInputAmbientTemperature: set at pre-compile, destination=[DemExternalCSDataElementClass, DemExternalSRDataElementClass]  # Input variable for the ambient temperature, which is assigned to a specific data element used as interface for the Dem-internal PID calculations.
        choice reference DemOBDInputDistanceInformation: set at pre-compile, destination=[DemExternalCSDataElementClass, DemExternalSRDataElementClass]  # Input variable for the distance information, which is assigned to a specific data element used as interface for the Dem-internal PID calculations.
        choice reference DemOBDInputEngineSpeed: set at pre-compile, destination=[DemExternalCSDataElementClass, DemExternalSRDataElementClass]  # Input variable for the engine speed, which is assigned to a specific data element used as interface for the Dem-internal PID calculations.
        choice reference DemOBDInputEngineTemperature: set at pre-compile, destination=[DemExternalCSDataElementClass, DemExternalSRDataElementClass]  # Input variable for the engine temperature, which is assigned to a specific data element used as interface for the Dem-internal PID calculations.
        choice reference DemOBDInputProgrammingEvent: set at pre-compile, destination=[DemExternalCSDataElementClass, DemExternalSRDataElementClass]  # Input variable for the programming event, which is assigned to a specific data element used as interface for the Dem-internal PID calculations.
        choice reference DemOBDInputVehicleSpeed: set at pre-compile, destination=[DemExternalCSDataElementClass, DemExternalSRDataElementClass]  # Input variable for the vehicle speed, which is assigned to a specific data element used as interface for the Dem-internal PID calculations.
      container DemGroupOfDTC [0..255]  # This container contains the configuaration (parameters) for DTC groups.
        integer DemGroupDTCs: 0..16777214, set at pre-compile, symbolic-name-value=true  # DTC value of the selected group of DTC | (Range: 3 byte, 0x000000 is only available for the emission-related DTC group, 0xFFFFFF is reserved for 'all DTCs', according to ISO14229-1 Annex D.1,) The DTC group 'all DTCs' is always available and will not be configured.
      container DemIndicator [0..255]  # This container contains the configuration (parameters) for Indicators. | Note that this container definition does not explicitly define a symbolic name parameter. Instead, the short name of the container will be used in the Ecu Configuration Description to specify the symbolic name of the INDICATOR_NAME.
        integer DemIndicatorID: 0..255, set at pre-compile, symbolic-name-value=true  # Unique identifier of an indicator.
      container DemNvRamBlockId [0..*]  # This container contains the configuaration (parameters) for a non-volatile memory block, which is used from the Dem. If no permanent storage of event memory entries is required, no block needs to be configured. | The number of blocks which are necessary depends on the implementation and configuration (e.g. number of used event memories) of the Dem module.
        symbolic name reference DemNvRamBlockIdRef: set at pre-compile, origin=AUTOSAR_ECUC V1.0.0, destination=NvMBlockDescriptor  # This reference contains the link to a non-volatile memory block. For post build time configurations worst case szenario shall be used.
      container DemOperationCycle [1..256]  # Note that this container definition does not explicitly define a symbolic name parameter. Instead, the short name of the container will be used in the Ecu Configuration Description to specify the symbolic name of the operation cycle name.
        enumeration DemOperationCycleType: {DEM_OPCYC_IGNITION, DEM_OPCYC_OBD_DCY, DEM_OPCYC_OTHER, DEM_OPCYC_POWER, DEM_OPCYC_TIME, DEM_OPCYC_WARMUP}, set at pre-compile  # Operation cycles types for the Dem to be supported by cycle-state APIs. | Further cycle types can be specified as part of the Dem delivery.
      container DemRatioId [0..65535]  # This container contains the OBD specific ratio Id configuraiton. It is related to a specific event, a FID, and an IUMPR group. | Note that this container definition does not explicitly define a symbolic name parameter. Instead, the short name of the container will be used in the Ecu Configuration Description to specify the symbolic name of the ratio Id name.
        enumeration DemIUMPRGroup: {DEM_IUMPR_BOOSTPRS, DEM_IUMPR_CAT1, DEM_IUMPR_CAT2, DEM_IUMPR_EGR, DEM_IUMPR_EGSENSOR, DEM_IUMPR_EVAP, DEM_IUMPR_NMHCCAT, DEM_IUMPR_NOXADSORB, DEM_IUMPR_NOXCAT, DEM_IUMPR_OXS1, DEM_IUMPR_OXS2, DEM_IUMPR_PMFILTER, DEM_IUMPR_PRIVATE, DEM_IUMPR_SAIR, DEM_IUMPR_SECOXS1, DEM_IUMPR_SECOXS2}, set at pre-compile  # This parameter specifies the assigned IUMPR group of the ratio Id.
        enumeration DemRatioIdType: {DEM_RATIO_API, DEM_RATIO_OBSERVER}, set at pre-compile  # This parameter defines whether the ratio Id will be calculated API or observer based.
        reference DemDiagnosticEventRef: set at pre-compile, destination=DemEventParameter  # This reference contains the link to a diagnostic event.
        symbolic name reference DemFunctionIdRef: set at pre-compile, destination=FiMFID  # This reference contains the link to a function identifier within the FiM which is used as a primary FID.
        symbolic name reference DemSecondaryFunctionIdRef [0..*]: set at pre-compile, destination=FiMFID  # This reference contains the link to a function identifier within the FiM which is used as a secondary FID. | The "primary" and all "secondary" FID inhibitions are combined by "OR".
      container DemStorageCondition [0..255]  # This container contains the configuration (parameters) for storage conditions.
        integer DemStorageConditionId: 0..255, set at pre-compile, symbolic-name-value=true  # Defines a unique storage condition Id. This parameter should not be changeable by user, because the Id should be generated by Dem itself to prevent gaps and multiple use of an Id. The storage conditions should be sequentially ordered beginning with 0 and no gaps in between.
        boolean DemStorageConditionStatus: set at pre-compile  # Defines the initial status for enable or disable of storage of a diagnostic event. | The value is the initialization after power up (before this condition is reported the first time). true: storage of a diagnostic event enabled false: storage of a diagnostic event disabled
      container DemStorageConditionGroup [0..255]  # This container contains the configuration (parameters) for storage condition groups.
        reference DemStorageConditionRef [1..255]: set at pre-compile, origin=AUTOSAR_ECUC V1.0.0, destination=DemStorageCondition  # References an enable condition.
  module definition Det [0..1]: variants pre-compile  # Det configuration includes the functions to be called at notification. On one | side the application functions are specified and in general it can be decided whether Dlt shall be called at each call of Det.
    container DetGeneral  # Generic configuration parameters of the Det module.
      boolean DetForwardToDlt [0..1]: set at pre-compile  # Only if the parameter is present and set to true, the Det requires the Dlt interface and forwards it's call to the function Dlt_DetForwardErrorTrace. In this case the optional interface to Dlt_Det is required.
      boolean DetVersionInfoApi: set at pre-compile  # Pre-processor switch to enable / disable the API to read out the modules version information. | true: Version info API enabled. false: Version info API disabled.
    container DetNotification [0..1]  # Configuration of the notification functions.
      function name DetErrorHook [0..*]: set at pre-compile  # Optional list of functions to be called by the Development Error Tracer in context of each call of Det_ReportError. | The type of these functions shall be identical the type of Det_ReportError itself: Std_ReturnType (*f)(uint16, uint8, uint8, uint8).
  module definition Dio [0..1]: variants post-build/pre-compile  # Configuration of the Dio (Digital IO) module.
    container DioConfig: multiple-configuration-container=true  # This container contains the configuration parameters and sub containers of the AUTOSAR DIO module. This container is a MultipleConfigurationContainer, i.e. this container and its sub-containers exist once per configuration set.
      container DioPort [1..*]  # Configuration of individual DIO ports, consisting of channels and possible channel groups. | Note that this container definition does not explicitly define a symbolic name parameter. Instead, the container's short name will be used in the Ecu Configuration Description to specify the symbolic name of the port.
        integer DioPortId: 0..4294967295, set at post-build in variant post-build / pre-compile in variant pre-compile, symbolic-name-value=true  # Numeric identifier of the DIO port. Not all MCU ports may be used for DIO, thus there may be "gaps" in the list of all IDs. This value will be | assigned to the DIO port symbolic name (i.e. the SHORT-NAME of the DioPort container).
        container DioChannel [0..*]  # Configuration of an individual DIO channel. Besides a HW specific channel name which is typically fixed for a specific micro controller, additional symbolic names can be defined per channel. | Note hat this container definition does not explicitly define a symbolic name parameter. Instead, the container's short name will be used in the Ecu Configuration Description to specify the symbolic name of the channel.
          integer DioChannelId: 0..4294967295, set at post-build in variant post-build / pre-compile in variant pre-compile, symbolic-name-value=true  # Channel Id of the DIO channel. This value will be assigned to the symbolic names.
        container DioChannelGroup [0..*]  # Definition and configuration of DIO channel groups. A channel group represents several adjoining DIO channels represented by a logical group. | Note hat this container definition does not explicitly define a symbolic name parameter. Instead, the container's short name will be used in the Ecu Configuration Description to specify the symbolic name of the channel group.
          string DioChannelGroupIdentification: set at pre-compile, symbolic-name-value=true  # The DIO channel group is identified in DIO API by a pointer to a data structure (of type Dio_ChannelGroupType). That data structure contains the channel group information. | This parameter contains the code fragment that has to be inserted in the API call of the calling module to get the address of the variable in memory which holds the channel group information. Example values are "&MyDioGroup1" or "&MyDioGroupArray[0]"
          integer DioPortMask: 0..4294967295, set at post-build in variant post-build / pre-compile in variant pre-compile  # This shall be the mask which defines the positions of the channel | group. The channels shall consist of adjoining bits in the same port. The data type depends on the port width.
          integer DioPortOffset: 0..31, set at post-build in variant post-build / pre-compile in variant pre-compile  # The position of the Channel Group on the port, counted | from the LSB. This value can be derived from DioPortMask. calculationFormula = Position of the first bit of DioPortMask which is set to '1' counted from LSB
    container DioGeneral  # General DIO module configuration parameters.
      boolean DioDevErrorDetect: set at pre-compile  # Switches the Development Error Detection and Notification | ON or OFF
      boolean DioFlipChannelApi: set at pre-compile  # Adds / removes the service Dio_FlipChannel() from the code.
      boolean DioVersionInfoApi: set at pre-compile  # Adds / removes the service Dio_ GetVersionInfo() from the code.
  module definition Dlt [0..1]: variants link-time/post-build/pre-compile
    container DltGeneral  # Flags for adding removing functionality from code.
      boolean DltDevErrorDetect: set at pre-compile  # Enables/Disables development error detection.
      boolean DltImplementAppIdContextIdQuery: set at pre-compile  # If set the functionality for Verbose Mode shall be available.
      boolean DltImplementExtendedHeader: set at pre-compile  # If set the extended functionality for the header shall be available.
      boolean DltImplementFilterMessages: set at pre-compile  # This flag is for code generation of Dlt. If set the functionality for filtering messages shall be included in the code.
      boolean DltImplementNVRamStorage: set at pre-compile  # If set the functionality for storing and loading information in and from NVRam shall be availible.
      boolean DltImplementSWCInjection: set at pre-compile  # If the remote call from functions over the Dlt in SW-C shall be available.
      boolean DltImplementTimestamp: set at pre-compile  # If set the timestamp functionality for the header shall be available.
      boolean DltImplementVerboseMode: set at pre-compile  # If set the functionality for Verbose Mode shall be available.
      boolean DltImplementVfbTrace: set at pre-compile  # If set the the header files and the implementation of VFB-trace shall be generated.
      integer DltVfbTraceLogLevel: 0..6, set at link in variant link-time / pre-compile in variant post-build+pre-compile  # The log level of the log messages generated by the VFB-Trace. | ImplementationType: Dlt_MessageLogLevelType
      symbolic name reference DltGptChannel: set at pre-compile, destination=GptChannelConfiguration  # Reference to the hardware free running timer of the GPT module for time stamps (if no HWFRT is applied, calls to add timestamps are ignored).
    container DltMemory  # Configuration parameters for reserving memory for some internal storing and buffer.
      integer DltInitBufferSize: 0..4294967295, set at link in variant link-time / pre-compile in variant post-build+pre-compile  # Buffer size for the C-init buffer. This buffer is for storing messages from other BSW modules before Dlt is initialized. | Unit: byte
      integer DltMaxCountAppIds: 1..4294967295, set at link in variant link-time / pre-compile in variant post-build+pre-compile  # The maximum count of register able Application Ids. There shall be a table to manage registered Application IDs, this is the number of lines to hold in this table. | Unit: byte
      integer DltMaxCountContextIds: 1..4294967295, set at link in variant link-time / pre-compile in variant post-build+pre-compile  # The maximum count of registrable Context Ids. There shall be a table to manage registered Context IDs, this is the number of lines to hold in this table. | Unit: byte
      integer DltMaxCountContextIdsPerAppId: 1..4294967295, set at link in variant link-time / pre-compile in variant post-build+pre-compile  # Each Context ID belongs to a specific Application ID. Dlt shall handle the correlation between them. The table of the registered Application IDs shall hold for every Application ID several references to the proper Context IDs. This is the maximum count for Context IDs per Application ID. | Unit: byte
      integer DltMessageBufferSize: 0..4294967295, set at link in variant link-time / pre-compile in variant post-build+pre-compile  # Buffer size for storing Dlt messages for waiting to transmit over the Network (send buffer). | Unit: byte
    container DltMultipleConfigurationContainer: multiple-configuration-container=true  # Container holding the sub-structure for multiple configuration support.
      symbolic name reference DltNvRamBlockRef: set at post-build in variant post-build / pre-compile in variant pre-compile, destination=NvMBlockDescriptor  # Reference to the NvM Block which is used to store the Dlt parameters.
      container DltBandwidth  # Configuration parameters controlling network and diagnostic interfaces bandwidth. If DltImplementNVRamStorage is enabled this parameters are the initial values for the NVRam. If DltImplementNVRamStorage is not set, Link-Time or Post-Build configuration shall be uesd.
        integer DltBandwidthForComModule: 0..4294967295, set at link in variant link-time / post-build in variant post-build / pre-compile in variant pre-compile  # For communication over the Dlt Communication Module the maximum bandwidth shall be set. | Unit: kbit per second
        integer DltBandwidthForDiagChannel: 0..4294967295, set at link in variant link-time / post-build in variant post-build / pre-compile in variant pre-compile  # For communication over the DCM and as follows over the diagnostic interface the maximum bandwidth shall be set. | Unit: kbit per second
        float DltTimePeriodTrafficShaping: 0..Inf, set at link in variant link-time / post-build in variant post-build / pre-compile in variant pre-compile  # For implementing a traffic shaping, a time window for measuring shall be provided. | Unit: second
      container DltMessageFiltering  # Configuration parameters for setting message filtering properties in Dlt module.
        integer DltDefaultMaxLogLevel: 0..6, set at link in variant link-time / post-build in variant post-build / pre-compile in variant pre-compile  # The maximum log level a received message (from SW-C to Dlt) can have. This can also be modified at runtime and stored persistently in NVRAM. If DltImplementNVRamStorage is enabled this parameter is the initial value for the corospending NVRam entry. If DltImplementNVRamStorage is not set, Link-Time or Post-Build configuration shall be uesd. The value 0 means loging is disabled. | ImplementationType: Dlt_MessageLogLevelType
        boolean DltDefaultTraceStatus: set at link in variant link-time / post-build in variant post-build / pre-compile in variant pre-compile  # Tells if trace messages shall be forwarded by Dlt. This functionality can also be modified at runtime and changed can stored persistently in NVRAM. If DltImplementNVRamStorage is enabled this parameter is the initial value for the corresponding NVRam entry. If DltImplementNVRamStorage is not set, Link-Time or Post-Build configuration shall be used.
        integer DltFactoryDefaultMaxLogLevel: 0..6, set at link in variant link-time / post-build in variant post-build / pre-compile in variant pre-compile  # The maximum log level a received message (from SW-C to Dlt) can have. This is for setting DltDefaultMaxLogLevel to factory defaults. The value 0 means loging is disabled. | ImplementationType: Dlt_MessageLogLevelType
        boolean DltFilterMessages: set at link in variant link-time / pre-compile in variant post-build+pre-compile  # This flag gives the Dlt the instruction to filter or not to filter incoming log or trace messages. If it is not set all incoming messages are forwarded to the communication channel. So also the caller of the DltSendXXXMessage can leave the field trace_info or log_info empty. | If DltImplementNVRamStorage is enabled this parameter is the initial value for the corospending NVRam entry. If DltImplementNVRamStorage is not set, Link-Time or Post-Build configuration shall be uesd.
      container DltProtocol  # Configuration parameters for handling the specific protocol variants.
        string DltEcuId: set at link in variant link-time / post-build in variant post-build / pre-compile in variant pre-compile  # This is the name of the ECU for use within the Dlt protocol. The meaning is described in the document. This name is transimitted within the Dlt protocol. There this are 4 characters. If you want to use an number representation type this as character.
        enumeration DltHeaderPayloadEndianes: {BigEndian, LittleEndian}, set at pre-compile  # Determines the endianes of the CPU (Most Significant Byte).
        boolean DltHeaderUseEcuId: set at link in variant link-time / post-build in variant post-build / pre-compile in variant pre-compile  # Corresponds to field WEID (With ECU ID). If set ECU ID shall be placed in the header, else not. | If DltImplementNVRamStorage is enabled this parameter is the initial value for the corospending NVRam entry. If DltImplementNVRamStorage is not set, Link-Time or Post-Build configuration shall be uesd.
        boolean DltHeaderUseExtendedHeader: set at link in variant link-time / post-build in variant post-build / pre-compile in variant pre-compile  # Corresponds to field UEH (Use Extended Header). If set the Extended Header shall be attached, else not. | If DltImplementNVRamStorage is enabled this parameter is the initial value for the corospending NVRam entry. If DltImplementNVRamStorage is not set, Link-Time or Post-Build configuration shall be uesd.
        boolean DltHeaderUseSessionID: set at link in variant link-time / post-build in variant post-build / pre-compile in variant pre-compile  # Corresponds to field WSID (with Session ID). If set the Session ID shall be placed in the header, else not. | If DltImplementNVRamStorage is enabled this parameter is the initial value for the corospending NVRam entry. If DltImplementNVRamStorage is not set, Link-Time or Post-Build configuration shall be uesd.
        boolean DltHeaderUseTimestamp: set at link in variant link-time / post-build in variant post-build / pre-compile in variant pre-compile  # Corresponds to field WTMS (With Timestamp). If set the timestamp shall be placed in the header, else not. | If DltImplementNVRamStorage is enabled this parameter is the initial value for the corospending NVRam entry. If DltImplementNVRamStorage is not set, Link-Time or Post-Build configuration shall be uesd.
        integer DltMaxMessageLength: 8..65535, set at link in variant link-time / pre-compile in variant post-build+pre-compile  # The maximum length of a Dlt log or trace message.
        boolean DltUseVerboseMode: set at link in variant link-time / post-build in variant post-build / pre-compile in variant pre-compile  # If this flag is set Dlt shall use the Verbose Mode for generating the header of the transport protocol. Also it shall store the information provided by registering Context ID and Application ID (description) at runtime if flag is set. If it is not set, the Non Verbose Mode shall be used. | If DltImplementNVRamStorage is enabled this parameter is the initial value for the corospending NVRam entry. If DltImplementNVRamStorage is not set, Link-Time or Post-Build configuration shall be uesd.
    container DltVfbTrace [0..*]  # All functions to trace from the VFB by the Dlt.
      function name DltVfbTraceFunction: set at pre-compile  # The Dlt generator shall enable VFB tracing for a given hook function when there is a #define in the Dlt-VFB configuration header file for the hook function name and tracing is globally enabled. | Example: #define Dlt_Rte WriteHook i1 p1 a Start. Also the corresponding function shall be generated. The exact argument description for the function is to take from the provieded BSWModudulDescription from the RTE module.
      foreign reference DltBswModuleEntryRef: set at pre-compile, destination-type=BSW-MODULE-ENTRY  # Foreign reference to the BSWModuleEntry describing the trace function implementation.
  module definition Ea [0..1]: variants pre-compile  # Configuration of the Ea (EEPROM Abstraction) module. | The module shall abstract from the device specific addressing scheme and segmentation and provide the upper layers with a virtual addressing scheme and segmentation as well as a 'virtually' unlimited number of erase cycles.
    container EaBlockConfiguration [1..*]  # Configuration of block specific parameters for the EEPROM abstraction module.
      integer EaBlockNumber: 1..65534, set at pre-compile, symbolic-name-value=true  # Block identifier (handle). | 0x0000 and 0xFFFF shall not be used for block numbers (see EA006). Range: min = 2^NVM_DATASET_SELECTION_BITS max = 0xFFFF -2^NVM_DATASET_SELECTION_BITS Note: Depending on the number of bits set aside for dataset selection several other block numbers shall also be left out to ease implementation.
      integer EaBlockSize: 1..65535, set at pre-compile  # Size of a logical block in bytes.
      boolean EaImmediateData: set at pre-compile  # Marker for high priority data. | true: Block contains immediate data. false: Block does not contain immediate data.
      integer EaNumberOfWriteCycles: 0..4294967295, set at pre-compile  # Number of write cycles required for this block.
      symbolic name reference EaDeviceIndex: set at pre-compile, destination=EepGeneral  # Device index (handle). | Range: 0 .. 254 (0xFF reserved for broadcast call to GetStatus function).
    container EaGeneral  # General configuration of the EEPROM abstraction module. This container lists block independent configuration parameters.
      boolean EaDevErrorDetect: set at pre-compile  # Pre-processor switch to enable and disable development error detection. | true: Development error detection enabled. false: Development error detection disabled.
      integer EaIndex: 0..254, set at pre-compile  # Specifies the InstanceId of this module instance. If only one instance is present it shall have the Id 0.
      function name EaNvmJobEndNotification [0..1]: set at pre-compile  # Mapped to the job end notification routine provided by the upper layer module (NvM_JobEndNotification).
      function name EaNvmJobErrorNotification [0..1]: set at pre-compile  # Mapped to the job error notification routine provided by the upper layer module (NvM_JobErrorNotification).
      boolean EaPollingMode: set at pre-compile  # Pre-processor switch to enable and disable the polling mode for this module. | true: Polling mode enabled, callback functions (provided to EEP module) disabled. false: Polling mode disabled, callback functions (provided to EEP module) enabled.
      boolean EaSetModeSupported: set at pre-compile, default-value=true  # Compile switch to enable / disable the function Ea_SetMode.
      boolean EaVersionInfoApi: set at pre-compile  # Pre-processor switch to enable / disable the API to read out the modules version information. | true: Version info API enabled. false: Version info API disabled.
      integer EaVirtualPageSize: 0..65535, set at pre-compile  # The size in bytes to which logical blocks shall be aligned.
    container EaPublishedInformation  # Additional published parameters not covered by CommonPublishedInformation container. | Note that these parameters do not have any configuration class setting, since they are published information.
      integer EaBlockOverhead: 0..65535, set at published-information  # Management overhead per logical block in bytes. | Note: If the management overhead depends on the block size or block location a formula has to be provided that allows the configurator to calculate the management overhead correctly.
      float EaMaximumBlockingTime: 0..Inf, set at published-information  # The maximum time the EA module's API routines shall be blocked (delayed) by internal operations. (EA070) | Note: Internal operations in that case means operations that are not explicitly invoked from the upper layer module but need to be handled for proper operation of this module or the underlying memory driver.
      integer EaPageOverhead: 0..65535, set at published-information  # Management overhead per page in bytes. | Note: If the management overhead depends on the block size or block location a formula has to be provided that allows the configurator to calculate the management overhead correctly.
  module definition EcuC [0..1]: variants post-build/pre-compile  # Virtual module to collect ECU Configuration specific / global configuration information.
    container EcucPartitionCollection [0..1]  # Collection of Partitions defined for this ECU.
      container EcucPartition [0..*]  # Definition of one Partition on this ECU. | One Partition will be implemented using one Os-Application.
        boolean EcucPartitionBswModuleExecution: set at pre-compile  # Denotes that this partition will execute all BSW Modules. BSW Modules can only be executed in one partition.
        boolean PartitionCanBeRestarted: set at pre-compile  # Specifies the requirement whether the Partition can be restarted. If set to true all software executing in this partition shall be capable of handling a restart.
        instance reference EcucPartitionSoftwareComponentInstanceRef [0..*]: set at pre-compile, destination-context=ROOT-SW-COMPOSITION-PROTOTYPE, destination-type=SW-COMPONENT-PROTOTYPE  # References the SW Component instances from the Ecu Extract that shall be executed in this partition.
    container EcucPduCollection [0..1]  # Collection of all Pdu objects flowing through the Com-Stack.
      enumeration PduIdTypeEnum: {UINT16, UINT8}  # The PduIdType is used within the entire AUTOSAR Com Stack except for bus drivers. The size of this global type depends on the maximum number of PDUs used within one software module. If no software module deals with more PDUs that 256, this type can be set to uint8. If at least one software module handles more than 256 PDUs, this type must be set to uint16. See AUTOSAR_SWS_CommunicationStackTypes for more details.
      enumeration PduLengthTypeEnum: {UINT16, UINT32, UINT8}  # The PduLengthType is used within the entire AUTOSAR Com Stack except for bus drivers. The size of this global type depends on the maximum length of PDUs to be sent by an ECU. If no segmentation is used the length depends on the maximum payload size of a frame of the underlying communication system (for FlexRay maximum size is 255 bytes, therefore uint8). If segementation is used it depends on the maximum length of a segmeneted N-PDU (in general uint16 is used). See AUTOSAR_SWS_CommunicationStackTypes for more details.
      container Pdu [0..*]  # One Pdu flowing through the COM-Stack. | This Pdu is used by all Com-Stack modules to agree on referencing the same Pdu.
        integer PduLength: 0..4095, set at post-build in variant post-build / pre-compile in variant pre-compile  # Length of the Pdu in bytes. It should be noted that in former AUTOSAR releases (Rel 2.1, Rel 3.0, Rel 3.1, Rel 4.0 Rev. 1) this parameter was defined in bits.
        foreign reference SysTPduToFrameMappingRef [0..1]: set at pre-compile, destination-type=PDU-TO-FRAME-MAPPING  # Optional reference to the PduToFrameMapping from the SystemTemplate which this Pdu represents.
    container EcucVariationResolver [0..1]  # Collection of PredefinedVariant elements containing definition of values for SwSystemconst which shall be applied when resolving the variability during ECU Configuration.
      foreign reference PredefinedVariantRef [1..*]: set at pre-compile, destination-type=PREDEFINED-VARIANT
  module definition EcuM [0..1]: variants post-build  # Configuration of the EcuM (ECU State Manager) module.
    container EcuMConfiguration: multiple-configuration-container=true  # This container contains the configuration (parameters) of the ECU State Manager.
      container EcuMCommonConfiguration  # This container contains the common configuration (parameters) of the ECU State Manager.
        integer EcuMConfigConsistencyHash: 0..18446744073709551615, set at link  # A hash value generated across all pre-compile and link-time parameters of all BSW modules. This hash value is compared against a field in the EcuM_ConfigType and hence allows checking the consistency of the entire configuration.
        reference EcuMDefaultAppMode: set at post-build, destination=OsAppMode  # The default application mode loaded when the ECU comes out of reset.
        reference EcuMOSResource [1..*]: set at pre-compile, destination=OsResource  # This parameter is a reference to a OS ressource which is used to bring the ECU into sleep mode. | In case of multi core each core shall have an own OsResource.
        container EcuMDefaultShutdownTarget  # This container describes the default shutdown target to be selected by EcuM. The actual shutdown target may be overridden by the EcuM_SelectShutdownTarget service.
          enumeration EcuMDefaultState: {EcuMStateOff, EcuMStateReset, EcuMStateSleep}, set at post-build  # This parameter describes the state part of the default shutdown target selected when the ECU comes out of reset. If EcuMStateSleep is selected, the parameter EcuMDefaultSleepModeRef selects the specific sleep mode.
          symbolic name reference EcuMDefaultResetModeRef [0..1]: set at post-build, destination=EcuMResetMode  # If EcuMDefaultShutdownTarget is EcuMStateReset, this parameter selects the default reset mode. Otherwise this parameter may be ignored.
          symbolic name reference EcuMDefaultSleepModeRef [0..1]: set at post-build, destination=EcuMSleepMode  # If EcuMDefaultShutdownTarget is EcuMStateSleep, this parameter selects the default sleep mode. Otherwise this parameter may be ignored.
        container EcuMDemEventParameterRefs [0..1]  # Container for the references to DemEventParameter elements which shall be invoked using the API Dem_ReportErrorStatus in case the corresponding error occurs. The EventId is taken from the referenced DemEventParameter's DemEventId value. | The standardized errors are provided in this container and can be extended by vendor specific error references.
          symbolic name reference ECUM_E_ALL_RUN_REQUESTS_KILLED [0..1]: set at pre-compile, destination=DemEventParameter  # Reference to the DemEventParameter which shall be issued when the error "ECUM_E_ALL_RUN_REQUESTS_KILLED" has occured.
          symbolic name reference ECUM_E_CONFIGURATION_DATA_INCONSISTENT [0..1]: set at pre-compile, destination=DemEventParameter  # Reference to the DemEventParameter which shall be issued when the error "ECUM_E_CONFIGURATION_DATA_INCONSISTENT" has occured.
          symbolic name reference ECUM_E_RAM_CHECK_FAILED [0..1]: set at pre-compile, destination=DemEventParameter  # Reference to the DemEventParameter which shall be issued when the error "ECUM_E_RAM_CHECK_FAILED" has occured.
        container EcuMDriverInitListOne [0..1]  # Container for Init Block I. | This container holds a list of module IDs that will be initialised. Each module in the list will be called for initialisation in the list order. All modules in this list are initilialised before the OS is started and so these modules require no OS support.
          container EcuMDriverInitItem [1..*]  # These containers describe the entries in a driver init list.
            string EcuMModuleID: set at pre-compile  # Short name of the module to be initialized, e.g. Mcu, Gpt etc.
            string EcuMModuleService: set at pre-compile  # The service to be called to initialize that module, e.g. Init, PreInit, Start etc. | If the service is Init and the parameter EcuMModuleConfigurationRef has been set for that module, the corresponding pointer to the init structure (<Module>_ConfigType) and in case of multiple instantiation an uint8 value to identify the instance of the module(<MSN>_CtrlIdx) shall be passed as arguments.
        container EcuMDriverInitListZero [0..1]  # Container for Init Block 0. | This container holds a list of module IDs that will be initialised. Each module in the list will be called for initialisation in the list order. All modules in this list are initilialised before the post-build configuration has been loaded and the OS is initialized. Therefore, these modules may not use post-build configuration.
          container EcuMDriverInitItem [1..*]  # These containers describe the entries in a driver init list.
            string EcuMModuleID: set at pre-compile  # Short name of the module to be initialized, e.g. Mcu, Gpt etc.
            string EcuMModuleService: set at pre-compile  # The service to be called to initialize that module, e.g. Init, PreInit, Start etc. | If the service is Init and the parameter EcuMModuleConfigurationRef has been set for that module, the corresponding pointer to the init structure (<Module>_ConfigType) and in case of multiple instantiation an uint8 value to identify the instance of the module(<MSN>_CtrlIdx) shall be passed as arguments.
        container EcuMDriverRestartList [0..1]  # List of module IDs. | EcuM2719: A configuration tool shall fill the callout EcuM_AL_DriverRestart with initialization calls to the listed drivers in the order in which they occur in the list. EcuM2720: Entries in this list must appear in the same order as in the combined list of EcuM_DriverInitListOne and EcuM_DriverInitListTwo. This list may be a real subset though. In all other cases, the generation tool shall report an error. The included container has the same structure as EcuM_DriverInitItem
          container EcuMDriverInitItem [1..*]  # These containers describe the entries in a driver init list.
            string EcuMModuleID: set at pre-compile  # Short name of the module to be initialized, e.g. Mcu, Gpt etc.
            string EcuMModuleService: set at pre-compile  # The service to be called to initialize that module, e.g. Init, PreInit, Start etc. | If the service is Init and the parameter EcuMModuleConfigurationRef has been set for that module, the corresponding pointer to the init structure (<Module>_ConfigType) and in case of multiple instantiation an uint8 value to identify the instance of the module(<MSN>_CtrlIdx) shall be passed as arguments.
        container EcuMSleepMode [1..*]  # These containers describe the configured sleep modes. | The names of these containers specify the symbolic names of the different sleep modes.
          integer EcuMSleepModeId: 0..255, set at pre-compile, symbolic-name-value=true  # This ID identifies this sleep mode in services like EcuM_SelectShutdownTarget.
          boolean EcuMSleepModeSuspend: set at pre-compile  # Flag, which is set true, if the CPU is suspended, halted, or powered off in the sleep mode. If the CPU keeps running in this sleep mode, then this flag must be set to false.
          symbolic name reference EcuMSleepModeMcuModeRef: set at pre-compile, destination=McuModeSettingConf  # This parameter is a reference to the corresponding MCU mode for this sleep mode.
          symbolic name reference EcuMWakeupSourceMask [1..*]: set at pre-compile, destination=EcuMWakeupSource  # These parameters are references to the wakeup sources that shall be enabled for this sleep mode.
        container EcuMWakeupSource [1..*]  # These containers describe the configured wakeup sources.
          float EcuMValidationTimeout [0..1]: 0..Inf, set at pre-compile  # The validation timeout (period for which the ECU State Manager will wait for the validation of a wakeup event) can be defined for each wakeup source independently. The timeout is specified in seconds. | When the timeout is not instantiated, there is no validation routine and the ECU Manager shall not validate the wakeup source.
          integer EcuMWakeupSourceId: 0..31, set at pre-compile, symbolic-name-value=true  # This parameter defines the identifier of this wakeup source.
          boolean EcuMWakeupSourcePolling: set at pre-compile  # This parameter describes if the wakeup source needs polling.
          symbolic name reference EcuMComMChannelRef [0..1]: set at pre-compile, destination=ComMChannel  # This parameter is a reference to a Network (channel) defined in the Communication Manager. No reference indicates that the wakeup source is not a communication channel.
          symbolic name reference EcuMResetReasonRef: set at pre-compile, destination=McuResetReasonConf  # This parameter describes the mapping of reset reasons detected by the MCU driver into wakeup sources.
      container EcuMFixedConfiguration [0..1]  # This container contains the configuration (parameters) of the EcuMFixed. | Only applicable if EcuMFixed is implemented.
        float EcuMNvramReadallTimeout: 0..Inf, set at post-build  # Period given in seconds for which the ECU State Manager will wait until it considers a ReadAll job of the NVRAM Manager as failed.
        float EcuMNvramWriteallTimeout: 0..Inf, set at post-build  # Period given in seconds for which the ECU State Manager will wait until it considers a WriteAll job of the NVRAM Manager as failed.
        float EcuMRunMinimumDuration: 0..Inf, set at post-build  # Duration given in seconds for which the ECU State Manager will | stay in RUN state even when no one requests RUN. This duration should be long at least as long as a SW-Cs needs to request RUN.
        choice reference EcuMFixedModuleConfigurationRef [0..*]: set at post-build, destination=[AdcConfigSet, CanConfigSet, CanIfInitCfg, CanNmGlobalConfig, CanSMConfiguration, CanTpConfig, CanTrcvConfigSet, ComConfig, ComMConfigSet, DbgMultipleConfigurationContainer, DcmConfigSet, DemConfigSet, DioConfig, DltMultipleConfigurationContainer, EepInitConfiguration, EthConfigSet, EthIfConfigSet, EthTrcvConfigSet, FiMConfigSet, FlsConfigSet, FlsTstConfigSet, FrArTpMultipleConfig, FrIfConfig, FrMultipleConfiguration, FrNmChannelConfig, FrSMConfig, FrTpMultipleConfig, GptChannelConfigSet, IcuConfigSet, IpduMConfig, J1939TpConfiguration, LinGlobalConfig, LinIfGlobalConfig, LinSMConfigSet, LinTpGlobalConfig, McuModuleConfiguration, PduRRoutingTables, PortConfigSet, PwmChannelConfigSet, RtePostBuildVariantConfiguration, SoAdDoIpConfig, SpiDriver, UdpNmGlobalConfig, WdgMConfigSet, WdgSettingsConfig, XcpConfig]  # These parameters contain references to the init structure of the corresponding BSW module.
        symbolic name reference EcuMComMCommunicationAllowedList [0..*]: set at pre-compile, destination=ComMChannel  # These parameters contain references to the ComMChannels for which EcuM has to call ComM_CommunicationAllowed.
        symbolic name reference EcuMNormalMcuModeRef: set at pre-compile, destination=McuModeSettingConf  # This parameter is a reference to the normal MCU mode to be restored after a sleep.
        container EcuMDriverInitListThree [0..1]  # Container for Init Block III. | This container holds a list of module IDs that will be initialised. Each module in the list will be called for initialisation in the list order. All modules in this list are initilialised after the OS is started and so these modules may use OS support. These modules may also rely on the Nvram ReadAll job to have provided all data.
          container EcuMDriverInitItem [1..*]  # These containers describe the entries in a driver init list.
            string EcuMModuleID: set at pre-compile  # Short name of the module to be initialized, e.g. Mcu, Gpt etc.
            string EcuMModuleService: set at pre-compile  # The service to be called to initialize that module, e.g. Init, PreInit, Start etc. | If the service is Init and the parameter EcuMModuleConfigurationRef has been set for that module, the corresponding pointer to the init structure (<Module>_ConfigType) and in case of multiple instantiation an uint8 value to identify the instance of the module(<MSN>_CtrlIdx) shall be passed as arguments.
        container EcuMDriverInitListTwo [0..1]  # Container for Init Block II. | This container holds a list of module IDs that will be initialised. Each module in the list will be called for initialisation in the list order. All modules in this list are initilialised after the OS is started and so these modules may use OS support. These modules may not rely on the Nvram ReadAll job to have provided all data.
          container EcuMDriverInitItem [1..*]  # These containers describe the entries in a driver init list.
            string EcuMModuleID: set at pre-compile  # Short name of the module to be initialized, e.g. Mcu, Gpt etc.
            string EcuMModuleService: set at pre-compile  # The service to be called to initialize that module, e.g. Init, PreInit, Start etc. | If the service is Init and the parameter EcuMModuleConfigurationRef has been set for that module, the corresponding pointer to the init structure (<Module>_ConfigType) and in case of multiple instantiation an uint8 value to identify the instance of the module(<MSN>_CtrlIdx) shall be passed as arguments.
        container EcuMFixedUserConfig [1..*]  # These containers describe the identifiers that are needed to refer to a software component or another appropriate entity in the system which is designated to request the RUN state. Application requestors refer to entities above RTE, system requestors to entities below RTE (e.g. Communication Manager).
          integer EcuMFixedUser: 0..255, set at pre-compile, symbolic-name-value=true  # Parameter used to identify one user.
        container EcuMTTII [0..*]  # These containers describe the structures and the following configuration items describe its elements. These structures are concatenated to build a list as indicated by Figure 27 - Configuration Container Diagram. | The list must contain at least one element when ECUM_TTII_ENABLED is set to true.
          integer EcuMDivisor: 0..18446744073709551615, set at pre-compile  # This parameter defines the divisor preload value.
          symbolic name reference EcuMSleepModeRef: set at pre-compile, destination=EcuMSleepMode  # This configuration parameter is a reference to a configured sleep mode that is used for TTII.
          symbolic name reference EcuMSuccessorRef [0..1]: set at pre-compile, destination=EcuMSleepMode  # This parameter is a reference to the next sleep mode in the TTII protocol.
      container EcuMFlexConfiguration [0..1]  # This container contains the configuration (parameters) of the EcuMFlex. | Only applicable if EcuMFlex is implemented.
        choice reference EcuMFlexModuleConfigurationRef [0..*]: set at post-build, destination=[AdcConfigSet, CanConfigSet, DemConfigSet, FlsConfigSet, GptChannelConfigSet, IcuConfigSet, LinGlobalConfig, McuModuleConfiguration, PortConfigSet, PwmChannelConfigSet, SpiDriver, WdgMConfigSet, WdgSettingsConfig]  # These parameters contain references to the init structure of the corresponding BSW module.
        symbolic name reference EcuMNormalMcuModeRef: set at pre-compile, destination=McuModeSettingConf  # This parameter is a reference to the normal MCU mode to be restored after a sleep.
        container EcuMAlarmClock [0..*]  # These containers describe the configured alarm clocks. | The name of these conatiners allows giving a symbolic name to one alarm clock.
          integer EcuMAlarmClockId: 0..255, set at pre-compile, symbolic-name-value=true  # This ID identifies this alarmclock.
          float EcuMAlarmClockTimeOut: 0..Inf, set at pre-compile  # This parameter allows to define a timout for this alarm clock.
          symbolic name reference EcuMAlarmClockUser: set at pre-compile, destination=EcuMFlexUserConfig  # This parameter allows an alarm to be assigned to a user.
        container EcuMFlexUserConfig [1..*]  # These containers describe the identifiers that are needed to refer to a software component or another appropriate entity in the system which uses the EcuMFlex Interfaces.
          integer EcuMFlexUser: 0..255, set at pre-compile, symbolic-name-value=true  # Parameter used to identify one user.
          reference EcuMFlexEcucPartitionRef [0..1]: set at pre-compile, destination=EcucPartition  # Denotes in which "EcucPartition" the user of the EcuM is executed.
        container EcuMGoDownAllowedUsers [0..1]  # This container describes the collection of allowed users which are allowed to call the EcuM_GoDown API.
          symbolic name reference EcuMGoDownAllowedUserRef [1..*]: set at pre-compile, destination=EcuMFlexUserConfig  # These parameters describe the references to the users which are allowed to call the EcuM_GoDown API.
        container EcuMResetMode [1..*]  # These containers describe the configured reset modes. | The name of these containers allows one of the following symbolic names to be given to the different reset modes: - ECUM_RESET_MCU - ECUM_RESET_WDGM - ECUM_RESET_IO.
          integer EcuMResetModeId: 0..255, set at pre-compile, symbolic-name-value=true  # This ID identifies this reset mode in services like EcuM_SelectShutdownTarget.
        container EcuMSetClockAllowedUsers [0..1]  # This container describes the collection of allowed users which are allowed to call the EcuM_SetClock API.
          symbolic name reference EcuMSetClockAllowedUserRef [1..*]: set at pre-compile, destination=EcuMFlexUserConfig  # These parameters describe the references to the users which are allowed to call the EcuM_SetClock API.
        container EcuMShutdownCause [1..*]  # These containers describe the configured shut down or reset causes. | The name of these containers allows to give one of the following symbolic names to the diffenrent shut down causes: - ECUM_CAUSE_ECU_STATE - ECU state machine entered a state for shutdown, - ECUM_CAUSE_WDGM - WdgM detected failure, - ECUM_CAUSE_DCM - Dcm requests shutdown (split into UDS services?), - and values from configuration.
          integer EcuMShutdownCauseId: 0..255, set at pre-compile, symbolic-name-value=true  # This ID identifies this shut down cause.
        container EcuMShutdownTarget [1..*]  # These containers describe the configured shut down targets. | The name of these containers allows to give symbolic names to the different shut down targets.
          integer EcuMShutdownTargetId: 0..255, set at pre-compile, symbolic-name-value=true  # This ID identifies this shut down target in services like EcuM_SelectShutdownTarget.
    container EcuMFixedGeneral [0..1]  # This container holds the general, pre-compile configuration parameters for the EcuMFixed. | Only applicable if EcuMFixed is implemented.
      boolean EcuMIncludeComM: set at pre-compile  # This configuration parameter defines whether the communication manager is supported by EcuM. This feature is presented for development purpose to compile out the communication manager in the early debugging phase.
      boolean EcuMIncludeNvM: set at pre-compile  # This configuration parameter defines whether the non volatile memory manager is supported by EcuM. This feature is presented for development purpose to compile out the volatile memory manager in the early debugging phase.
      boolean EcuMIncludeNvramMgr: set at pre-compile  # If NVRAM manager is enabled but both flash and EEPROM driver are missing, then an error shall be flagged by the configuration tool
      boolean EcuMTTIIEnabled: set at pre-compile  # Boolean switch to enable / disable TTII
      symbolic name reference EcuMTTIIWakeupSourceRef: set at pre-compile, destination=EcuMWakeupSource  # This configuration parameter references the initial sleep mode to be used by TTII when TTII is activated after a RUN mode. | EcuM2785: Whenever RUN mode is reached, the TTII protocol shall be reset to use the wakeup source referenced by this parameter. This configuration parameter is a human readable name for a TTII wakeup source which is only needed by the configuration tool. For imlementation on the ECU, this parameter may be dropped and replaced by a generated list index of EcuM_TTII.
    container EcuMFlexGeneral [0..1]  # This container holds the general, pre-compile configuration parameters for the EcuMFlex. | Only applicable if EcuMFlex is implemented.
      boolean EcuMAlarmClockPresent: set at pre-compile  # This flag indicates whether the optional AlarmClock feature is present.
      boolean EcuMEnableDefBehaviour [0..1]: set at pre-compile  # Switches the defensive behaviour on or off.
      boolean EcuMResetLoopDetection: set at pre-compile  # If false, no reset loop detection is performed.
      symbolic name reference EcuMAlarmWakeupSource [0..1]: set at pre-compile, destination=EcuMWakeupSource  # This parameter describes the reference to the EcuMWakeupSource being used for the EcuM AlarmClock.
    container EcuMGeneral  # This container holds the general, pre-compile configuration parameters.
      boolean EcuMDevErrorDetect: set at pre-compile  # If false, no debug artifacts (e.g. calls to DET) shall remain in the executable object. Initialization of DET, however is controlled by configuration of optional BSW modules.
      boolean EcuMIncludeDem: set at pre-compile  # If enabled, the according BSW module will be included to the ECU State Manager.
      boolean EcuMIncludeDet: set at pre-compile  # If defined, the according BSW module will be initialized by the ECU State Manager
      float EcuMMainFunctionPeriod: 0..Inf, set at pre-compile  # This parameter defines the schedule period of EcuM_MainFunction. | Unit: [s]
      boolean EcuMVersionInfoApi: set at pre-compile  # Switches the version info API on or off
  module definition Eep [0..*]: variants post-build/pre-compile  # Configuration of the Eep (internal or external EEPROM driver) module. | Its multiplicity describes the number of EEPROM drivers present, so there will be one container for each EEPROM driver in the ECUC template. When no EEPROM driver is present then the multiplicity is 0.
    container EepGeneral  # Container for general configuration parameters of the EEPROM driver. These parameters are always pre-compile.
      boolean EepDevErrorDetect: set at pre-compile, default-value=true  # Pre-processor switch to enable and disable development error detection. | true: Development error detection enabled. false: Development error detection disabled.
      integer EepDriverIndex: 0..254, set at pre-compile, symbolic-name-value=true  # Index of the driver, used by EA.
      boolean EepUseInterrupts: set at pre-compile, default-value=false  # Switches to activate or deactivate interrupt controlled job processing. | true: Interrupt controlled job processing enabled. false: Interrupt controlled job processing disabled.
      boolean EepVersionInfoApi: set at pre-compile, default-value=false  # Pre-processor switch to enable / disable the API to read out the modules version information. | true: Version info API enabled. false: Version info API disabled.
      boolean EepWriteCycleReduction: set at pre-compile, default-value=false  # Switches to activate or deactivate write cycle reduction (EEPROM value is read and compared before being overwritten). | true: Write cycle reduction enabled. false: Write cycle reduction disabled.
    container EepInitConfiguration: multiple-configuration-container=true  # Container for runtime configuration parameters of the EEPROM driver. | Implementation Type: Eep_ConfigType.
      integer EepBaseAddress: 0..4294967295, set at post-build in variant post-build / pre-compile in variant pre-compile  # This parameter is the EEPROM device base address. | Implementation Type: Eep_AddressType.
      enumeration EepDefaultMode: {MEMIF_MODE_FAST, MEMIF_MODE_SLOW}, set at post-build in variant post-build / pre-compile in variant pre-compile, default-value=MEMIF_MODE_SLOW  # This parameter is the default EEPROM device mode after initialization. | Implementation Type: MemIf_ModeType.
      integer EepFastReadBlockSize: 0..4294967295, set at post-build in variant post-build / pre-compile in variant pre-compile  # Number of bytes read within one job processing cycle in fast mode. If the hardware does not support burst mode this parameter shall be set to the same value as EepNormalReadBlockSize. | Implementation Type: Eep_LengthType.
      integer EepFastWriteBlockSize: 0..4294967295, set at post-build in variant post-build / pre-compile in variant pre-compile  # Number of bytes written within one job processing cycle in fast mode. If the hardware does not support burst mode this parameter shall be set to the same value as EepNormalWriteBlockSize. | Implementation Type: Eep_LengthType.
      float EepJobCallCycle [0..1]: 0..Inf, set at post-build in variant post-build / pre-compile in variant pre-compile  # Call cycle time of the EEPROM driver's main function. Unit: [s]
      function name EepJobEndNotification [0..1]: set at post-build in variant post-build / pre-compile in variant pre-compile  # This parameter is a reference to a callback function for positive job result (see EEP045).
      function name EepJobErrorNotification [0..1]: set at post-build in variant post-build / pre-compile in variant pre-compile  # This parameter is a reference to a callback function for negative job result (see EEP046).
      integer EepNormalReadBlockSize: 0..4294967295, set at post-build in variant post-build / pre-compile in variant pre-compile  # Number of bytes read within one job processing cycle in normal mode. | Implementation Type: Eep_LengthType.
      integer EepNormalWriteBlockSize: 0..4294967295, set at post-build in variant post-build / pre-compile in variant pre-compile  # Number of bytes written within one job processing cycle in normal mode. | Implementation Type: Eep_LengthType.
      integer EepSize: 0..4294967295, set at post-build in variant post-build / pre-compile in variant pre-compile  # This parameter is the used size of EEPROM device in bytes. | Implementation Type: Eep_LengthType.
      container EepDemEventParameterRefs [0..1]  # Container for the references to DemEventParameter elements which shall be invoked using the API Dem_ReportErrorStatus API in case the corresponding error occurs. The EventId is taken from the referenced DemEventParameter's DemEventId value. The standardized errors are provided in the container and can be extended by vendor specific error references.
        symbolic name reference EEP_E_COMPARE_FAILED [0..1]: set at post-build in variant post-build / pre-compile in variant pre-compile, destination=DemEventParameter  # Reference to the DemEventParameter which shall be issued when the error "EEPROM compare failed (HW)" has occurred.
        symbolic name reference EEP_E_ERASE_FAILED [0..1]: set at post-build in variant post-build / pre-compile in variant pre-compile, destination=DemEventParameter  # Reference to the DemEventParameter which shall be issued when the error "EEPROM erase failed (HW)" has occurred.
        symbolic name reference EEP_E_READ_FAILED [0..1]: set at post-build in variant post-build / pre-compile in variant pre-compile, destination=DemEventParameter  # Reference to the DemEventParameter which shall be issued when the error "EEPROM read failed (HW)" has occurred.
        symbolic name reference EEP_E_WRITE_FAILED [0..1]: set at post-build in variant post-build / pre-compile in variant pre-compile, destination=DemEventParameter  # Reference to the DemEventParameter which shall be issued when the error "EEPROM write failed (HW)" has occurred.
      container EepExternalDriver [0..1]  # This container is present for external EEPROM drivers only. Internal EEPROM drivers do not use the parameter listed in this container, hence its multiplicity is 0 for internal drivers.
        symbolic name reference EepSpiReference [1..*]: set at post-build in variant post-build / pre-compile in variant pre-compile, destination=SpiSequence  # Reference to SPI sequence (required for external EEPROM drivers).
    container EepPublishedInformation  # Additional published parameters not covered by CommonPublishedInformation container. | Note that these parameters do not have any configuration class setting, since they are published information.
      integer EepAllowedWriteCycles: 0..4294967295, set at published-information  # Specified maximum number of write cycles under worst case conditions of specific EEPROM hardware (e.g. +90°C)
      float EepEraseTime: 0..Inf, set at published-information  # Maximum time for erasing one EEPROM data unit.
      integer EepEraseUnitSize: 0..4294967295, set at published-information  # Size of smallest erasable EEPROM data unit in bytes.
      integer EepEraseValue: 0..255, set at published-information  # Value of an erased EEPROM cell.
      integer EepMinimumAddressType: 0..4294967295, set at published-information  # Minimum expected size of Eep_AddressType.
      integer EepMinimumLengthType: 0..4294967295, set at published-information  # Minimum expected size of Eep_LengthType.
      integer EepReadUnitSize: 0..4294967295, set at published-information  # Size of smallest readable EEPROM data unit in bytes.
      integer EepSpecifiedEraseCycles: 0..4294967295, set at published-information  # Number of erase cycles specified for the EEP device (usually given in the device data sheet).
      integer EepTotalSize: 0..4294967295, set at published-information  # Total size of EEPROM in bytes. | Implementation Type: Eep_LengthType.
      float EepWriteTime: 0..Inf, set at published-information  # Maximum time for writing one EEPROM data unit.
      integer EepWriteUnitSize: 0..4294967295, set at published-information  # Size of smallest writeable EEPROM data unit in bytes.
  module definition Eth [0..*]: variants link-time/post-build/pre-compile  # Configuration of the Eth (Ethernet Driver) module.
    container EthConfigSet: multiple-configuration-container=true  # All included containers and parameters that may be part of a multiple configuration set.
      container EthCtrlConfig [1..*]  # Configuration of the individual controller
        boolean EthCtrlEnableMii: set at pre-compile  # Enables / Disables Media Independent Interface (MII) for transceiver access
        boolean EthCtrlEnableRxInterrupt: set at pre-compile  # Enables / Disables receive interrupt
        boolean EthCtrlEnableTxInterrupt: set at pre-compile  # Enables / Disables transmit interrupt
        integer EthCtrlIdx: 0..255, set at link in variant link-time / post-build in variant post-build / pre-compile in variant pre-compile, symbolic-name-value=true  # Specifies the instance ID of the configured controller.
        integer EthCtrlRxBufLenByte: 0..1522, set at link in variant link-time / post-build in variant post-build / pre-compile in variant pre-compile  # Limits the maximum receive buffer length (frame length) in bytes.
        integer EthCtrlTxBufLenByte: 0..1522, set at link in variant link-time / post-build in variant post-build / pre-compile in variant pre-compile  # Limits the maximum transmit buffer length (frame length) in bytes.
        integer EthRxBufTotal: 0..255, set at link in variant link-time / post-build in variant post-build / pre-compile in variant pre-compile  # Configures the number of receive buffers.
        integer EthTxBufTotal: 0..255, set at link in variant link-time / post-build in variant post-build / pre-compile in variant pre-compile  # Configures the number of transmit buffers.
        container EthDemEventParameterRefs [0..1]  # Container for the references to DemEventParameter elements which shall be invoked using the API Dem_ReportErrorStatus in case the corresponding error occurs. The EventId is taken from the referenced DemEventParameter's DemEventId value. The standardized errors are provided in the container and can be extended by vendor specific error references.
          symbolic name reference ETH_E_ACCESS [0..1]: set at link in variant link-time / post-build in variant post-build / pre-compile in variant pre-compile, destination=DemEventParameter  # Reference to the DemEventParameter which shall be issued when the error "Controller access failed" has occured.
    container EthGeneral  # General configuration of Ethernet Driver module
      boolean EthDevErrorDetect: set at pre-compile  # Enables / Disables development error detection.
      integer EthIndex: 0..255, set at pre-compile  # Specifies the InstanceId of this module instance. If only one instance is present it shall have the Id 0.
      integer EthMaxCtrlsSupported: 1..255, set at pre-compile  # Limits the total number of supported controllers.
      boolean EthVersionInfoApi: set at pre-compile  # Enables / Disables version info API
      boolean EthVersionInfoApiMacro: set at pre-compile  # Enables / Disables version info API macro implementation
  module definition EthIf [0..1]: variants link-time/post-build/pre-compile  # Configuration of the EthIf (Ethernet Interface) module.
    container EthIfConfigSet: multiple-configuration-container=true  # Collecting container for all parameters with post-build configuration classes.
      container EthIfConnection2EthCtrlMapping [1..*]  # Maps a particular connection in the Ethernet Interface to the physical Ethernet Controller.
        symbolic name reference EthIfEthCtrlRef: set at link in variant link-time / post-build in variant post-build / pre-compile in variant pre-compile, destination=EthCtrlConfig  # Reference to the controller in Ethernet Driver on which this connection will be transmitted / received. Connections are specified in the Socket Adapter [9].
        symbolic name reference EthIfSoAdConnectionRef: set at link in variant link-time / post-build in variant post-build / pre-compile in variant pre-compile, destination=SoAdSocketConnection
      container EthIfFrameOwnerConfig [1..*]  # Configuration of Ethernet frame owner
        integer EthIfFrameType: 0..65535, set at link in variant link-time / post-build in variant post-build / pre-compile in variant pre-compile  # Selects the Ethernet frame type.
        integer EthIfOwner: 0..255, set at link in variant link-time / post-build in variant post-build / pre-compile in variant pre-compile  # Selects the owner of an Ethernet frame type. The owner is a zero based index into the callback function configuration 'EthIfRxIndicationConfig'. I.e. an Ethernet frame of type IPv4 (0x800) at index 0 will call the first callback function configured in 'EthIfRxIndicationConfig'.
      container EthIfRxIndicationConfig [1..*]  # Configuration of receive callback functions.
        function name EthIfRxIndicationFunction: set at link in variant link-time / post-build in variant post-build / pre-compile in variant pre-compile  # Specifies receive indication callback function.
      container EthIfTrcvLinkStateChgConfig [1..*]  # Specifies link state change callback function
        function name EthIfTrcvLinkStateChgFunction: set at link in variant link-time / post-build in variant post-build / pre-compile in variant pre-compile  # Specifies link state change callback function
      container EthIfTxConfirmationConfig [1..*]  # Configuration of transmit indication callback functions.
        function name EthIfTxConfirmationFunction: set at link in variant link-time / post-build in variant post-build / pre-compile in variant pre-compile  # Specifies transmit indication callback function
    container EthIfGeneral  # This container contains the general configuration parameters of the Ethernet Interface.
      boolean EthIfDevErrorDetect: set at pre-compile  # Enables / Disables development error detection.
      boolean EthIfEnableRxInterrupt: set at pre-compile  # Enables / Disables receive interrupt.
      boolean EthIfEnableTxInterrupt: set at pre-compile  # Enables / Disables the transmit interrupt.
      float EthIfMainFunctionPeriod: 0..Inf, set at pre-compile  # Specifies the period of main function EthIf_MainFunctionRx and EthIf_MainFunctionTx in seconds. Ethernet Interface does not require this information but the BSW scheduler.
      integer EthIfMaxTrcvsTotal: 1..255, set at pre-compile  # Limits the total number of transceivers.
      integer EthIfMaxTxBufsTotal: 1..255, set at pre-compile  # Limits the total number of transmit buffers.
      string EthIfPublicCddHeaderFile [0..*]: set at pre-compile, max-length=32, min-length=1  # Defines header files for callback functions which shall be included in case of CDDs. Range of characters is 1.. 32.
      integer EthIfTrcvLinkStateChgMainReload: 1..255, set at pre-compile  # Specifies the frequency of transceiver link state change checks in each | period of main function EthIf_MainFunctionTx.
      boolean EthIfVersionInfoApi: set at pre-compile  # Enables / Disables version info API
      boolean EthIfVersionInfoApiMacro: set at pre-compile  # Enables / Disables version info API macro implementation.
  module definition EthSm [0..1]: variants pre-compile  # Configuration of the Ethernet State Manager
    container EthSmGeneral  # This container contains the global parameter of the Ethernet State Manager.
      boolean EthSmDevErrorDetect: set at pre-compile  # Enables and disables the development errer detection and notification mechanism.
      boolean EthSmDummyMode: set at pre-compile  # Disables the API to the EthIf. The API to the ComM is available but the functionality is deactivated. The function calls from the ComM will be answered with the return value E_OK.
      float EthSmMainFunctionPeriod: 0.005..1, set at pre-compile  # Specifies the period in seconds that the MainFunction has to be triggered with.
      boolean EthSmVersionInfoApi: set at pre-compile  # Enables and disables the version info API.
    container EthSmNetwork [1..*]  # This container contains the Ethernet network-specific parameters of each Ethernet network. It also contains the controller and transceiver IDs assigned to a Ethernet network.
      float EthSmConfirmationTimeout: 0..Inf, set at pre-compile  # Timeout in seconds for the calls to EthIf: | EthIf_ControllerInit EthIf_TransceiverInit EthIf_SetControllerMode EthIf_SetTransceiverMode
      symbolic name reference EthSMComMNetworkHandleRef: set at pre-compile, destination=ComMChannel  # Unique handle to identify one certain Ethernet network. Reference to one of the network handles configured for the ComM.
      symbolic name reference EthSmControllerId: set at pre-compile, destination=EthCtrlConfig  # ID of the Ethernet controller assigned to the configured network handle. Reference to one of the controllers of Eth configuration.
      symbolic name reference EthSmTransceiverId: set at pre-compile, destination=EthTrcvConfig  # ID of the ethernet transceiver assigned to the configured network handle. Reference to one of the transceivers of EthTrcv configuration.
  module definition EthTrcv [0..*]: variants link-time/post-build/pre-compile  # Configuration of Ethernet Transceiver Driver module
    container EthTrcvConfigSet: multiple-configuration-container=true  # All underlying parameters may be part of a multiple configuration set.
      container EthTrcvConfig [1..*]  # Configuration of the individual transceiver
        integer EthTrcvCtrlIdx: 0..255, set at link in variant link-time / post-build in variant post-build / pre-compile in variant pre-compile  # Specifies the controller used for MII access to the transceiver
        integer EthTrcvIdx: 0..255, set at link in variant link-time / post-build in variant post-build / pre-compile in variant pre-compile, symbolic-name-value=true  # Specifies the instance ID of the configured transceiver.
        integer EthTrcvMiiIdx: 0..255, set at link in variant link-time / post-build in variant post-build / pre-compile in variant pre-compile  # Specifies the transceiver index used for MII access to the transceiver
        container EthTrcvDemEventParameterRefs [0..1]  # Container for the references to DemEventParameter elements which shall be invoked using the API Dem_ReportErrorStatus API in case the corresponding error occurs. The EventId is taken from the referenced DemEventParameter's DemEventId value. The standardized errors are provided in the container and can be extended by vendor specific error references.
          symbolic name reference ETHTRCV_E_ACCESS [0..1]: set at link in variant link-time / post-build in variant post-build / pre-compile in variant pre-compile, destination=DemEventParameter  # Reference to the DemEventParameter which shall be issued when the error "Transceiver access failed" has occured.
    container EthTrcvGeneral  # General configuration of Ethernet Transceiver Driver module
      boolean EthTrcvDevErrorDetect: set at pre-compile  # Enables / Disables development error detection
      boolean EthTrcvGetBaudRateApi: set at pre-compile  # Enables / Disables EthTrcv_GetBaudRate API
      boolean EthTrcvGetDuplexModeApi: set at pre-compile  # Enables / Disables EthTrcv_GetDuplexMode API
      boolean EthTrcvGetLinkStateApi: set at pre-compile  # Enables / Disables EthTrcv_GetLinkState API
      boolean EthTrcvGetTransceiverModeApi: set at pre-compile  # Enables / Disables EthTrcv_GetTransceiverMode API
      integer EthTrcvIndex: 0..255, set at pre-compile  # Specifies the InstanceId of this module instance. If only one instance is present it shall have the Id 0.
      integer EthTrcvMaxTrcvsSupported: 0..255, set at pre-compile, default-value=1
      boolean EthTrcvSetTransceiverModeApi: set at pre-compile  # Enables / Disables EthTrcv_SetTransceiverMode API
      boolean EthTrcvStartAutoNegotiationApi: set at pre-compile  # Enables / Disables EthTrcv_StartAutoNegotiation API
      boolean EthTrcvVersionInfoApi: set at pre-compile  # Enables / Disables version info API
      boolean EthTrcvVersionInfoApiMacro: set at pre-compile  # Enables / Disables version info API macro implementation
      integer EthTrcvWaitCount: 0..4294967295, set at pre-compile, default-value=0  # Wait count for transceiver state changes.
  module definition Fee [0..1]: variants pre-compile  # Configuration of the Fee (Flash EEPROM Emulation) module.
    container FeeBlockConfiguration [1..*]  # Configuration of block specific parameters for the Flash EEPROM Emulation module.
      integer FeeBlockNumber: 1..65534, set at pre-compile, symbolic-name-value=true  # Block identifier (handle). | 0x0000 and 0xFFFF shall not be used for block numbers (see FEE006). Range: min = 2^NVM_DATASET_SELECTION_BITS max = 0xFFFF -2^NVM_DATASET_SELECTION_BITS Note: Depending on the number of bits set aside for dataset selection several other block numbers shall also be left out to ease implementation.
      integer FeeBlockSize: 1..65535, set at pre-compile  # Size of a logical block in bytes.
      boolean FeeImmediateData: set at pre-compile  # Marker for high priority data. | true: Block contains immediate data. false: Block does not contain immediate data.
      integer FeeNumberOfWriteCycles: 0..4294967295, set at pre-compile  # Number of write cycles required for this block.
      symbolic name reference FeeDeviceIndex: set at pre-compile, destination=FlsGeneral  # Device index (handle). | Range: 0 .. 254 (0xFF reserved for broadcast call to GetStatus function).
    container FeeGeneral  # Container for general parameters. These parameters are not specific to a block.
      boolean FeeDevErrorDetect: set at pre-compile  # Pre-processor switch to enable and disable development error detection. | true: Development error detection enabled. false: Development error detection disabled.
      integer FeeIndex: 0..254, set at pre-compile  # Specifies the InstanceId of this module instance. If only one instance is present it shall have the Id 0.
      function name FeeNvmJobEndNotification [0..1]: set at pre-compile  # Mapped to the job end notification routine provided by the upper layer module (NvM_JobEndNotification).
      function name FeeNvmJobErrorNotification [0..1]: set at pre-compile  # Mapped to the job error notification routine provided by the upper layer module (NvM_JobErrorNotification).
      boolean FeePollingMode: set at pre-compile  # Pre-processor switch to enable and disable the polling mode for this module. | true: Polling mode enabled, callback functions (provided to FLS module) disabled. false: Polling mode disabled, callback functions (provided to FLS module) enabled.
      boolean FeeSetModeSupported: set at pre-compile  # Compiler switch to enable/disable the 'SetMode' functionality of the FEE module. | TRUE: SetMode functionality supported / code present, FALSE: SetMode functionality not supported / code not present. Note: This configuration setting has to be consistent with that of all underlying flash device drivers (configuration parameter FlsSetModeApi).
      boolean FeeVersionInfoApi: set at pre-compile  # Pre-processor switch to enable / disable the API to read out the modules version information. | true: Version info API enabled. false: Version info API disabled.
      integer FeeVirtualPageSize: 0..65535, set at pre-compile  # The size in bytes to which logical blocks shall be aligned.
    container FeePublishedInformation  # Additional published parameters not covered by CommonPublishedInformation container. | Note that these parameters do not have any configuration class setting, since they are published information.
      integer FeeBlockOverhead: 0..65535, set at published-information  # Management overhead per logical block in bytes. | Note: If the management overhead depends on the block size or block location a formula has to be provided that allows the configurator to calculate the management overhead correctly.
      float FeeMaximumBlockingTime: 0..Inf, set at published-information  # The maximum time the FEE module's API routines shall be blocked (delayed) by internal operations. | Note: Internal operations in that case means operations that are not explicitly invoked from the upper layer module but need to be handled for proper operation of this module or the underlying memory driver.
      integer FeePageOverhead: 0..65535, set at published-information  # Management overhead per page in bytes. | Note: If the management overhead depends on the block size or block location a formula has to be provided that allows the configurator to calculate the management overhead correctly.
  module definition FiM [0..1]: variants post-build/pre-compile  # Configuration of the FiM (Function Inhibition Manager) module.
    container FiMConfigSet: multiple-configuration-container=true  # This container contains the configuration parameters and sub containers of the FiM module supporting multiple configuration sets. | This container is a MultipleConfigurationContainer, i.e. this container and its sub-containers exist once per configuration set.
      container FiMEventSummary [0..*]  # The summarized EventId definition record consists of a summarized event ID and a specific EventId. | This record means that a particular FID that has to be disabled in case of summarized event (defined above) is to be disabled in any of the specific events. A possible solution could be assigning events as summarized events along with a list of specific events. During the configuration process the summarized event substitutes the referenced single events. However, it is not outlined how this requirement is solved - whether by configuration process or by implementation within the FiM. The FiM configuration tool could also build up a suitable data structure for summarized events and deal with it in the FiM implementation.
        symbolic name reference FiMInputSumEventRef [1..*]: set at post-build in variant post-build / pre-compile in variant pre-compile, destination=DemEventParameter
        symbolic name reference FiMOutputSumEventRef: set at post-build in variant post-build / pre-compile in variant pre-compile, destination=FiMSummaryEventId
      container FiMFID [0..*]  # This container includes symbolic names of all FIDs.
        integer FiMFunctionId: 0..65535, set at pre-compile, symbolic-name-value=true  # The configuration parameter is used as an ID which represents a functionality. FiMFunctionId is the unique identifier assigned during FIM configuration. | Implementation Type: FiM_FunctionIdType.
      container FiMInhibitionConfiguration [0..*]  # This container includes all configuration parameters concerning the relationship between event and FID.
        enumeration FiMInhInhibitionMask: {FIM_LAST_FAILED, FIM_NOT_TESTED, FIM_TESTED, FIM_TESTED_AND_FAILED}, set at post-build in variant post-build / pre-compile in variant pre-compile  # The configuration parameter is used to specify the inhibition mask for an event - FID relation.
        reference FiMInhFunctionIdRef: set at post-build in variant post-build / pre-compile in variant pre-compile, destination=FiMFID
        container FiMInhEventId  # The configuration parameter is used for an existing DEM event and summarized events as well.
          choice container FiMInhRefChoice
            container FiMInhChoiceDemRef [0..1]
              symbolic name reference FiMInhEventRef: destination=DemEventParameter
            container FiMInhChoiceSumRef [0..1]
              symbolic name reference FiMInhSumRef [1..*]: destination=FiMSummaryEventId
      container FiMSummaryEventId [0..*]  # This container defines the name of a summarized event.
        integer FiMEventSumId: 0..65535, set at post-build in variant post-build / pre-compile in variant pre-compile, symbolic-name-value=true  # The summarized EventId definition record defines the existence of a summarized event with a specific name. This summarized event can be referenced in the EventSummary (as FimSummaryEventId) and Inhibition configuration (as FimInhEventId).
    container FiMGeneral
      boolean FiMDataFixed: set at pre-compile  # Enable or disable calibration of inhibit relations The scope of the parameter is to meet the requirement (FIM008) to have the option to calibrate inhibit data on the one hand side and also to provide the option to protect inhibit data for consistency reasons.
      boolean FiMDevErrorDetect: set at pre-compile  # This configuration parameter is used to switch on or to switch off the detection of development errors during development.
      boolean FiMEventUpdateTriggeredByDem: set at pre-compile  # This configuration parameter specifies the way FIM obtains status of EventIds. | TRUE: the DEM informs FIM about changes of event status, FALSE: the FIM polls event status from the DEM module either cyclically or on demand.
      integer FiMMaxEventFidLinks: 1..65535, set at pre-compile  # This configuration parameter specifies the total maximum number of links between EventIds and FIDs.
      integer FiMMaxEventsPerFid: 1..65535, set at pre-compile  # This configuration parameter specifies the maximum number of EventIds that can be linked to a single FID.
      integer FiMMaxFidsPerEvent: 1..65535, set at pre-compile  # This configuration parameter specifies the maximum number of FIDs that can be linked to a single event.
      integer FiMMaxSummaryEvents: 0..65535, set at pre-compile  # This configuration parameter specifies the maximum number of summarized events that can be configured.
      integer FiMMaxSummaryLinks: 0..65535, set at pre-compile  # This configuration parameter specifies the total maximum number of links between EventIds and summarized events.
      integer FiMMaxTotalLinks: 1..65535, set at pre-compile  # This configuration parameter specifies the total maximum number of links between EventIds and FIDs plus the number of links between EventIds and summarized events.
      float FiMTaskTime: 0..0.1, set at pre-compile, origin=AUTOSAR_ECUC V1.0.0  # Allow to configure the time for the periodic cyclic task. Please note: This configuration value shall be equal to the value in the Basic Software Scheduler configuration of the RTE module. | The AUTOSAR configuration standard is to use SI units, so this parameter is defined as float value in seconds. DEM configuration tools must convert this float value to the appropriate value format for the use in the software implementation of DEM. min: A negative value is not allowed. max: FID must be set after a maximal time of 100ms after DEM status is set. upperMultiplicity: Exactly one TaskTime must be specified per configuration. lowerMultiplicity: Exactly one TaskTime must be specified per configuration.
      boolean FiMVersionInfoApi: set at pre-compile  # This configuration parameter is used to switch on or to switch off the API to get the version information.
  module definition Fls [0..*]: variants post-build/pre-compile  # Configuration of the Fls (internal or external flash driver) module. | Its multiplicity describes the number of flash drivers present, so there will be one container for each flash driver in the ECUC template. When no flash driver is present then the multiplicity is 0.
    container FlsConfigSet: multiple-configuration-container=true  # Container for runtime configuration parameters of the flash driver. | Implementation Type: Fls_ConfigType.
      integer FlsAcErase: 0..4294967295, set at post-build in variant post-build / pre-compile in variant pre-compile  # Address offset in RAM to which the erase flash access code shall be loaded. | Used as function pointer to access the erase flash access code.
      integer FlsAcWrite: 0..4294967295, set at post-build in variant post-build / pre-compile in variant pre-compile  # Address offset in RAM to which the write flash access code shall be loaded. | Used as function pointer to access the write flash access code.
      float FlsCallCycle: 0..1, set at post-build in variant post-build / pre-compile in variant pre-compile  # Cycle time of calls of the flash driver's main function (in seconds).
      enumeration FlsDefaultMode: {MEMIF_MODE_FAST, MEMIF_MODE_SLOW}, set at post-build in variant post-build / pre-compile in variant pre-compile, default-value=MEMIF_MODE_SLOW  # This parameter is the default FLS device mode after initialization. | Implementation Type: MemIf_ModeType.
      function name FlsJobEndNotification [0..1]: set at post-build in variant post-build / pre-compile in variant pre-compile  # Mapped to the job end notification routine provided by some upper layer module, typically the Fee module.
      function name FlsJobErrorNotification [0..1]: set at post-build in variant post-build / pre-compile in variant pre-compile  # Mapped to the job error notification routine provided by some upper layer module, typically the Fee module.
      integer FlsMaxReadFastMode: 0..4294967295, set at post-build in variant post-build / pre-compile in variant pre-compile  # The maximum number of bytes to read or compare in one cycle of the flash driver's job processing function in fast mode.
      integer FlsMaxReadNormalMode: 0..4294967295, set at post-build in variant post-build / pre-compile in variant pre-compile  # The maximum number of bytes to read or compare in one cycle of the flash driver's job processing function in normal mode.
      integer FlsMaxWriteFastMode: 0..4294967295, set at post-build in variant post-build / pre-compile in variant pre-compile  # The maximum number of bytes to write in one cycle of the flash driver's job processing function in fast mode.
      integer FlsMaxWriteNormalMode: 0..4294967295, set at post-build in variant post-build / pre-compile in variant pre-compile  # The maximum number of bytes to write in one cycle of the flash driver's job processing function in normal mode.
      integer FlsProtection: 0..4294967295, set at post-build in variant post-build / pre-compile in variant pre-compile  # Erase/write protection settings. Only relevant if supported by hardware.
      container FlsDemEventParameterRefs [0..1]  # Container for the references to DemEventParameter elements which shall be invoked using the Dem_ReportErrorStatus API in case the corresponding error occurs. The EventId is taken from the referenced DemEventParameter's DemEventId value. The standardized errors are provided in the container and can be extended by vendor specific error references.
        symbolic name reference FLS_E_COMPARE_FAILED [0..1]: set at post-build in variant post-build / pre-compile in variant pre-compile, destination=DemEventParameter  # Reference to the DemEventParameter which shall be issued when the error "Flash compare failed (HW)" has occurred.
        symbolic name reference FLS_E_ERASE_FAILED [0..1]: set at post-build in variant post-build / pre-compile in variant pre-compile, destination=DemEventParameter  # Reference to the DemEventParameter which shall be issued when the error "Flash erase failed (HW)" has occurred.
        symbolic name reference FLS_E_READ_FAILED [0..1]: set at post-build in variant post-build / pre-compile in variant pre-compile, destination=DemEventParameter  # Reference to the DemEventParameter which shall be issued when the error "Flash read failed (HW)" has occurred.
        symbolic name reference FLS_E_UNEXPECTED_FLASH_ID [0..1]: set at post-build in variant post-build / pre-compile in variant pre-compile, destination=DemEventParameter  # Reference to the DemEventParameter which shall be issued when the error "Expected hardware ID not matched" has occurred.
        symbolic name reference FLS_E_WRITE_FAILED [0..1]: set at post-build in variant post-build / pre-compile in variant pre-compile, destination=DemEventParameter  # Reference to the DemEventParameter which shall be issued when the error "Flash write failed (HW)" has occurred.
      container FlsExternalDriver [0..1]  # This container is present for external Flash drivers only. Internal Flash drivers do not use the parameter listed in this container, hence its multiplicity is 0 for internal drivers.
        symbolic name reference FlsSpiReference [1..*]: set at pre-compile, destination=SpiSequence  # Reference to SPI sequence (required for external Flash drivers).
      container FlsSectorList  # List of flashable sectors and pages.
        container FlsSector [1..*]  # Configuration description of a flashable sector
          integer FlsNumberOfSectors: 0..65535, set at pre-compile  # Number of continuous sectors with identical values for FlsSectorSize and | FlsPageSize. The parameter FlsSectorStartAddress denotes the start address of the first sector.
          integer FlsPageSize: 0..4294967295, set at pre-compile  # Size of one page of this sector. | Implementation Type: Fls_LengthType.
          integer FlsSectorSize: 0..4294967295, set at pre-compile  # Size of this sector. | Implementation Type: Fls_LengthType.
          integer FlsSectorStartaddress: 0..4294967295, set at pre-compile  # Start address of this sector. | Implementation Type: Fls_AddressType.
    container FlsGeneral  # Container for general parameters of the flash driver. These parameters are always pre-compile.
      boolean FlsAcLoadOnJobStart: set at pre-compile, default-value=false  # The flash driver shall load the flash access code to RAM whenever an erase or write job is started and unload (overwrite) it after that job has been finished or canceled. | true: Flash access code loaded on job start / unloaded on job end or error. false: Flash access code not loaded to / unloaded from RAM at all.
      integer FlsBaseAddress: 0..4294967295, set at pre-compile  # The flash memory start address (see also FLS208 and FLS209). | FLS169_Conf: This parameter defines the lower boundary for read / write / erase and compare jobs.
      boolean FlsCancelApi: set at pre-compile  # Compile switch to enable and disable the Fls_Cancel function. | true: API supported / function provided. false: API not supported / function not provided
      boolean FlsCompareApi: set at pre-compile  # Compile switch to enable and disable the Fls_Compare function. | true: API supported / function provided. false: API not supported / function not provided
      boolean FlsDevErrorDetect: set at pre-compile, default-value=true  # Pre-processor switch to enable and disable development error detection (see FLS077). | true: Development error detection enabled. false: Development error detection disabled.
      integer FlsDriverIndex: 0..254, set at pre-compile, symbolic-name-value=true  # Index of the driver, used by FEE.
      boolean FlsGetJobResultApi: set at pre-compile  # Compile switch to enable and disable the Fls_GetJobResult function. | true: API supported / function provided. false: API not supported / function not provided
      boolean FlsGetStatusApi: set at pre-compile  # Compile switch to enable and disable the Fls_GetStatus function. | true: API supported / function provided. false: API not supported / function not provided
      boolean FlsSetModeApi: set at pre-compile  # Compile switch to enable and disable the Fls_SetMode function. | true: API supported / function provided. false: API not supported / function not provided
      integer FlsTotalSize: 0..4294967295, set at pre-compile  # The total amount of flash memory in bytes (see also FLS208 and FLS209). | FLS170_Conf: This parameter in conjunction with FLS_BASE_ADDRESS defines the upper boundary for read / write / erase and compare jobs.
      boolean FlsUseInterrupts: set at pre-compile, default-value=false  # Job processing triggered by hardware interrupt. | true: Job processing triggered by interrupt (hardware controlled). false: Job processing not triggered by interrupt (software controlled)
      boolean FlsVersionInfoApi: set at pre-compile  # Pre-processor switch to enable / disable the API to read out the modules version information. | true: Version info API enabled. false: Version info API disabled.
    container FlsPublishedInformation  # Additional published parameters not covered by CommonPublishedInformation container. | Note that these parameters do not have any configuration class setting, since they are published information.
      integer FlsAcLocationErase: 0..4294967295, set at published-information  # Position in RAM, to which the erase flash access code has to be loaded. | Only relevant if the erase flash access code is not position independent. If this information is not provided it is assumed that the erase flash access code is position independent and that therefore the RAM position can be freely configured.
      integer FlsAcLocationWrite: 0..4294967295, set at published-information  # Position in RAM, to which the write flash access code has to be loaded. | Only relevant if the write flash access code is not position independent. If this information is not provided it is assumed that the write flash access code is position independent and that therefore the RAM position can be freely configured.
      integer FlsAcSizeErase: 0..4294967295, set at published-information  # Number of bytes in RAM needed for the erase flash access code.
      integer FlsAcSizeWrite: 0..4294967295, set at published-information  # Number of bytes in RAM needed for the write flash access code.
      float FlsEraseTime: 0..Inf, set at published-information  # Maximum time to erase one complete flash sector.
      integer FlsErasedValue: 0..4294967295, set at published-information  # The contents of an erased flash memory cell.
      string FlsExpectedHwId: set at published-information  # Unique identifier of the hardware device that is expected by this driver (the device for which this driver has been implemented). | Only relevant for external flash drivers.
      integer FlsSpecifiedEraseCycles: 0..4294967295, set at published-information  # Number of erase cycles specified for the flash device (usually given in the device data sheet). | FLS198: If the number of specified erase cycles depends on the operating environment (temperature, voltage, ...) during reprogramming of the flash device, the minimum number for which a data retention of at least 15 years over the temperature range from -40°C .. +125°C can be guaranteed shall be given. Note: If there are different numbers of specified erase cycles for different flash sectors of the device this parameter has to be extended to a parameter list (similar to the sector list above).
      float FlsWriteTime: 0..Inf, set at published-information  # Maximum time to program one complete flash page.
  module definition FlsTst [0..1]: variants post-build/pre-compile
    container FlsTstConfigSet: multiple-configuration-container=true  # Multiple Configuration Set Container
      integer FlsTstBlockNumberBgnd: 0..4294967295, set at post-build in variant post-build / pre-compile in variant pre-compile  # This parameter shall represent the number of test blocks available for the background test. | calculationFormula = Number of configured FlsTstBlocks in the FlsTstBlockBgndConfigSet (or 0 if no FlsTstBlocks are configured).
      integer FlsTstBlockNumberFgnd: 0..4294967295, set at post-build in variant post-build / pre-compile in variant pre-compile  # This parameter shall represent the number of test blocks available for the foreground test. | calculationFormula = Number of configured FlsTstBlocks in the FlsTstBlockFgndConfigSet (or 0 if no FlsTstBlocks are configured).
      function name FlsTstTestCompletedNotification: set at post-build in variant post-build / pre-compile in variant pre-compile  # Pointer to function, which shall be called after finishing the background Flash test interval.
      container FlsTstBlockBgndConfigSet [0..1]  # This container defines the blocks in background mode.
        container FlsTstBlock [1..*]  # This container specifies configuration parameters for an individual test block.
          integer FlsTstBlockBaseAddress: 0..18446744073709551615, set at post-build in variant post-build / pre-compile in variant pre-compile  # Start Address of the Flash block.
          integer FlsTstBlockIndex: 0..4294967295, set at post-build in variant post-build / pre-compile in variant pre-compile, symbolic-name-value=true  # Foreground Test: Index identifies block to be tested by FlsTst_StartFgnd(); | Background Test: The scheduling for background test shall follow an order defined by this index. '0' means highest priority.
          integer FlsTstBlockSize: 0..4294967295, set at post-build in variant post-build / pre-compile in variant pre-compile  # This parameter shall represent the Flash Test block size.
          integer FlsTstNumberOfTestedCells: 0..4294967295, set at pre-compile  # Configures the Number of cells to be tested in background mode during one scheduled task (FlsTst_MainFunction() call).
          integer FlsTstSignatureAddress: 0..18446744073709551615, set at post-build in variant post-build / pre-compile in variant pre-compile  # Address of the signature reference value of the Flash test block.
          enumeration FlsTstTestAlgorithm: {FLSTST_16BIT_CRC, FLSTST_32BIT_CRC, FLSTST_8BIT_CRC, FLSTST_CHECKSUM, FLSTST_DUPLICATED_MEMORY, FLSTST_ECC}, set at post-build in variant post-build / pre-compile in variant pre-compile  # This is the configuration of the test algorithm for foreground mode and background mode. The availability of algorithm is implementation specific.
      container FlsTstBlockFgndConfigSet [0..1]  # This container defines the blocks in foreground mode.
        container FlsTstBlock [1..*]  # This container specifies configuration parameters for an individual test block.
          integer FlsTstBlockBaseAddress: 0..18446744073709551615, set at post-build in variant post-build / pre-compile in variant pre-compile  # Start Address of the Flash block.
          integer FlsTstBlockIndex: 0..4294967295, set at post-build in variant post-build / pre-compile in variant pre-compile, symbolic-name-value=true  # Foreground Test: Index identifies block to be tested by FlsTst_StartFgnd(); | Background Test: The scheduling for background test shall follow an order defined by this index. '0' means highest priority.
          integer FlsTstBlockSize: 0..4294967295, set at post-build in variant post-build / pre-compile in variant pre-compile  # This parameter shall represent the Flash Test block size.
          integer FlsTstNumberOfTestedCells: 0..4294967295, set at pre-compile  # Configures the Number of cells to be tested in background mode during one scheduled task (FlsTst_MainFunction() call).
          integer FlsTstSignatureAddress: 0..18446744073709551615, set at post-build in variant post-build / pre-compile in variant pre-compile  # Address of the signature reference value of the Flash test block.
          enumeration FlsTstTestAlgorithm: {FLSTST_16BIT_CRC, FLSTST_32BIT_CRC, FLSTST_8BIT_CRC, FLSTST_CHECKSUM, FLSTST_DUPLICATED_MEMORY, FLSTST_ECC}, set at post-build in variant post-build / pre-compile in variant pre-compile  # This is the configuration of the test algorithm for foreground mode and background mode. The availability of algorithm is implementation specific.
    container FlsTstConfigurationOfOptApiServices
      boolean FlsTstGetCurrentStateApi: set at pre-compile, default-value=false  # Adds / removes the service FlsTst_GetCurrentState() from the code.
      boolean FlsTstGetErrorDetailsApi: set at pre-compile, default-value=false  # Adds / removes the service FlsTst_GetErrorDetails() from the code.
      boolean FlsTstGetTestResultBgndApi: set at pre-compile, default-value=false  # Adds / removes the service FlsTst_GetTestResultBgnd() from the code.
      boolean FlsTstGetTestResultFgndApi: set at pre-compile, default-value=false  # Adds / removes the service FlsTst_GetTestResultFgnd() from the code.
      boolean FlsTstGetTestSignatureBgndApi: set at pre-compile, default-value=false  # Adds / removes the service FlsTst_GetTestSignatureBgnd() from the code.
      boolean FlsTstGetTestSignatureFgndApi: set at pre-compile, default-value=false  # Adds / removes the service FlsTst_GetTestSignatureFgnd() from the code.
      boolean FlsTstStartFgndApi: set at pre-compile, default-value=false  # Adds / removes the service FlsTst_StartFgnd() from the code.
      boolean FlsTstSuspendResumeApi: set at pre-compile, default-value=false  # Adds / removes the services FlsTst_Suspend() and FlsTst_Resume() from the code.
      boolean FlsTstTestEccApi: set at pre-compile, default-value=false  # Adds / removes the service FlsTst_TestEcc() from the code.
      boolean FlsTstVersionInfoApi: set at pre-compile, default-value=false  # Adds / removes the service FlsTst_GetVersionInfo() from the code.
    container FlsTstDemEventParameterRefs [0..1]  # Container for the references to DemEventParameter elements which shall be invoked using the API Dem_ReportErrorStatus API in case the corresponding error occurs. The EventId is taken from the referenced DemEventParameter's DemEventId value. The standardized errors are provided in the container and can be extended by vendor specific error references.
      symbolic name reference FLSTST_E_FLSTST_FAILURE [0..1]: set at pre-compile, destination=DemEventParameter  # Reference to the DemEventParameter which shall be issued when the error "Flash Failure" has occurred.
    container FlsTstGeneral
      boolean FlsTstDevErrorDetect: set at pre-compile, default-value=false  # Switch for enabling the development error detection.
      integer FlsTstNumberOfTestedCellsAtomic: 0..4294967295, set at pre-compile  # Configures the Number of cells to be tested in background mode without checking user requests (Abort, Suspend).
      boolean FlsTstTestCompletedNotificationSupported: set at pre-compile, default-value=true  # Switch to indicate that the notification is supported.
      integer FlsTstTestIntervalIdEndValue: 0..4294967295, set at pre-compile  # Defines the end value of the Test Interval Id.
      boolean FlsTstTestResultSignature: set at pre-compile, default-value=false  # Configures the result of the test in background mode: | True: Test Result is a signature (see FlsTst155, FlsTst054) False: Test Result is ok/not ok (see FlsTst153, FlsTst042)
  module definition Fr [0..*]: variants post-build/pre-compile  # Configuration of the Fr (FlexRay driver) module.
    container FrGeneral  # General configuration (parameters) of the FlexRay Driver module.
      boolean FrBufferReconfig: set at pre-compile  # Enables or disables buffer reconfiguration at runtime.
      integer FrCtrlTestCount: 0..255, set at pre-compile, default-value=1  # Maxmimum number of iterations the FlexRay controller hardware test is performed during controller initialization.
      boolean FrDevErrorDetect: set at pre-compile  # Switches the Development Error Detection and Notification | on or off. true: Development Error Detection and Notification enabled. false: Development Error Detection and Notification disabled.
      integer FrIndex: 0..255, set at pre-compile  # Specifies the InstanceId of this module instance. If only one instance is present it shall have the Id 0.
      integer FrNumCtrlSupported: 1..256, set at pre-compile  # Determines the maximum number of communication controllers that the driver supports.
      boolean FrRxStringentCheck: set at pre-compile, default-value=false  # If stringent check is enabled (true), received frames are only | accepted if no slot status error occured.
      boolean FrRxStringentLengthCheck: set at pre-compile, default-value=false  # If stringent check is enabled (true), received frames are only | accepted the received payload length matches the configured payload length.
      boolean FrVersionInfoApi: set at pre-compile  # Enables/disables the existence of the Fr_GetVersionInfo API.
    container FrMultipleConfiguration: multiple-configuration-container=true  # Configuration of the individual controllers.
      container FrController [1..*]  # Configuration of the individual controller.
        integer FrCtrlIdx: 0..255, set at post-build in variant post-build / pre-compile in variant pre-compile, symbolic-name-value=true  # Determines index of CC within Fr.
        boolean FrPAllowHaltDueToClock: set at post-build in variant post-build / pre-compile in variant pre-compile  # Boolean flag that controls the transition to the POC:halt state due to a clock synchronization errors. If set to true, the CC is allowed to transition to POC:halt. If set to false, the CC will not transition to the POC:halt state but will enter or remain in the POC:normal passive state (self healing would still be possible)
        integer FrPAllowPassiveToActive: 0..31, set at post-build in variant post-build / pre-compile in variant pre-compile  # Number of consecutive even/odd cycle pairs that must have valid clock correction terms before the CC will be allowed to transition from the POC:normal passive state to POC:normal active state. If set to zero, the CC is not allowed to transition from POC:normal passive to POC:normal active
        enumeration FrPChannels: {FR_CHANNEL_A, FR_CHANNEL_AB, FR_CHANNEL_B}, set at post-build in variant post-build / pre-compile in variant pre-compile  # Channels to which the node is connected. | Implementation Type: Fr_ChannelType
        integer FrPClusterDriftDamping: 0..20, set at post-build in variant post-build / pre-compile in variant pre-compile  # Local cluster drift damping factor used for rate correction [Microticks]. | Remark: Upper limit 10 for FlexRay Protocol 3.0 compliance.
        integer FrPDecodingCorrection: 12..143, set at post-build in variant post-build / pre-compile in variant pre-compile  # Value used by the receiver to calculate the difference between primary time reference point and secondary time reference point [Microticks]. | Remark: Lower limit 14 for FlexRay Protocol 2.1 Rev. A compliance. Upper limit 136 for FlexRay Protocol 3.0 compliance.
        integer FrPDelayCompensationA: 0..211, set at post-build in variant post-build / pre-compile in variant pre-compile  # Value used to compensate for reception delays on the indicated channel. This covers assumed propagation delay up to cPropagationDelayMax for microticks in the range of 0.0125us to 0.05us [Microticks]. | Remark: Lower limit 4 for FlexRay Protocol 3.0 compliance. Remark: Upper limit 200 for FlexRay Protocol 2.1 Rev A compliance.
        integer FrPDelayCompensationB: 0..211, set at post-build in variant post-build / pre-compile in variant pre-compile  # Value used to compensate for reception delays on the indicated channel. This covers assumed propagation delay up to cPropagationDelayMax for microticks in the range of 0.0125us to 0.05us [Microticks]. | Remark: Lower limit 4 for FlexRay Protocol 3.0 compliance. Remark: Upper limit 200 for FlexRay Protocol 2.1 Rev A compliance.
        boolean FrPExternalSync: set at post-build in variant post-build / pre-compile in variant pre-compile  # Flag indicating whether the node is externally synchronized (operating as time gateway sink in an TT-E cluster) or locally synchronized. | If FrPExternalSync is set to 'true' then FrPTwoKeySlotMode must also be set to 'true'. Remarks: Set to 'false' for FlexRay Protocol 2.1 Rev. A compliance.
        boolean FrPFallBackInternal: set at post-build in variant post-build / pre-compile in variant pre-compile  # Flag indicating whether a time gateway sink node will switch to local clock operation when synchronization with the time gateway source node is lost (FrPFallBackInternal = true) or will instead go to POC:ready (FrPFallBackInternal =false). | Remarks: Set to 'false' for FlexRay Protocol 2.1 Rev. A compliance.
        integer FrPKeySlotId: 0..1023, set at post-build in variant post-build / pre-compile in variant pre-compile  # ID of the key slot, i.e., the slot used to transmit the startup frame, sync frame, or designated key slot frame. If this parameter is set to zero the node does not have a key slot.
        boolean FrPKeySlotOnlyEnabled: set at post-build in variant post-build / pre-compile in variant pre-compile  # Flag indicating whether or not the node shall enter key slot only mode following startup. | Remarks: This parameter maps to FlexRay Protocol 2.1 Rev. A parameter pSingleSlotEnabled.
        boolean FrPKeySlotUsedForStartup: set at post-build in variant post-build / pre-compile in variant pre-compile  # Flag indicating whether the key slot is used to transmit a startup frame. | If FrPKeySlotUsedForStartup is set to true then FrPKeySlotUsedForSync must also be set to true. If FrPTwoKeySlotMode is set to true then both FrPKeySlotUsedForSync and FrPKeySlotUsedForStartup must also be set to true.
        boolean FrPKeySlotUsedForSync: set at post-build in variant post-build / pre-compile in variant pre-compile  # Flag indicating whether the key slot is used to transmit a sync frame. | If FrPKeySlotUsedForStartup is set to true then FrPKeySlotUsedForSync must also be set to true. If FrPTwoKeySlotMode is set to true then both FrPKeySlotUsedForSync and FrPKeySlotUsedForStartup must also be set to true.
        integer FrPLatestTx: 0..7988, set at post-build in variant post-build / pre-compile in variant pre-compile  # Number of the last minislot in which a frame transmission can start in the dynamic segment. | Remark: Upper limit 7980 for FlexRay Protocol 2.1 Rev A compliance.
        integer FrPMacroInitialOffsetA: 2..68, set at post-build in variant post-build / pre-compile in variant pre-compile  # Integer number of macroticks between the static slot boundary and the following macrotick boundary of the secondary time reference point based on the nominal macrotick duration [Macroticks].
        integer FrPMacroInitialOffsetB: 2..68, set at post-build in variant post-build / pre-compile in variant pre-compile  # Integer number of macroticks between the static slot boundary and the following macrotick boundary of the secondary time reference point based on the nominal macrotick duration [Macroticks].
        integer FrPMicroInitialOffsetA: 0..239, set at post-build in variant post-build / pre-compile in variant pre-compile  # Number of microticks between the secondary time reference point | and the macrotick boundary immediately following the secondary time reference point. The parameter depends on FrPDelayCompensationA and therefore it has to be set independently for each channel [Microticks].
        integer FrPMicroInitialOffsetB: 0..239, set at post-build in variant post-build / pre-compile in variant pre-compile  # Number of microticks between the secondary time reference point | and the macrotick boundary immediately following the secondary time reference point. The parameter depends on FrPDelayCompensationB and therefore it has to be set independently for each channel [Microticks].
        integer FrPMicroPerCycle: 640..1280000, set at post-build in variant post-build / pre-compile in variant pre-compile  # Nominal number of microticks in the communication cycle of the local node. If nodes have different microtick durations this number will differ from node to node [Microticks]. | Remark: Lower limit 960 for FlexRay Protocol 3.0 compliance. Upper limit 640000 for FlexRay Protocol 2.1 Rev A compliance.
        boolean FrPNmVectorEarlyUpdate: set at post-build in variant post-build / pre-compile in variant pre-compile  # Flag indicating when the update of the Network Management Vector | in the CHI shall take place. If FrPNmVectorEarlyUpdate is set to false, the update shall take place after the NIT. If FrPNmVectorEarlyUpdate is set to true, the update shall take place after the end of the static segment. Remarks: Set to 'false' for FlexRay Protocol 2.1 Rev. A compliance.
        integer FrPOffsetCorrectionOut: 13..16082, set at post-build in variant post-build / pre-compile in variant pre-compile  # Magnitude of the maximum permissible offset correction value [Microticks]. Remark: Upper limit 15567 for FlexRay Protocol 2.1 Rev A compliance. Remark: Lower limit 15 for FlexRay Protocol 3.0 compliance.
        integer FrPOffsetCorrectionStart: 7..15999, set at post-build in variant post-build / pre-compile in variant pre-compile  # Start of the offset correction phase within the NIT, expressed as the number of macroticks from the start of cycle [Macroticks]. | Remark: This parameter maps to FlexRay Protocol 2.1 Rev. A parameter gOffsetCorrectionStart. Remark: Lower limit 9 for FlexRay Protocol 2.1 Rev A compliance.
        integer FrPPayloadLengthDynMax: 0..127, set at post-build in variant post-build / pre-compile in variant pre-compile  # Maximum payload length for dynamic frames [16 bit words].
        integer FrPRateCorrectionOut: 2..3846, set at post-build in variant post-build / pre-compile in variant pre-compile  # Magnitude of the maximum permissible rate correction value and the maximum drift offset between two nodes operating with unsynchronized clocks for one communication cycle [Microticks]. | Remarks: This parameter maps to FlexRay Protocol 2.1 Rev. A parameter pdMaxDrift. Lower limit 3 for FlexRay Protocol 3.0 compliance. Upper limit 1923 for FlexRay Protocol 2.1 Rev A compliance.
        enumeration FrPSamplesPerMicrotick: {N1SAMPLES, N2SAMPLES, N4SAMPLES}, set at post-build in variant post-build / pre-compile in variant pre-compile  # Number of samples per microtick. Remark: Allowed range N1SAMPLES, N2SAMPLES for FlexRay Protocol 3.0 compliance.
        integer FrPSecondKeySlotId: 0..1023, set at post-build in variant post-build / pre-compile in variant pre-compile  # ID of the second key slot, in which a second startup frame shall be sent when operating as a coldstart node in a TT-L or TT-D cluster. If this parameter is set to zero the node does not have a second key slot. | Remark: Set to 0 for FlexRay Protocol 2.1 Rev A compliance.
        boolean FrPTwoKeySlotMode: set at post-build in variant post-build / pre-compile in variant pre-compile  # Flag indicating whether node operates as a coldstart node in a TT-E or TT-L cluster. | If pTwoKeySlotMode is set to true then both pKeySlotUsedForSync and pKeySlotUsedForStartup must also be set to true. If pExternalSync is set to true then pTwoKeySlotMode must also be set to true. Remark: Set to false for FlexRay Protocol 2.1 Rev A compliance.
        enumeration FrPWakeupChannel: {FR_CHANNEL_A, FR_CHANNEL_B}, set at post-build in variant post-build / pre-compile in variant pre-compile  # Channel used by the node to send a wakeup pattern. | FrPWakeupChannel must be selected from among the channels configured by FrPChannels.
        integer FrPWakeupPattern: 0..63, set at post-build in variant post-build / pre-compile in variant pre-compile  # Number of repetitions of the wakeup symbol that are combined to form a wakeup pattern when the node enters the POC:wakeup send state. | Remark: Lower limit 2 for FlexRay Protocol 2.1 Rev A compliance.
        integer FrPdAcceptedStartupRange: 0..2743, set at post-build in variant post-build / pre-compile in variant pre-compile  # Expanded range of measured clock deviation allowed for startup frames during integration [Microticks]. | Remark: Upper limit 1875 for FlexRay Protocol 2.1 Rev A compliance. Remark: Lower limit 29 for FlexRay Protocol 3.0 compliance.
        integer FrPdListenTimeout: 1284..2567692, set at post-build in variant post-build / pre-compile in variant pre-compile  # Value for the startup listen timeout and wakeup listen timeout. Although this is a node local parameter, the real time equivalent of this value should be the same for all nodes in the cluster [Microticks]. | Remark: Lower limit 1926 for FlexRay Protocol 3.0 compliance. Upper limit 1283846 for FlexRay Protocol 2.1 Rev. A compliance.
        enumeration FrPdMicrotick: {T100NS, T12_5NS, T25NS, T50NS}, set at post-build in variant post-build / pre-compile in variant pre-compile  # Duration of a microtick. | Remark: Allowed range T12_5NS, T25NS, T50NS for FlexRay Protocol 3.0 compliance.
        container FrAbsoluteTimer [1..*]  # Specifies the absolute timer configuration parameters of the Fr.
          integer FrAbsTimerIdx: 0..254, set at post-build in variant post-build / pre-compile in variant pre-compile, symbolic-name-value=true  # Contains the index of an absolute timer contained in Fr on a certain FlexRay CC.
        container FrControllerDemEventParameterRefs [0..1]  # Container for the references to DemEventParameter elements which shall be invoked using the API Dem_ReportErrorStatus API in case the corresponding error occurs. The EventId is taken from the referenced DemEventParameter's DemEventId value. The standardized errors are provided in the container and can be extended by vendor specific error references.
          symbolic name reference FrDemCtrlTestResultRef [0..1]: set at post-build in variant post-build / pre-compile in variant pre-compile, destination=DemEventParameter  # Reference to DEM event Id that is reported for FlexRay | controller hardware test failure. If this parameter is not configured, no event reporting happens.
        container FrFifo [0..*]  # One First In First Out (FIFO) queued receive structure, defining the admittance criteria to the FIFO, and mandating the ability to admit messages into the FIFO based on Message Id filtering criteria.
          boolean FrAdmitWithoutMessageId: set at post-build in variant post-build / pre-compile in variant pre-compile  # Determines whether or not frames received in the dynamic segment that don't contain a message ID will be admitted into the FIFO.
          integer FrBaseCycle: 0..63, set at post-build in variant post-build / pre-compile in variant pre-compile  # FIFO cycle counter acceptance criteria.
          enumeration FrChannels: {FR_CHANNEL_A, FR_CHANNEL_AB, FR_CHANNEL_B}, set at post-build in variant post-build / pre-compile in variant pre-compile  # FIFO channel admittance criteria.
          integer FrCycleRepetition: 1..64, set at post-build in variant post-build / pre-compile in variant pre-compile  # FIFO cylce counter acceptance criteria. Valid values are 1,2,4,5,8,10,16,20,32,40,50,64. | Remark: Values 1,2,4,8,16,32,64 are valid only for FlexRay Protocol 2.1 Rev A compliance.
          integer FrFifoDepth: 1..2048, set at post-build in variant post-build / pre-compile in variant pre-compile  # Fifo Depth.
          integer FrMsgIdMask: 0..65535, set at post-build in variant post-build / pre-compile in variant pre-compile  # FIFO message identifier acceptance criteria (Mask filter).
          integer FrMsgIdMatch: 0..65535, set at post-build in variant post-build / pre-compile in variant pre-compile  # FIFO message identifier acceptance criteria (Match filter).
          container FrRange [1..*]  # FIFO Frame Id range acceptance criteria.
            integer FrRangeMax: 0..2047, set at post-build in variant post-build / pre-compile in variant pre-compile  # Last FrameId of this range that will be accepted by the FIFO.
            integer FrRangeMin: 0..2047, set at post-build in variant post-build / pre-compile in variant pre-compile  # First FrameId of this range that will be accepted by the FIFO.
  module definition FrArTp [0..1]: variants post-build/pre-compile  # Configuration of the FrArTp (FlexRay Transport Protocol) module.
    container FrArTpGeneral  # This container contains the general configuration (parameters) of the FlexRay TP.
      integer FrArTpChanNum: 1..32, set at pre-compile  # Preprocessor switch for defining the number of concurrent channels the module supports. Up to 32 channels shall be definable here.
      boolean FrArTpDevErrorDetect: set at pre-compile  # Preprocessor switch for enabling development error detection.
      boolean FrArTpHaveAckRt: set at pre-compile  # Preprocessor switch for enabling the Acknowledgement and retry mechanisms.
      boolean FrArTpHaveGrpSeg: set at pre-compile  # Preprocessor switch for enabling segmentation of 1:n messages.
      boolean FrArTpHaveLm: set at pre-compile  # Preprocessor switch for enabling the mechanism for message longer than allowed by.
      boolean FrArTpHaveTc: set at pre-compile  # Preprocessor switch for enabling Transmit Cancellation.
      float FrArTpMainFuncCycle: 0..1.024, set at post-build in variant post-build / pre-compile in variant pre-compile  # This parameter contains the calling period of the TPs Main Function. The parameter is specified in seconds.
      boolean FrArTpVersionInfoApi: set at pre-compile  # Preprocessor switch for enabling the Version info API.
    container FrArTpMultipleConfig: multiple-configuration-container=true  # This container holds one or several multiple configuration sets.
      container FrArTpChannel [1..*]  # This container contains the configuration (parameters) of one FlexRay TP channel.
        enumeration FrArTpAckType: {FRARTP_ACK_WITHOUT_RT, FRARTP_ACK_WITH_RT, FRARTP_NO}, set at post-build in variant post-build / pre-compile in variant pre-compile  # This parameter defines the type of acknowledgement which is used for the specific channel.
        enumeration FrArTpAdrType: {FRARTP_OB, FRARTP_TB}, set at post-build in variant post-build / pre-compile in variant pre-compile  # This parameter states the addressing type this connection has. The meanings of the values are one byte and two byte.
        integer FrArTpChannelId: 0..255, set at post-build in variant post-build / pre-compile in variant pre-compile, symbolic-name-value=true  # The Id of the channel.
        integer FrArTpConNum: 0..65536, set at post-build in variant post-build / pre-compile in variant pre-compile  # This parameter states the number of connections used in this channel. At least 256 shall be configurable here.
        boolean FrArTpGrpSeg: set at post-build in variant post-build / pre-compile in variant pre-compile  # Here can be specified, whether segmentation within a 1:n connection is allowed or not.
        enumeration FrArTpLm: {FRARTP_ISO, FRARTP_ISO6, FRARTP_L4G}, set at post-build in variant post-build / pre-compile in variant pre-compile  # This specifies the maximum message length for the particular channel.
        integer FrArTpMaxAr: 0..255, set at post-build in variant post-build / pre-compile in variant pre-compile  # This parameter defines the maximum number of trying to send a frame when a TIMEOUT AR occurs (depending on whether retry is configured).
        integer FrArTpMaxAs: 0..255, set at post-build in variant post-build / pre-compile in variant pre-compile  # This parameter defines the maximum number of trying t osend a frame when a TIMEOUT AS occurs (depending on whether retry is configured)
        integer FrArTpMaxBs: 0..255, set at post-build in variant post-build / pre-compile in variant pre-compile  # This parameter defines number of consecutive CFs between two FCs (block size). Valid values are 1 .. 16 when retry is activated, and 0 .. 255 otherwise.
        integer FrArTpMaxBufReq: 0..255, set at post-build in variant post-build / pre-compile in variant pre-compile  # This parameter defines the maximum number of times the FrArTp should send a wait frame FC(WT). It is also used to limit the number of retries for PduR_FrArTpCopyTxData and PduR_FrArTpCopyRxData when no timer is active.
        integer FrArTpMaxFrIf: 0..255, set at post-build in variant post-build / pre-compile in variant pre-compile  # This parameter defines the maximum number of trying to send a frame when the FrIf returns an error.
        integer FrArTpMaxRn: 0..255, set at post-build in variant post-build / pre-compile in variant pre-compile  # This parameter defines the maximum number of retries (if retry is configured for the particular channel).
        float FrArTpStMin: 0..1, set at post-build in variant post-build / pre-compile in variant pre-compile  # This parameter defines the minimum amount of time between two succeeding CFs in seconds. Valid values are 0, 100µs, 200µs .. 900µs, 1ms, 2ms .. 127ms. The value can be changed at runtime using the FrArTp_ChangeParameter interface.
        boolean FrArTpTc: set at post-build in variant post-build / pre-compile in variant pre-compile  # With this switch Transmit Cancellation can be turned on or off for this channel.
        float FrArTpTimeBr: 0..65.535, set at pre-compile  # This parameter defines the time in seconds between receiving the last CF of a block or an FF-x (or SF-x) and sending out an FC or AF. | It is obvious that FRARTP_TIME_BR + FRARTP_TIMEOUT_AR < FRARTP_TIMEOUT_BS must hold (because the transmission duration on the bus has also to be considered). This parameter is defined in ISO 15765-2. It is contained in the configuration as a performance requirement.
        float FrArTpTimeBuffer: 0..0.255, set at post-build in variant post-build / pre-compile in variant pre-compile  # This parameter defines the time in seconds of waiting for the next try (if retry is activated) to get a Tx or Rx buffer.
        float FrArTpTimeCs: 0..65.535, set at pre-compile  # This parameter defines the time in seconds between the sending of two consecutive CFs or between reception of an FC or AF and sending of the next CF . It is obvious that FRARTP_TIME_CS + FRARTP_TIMEOUT_AS < FRARTP_TIMEOUT_CR must hold (because the transmission duration on the bus has also to be considered). This parameter is defined in ISO 15765-2. It is contained in the configuration as a performance requirement.
        float FrArTpTimeFrIf: 0..0.255, set at post-build in variant post-build / pre-compile in variant pre-compile  # This parameter defines the time in seconds of waiting for the next try (if retry is activated) to send via FrIf_Transmit.
        float FrArTpTimeoutAr: 0..65.535, set at post-build in variant post-build / pre-compile in variant pre-compile  # This parameter states the timeout in seconds between the PDU transmit request of the Transport Layer to the FlexRay Interface and the corresponding confirmation of the FlexRay Interface on the receiver side (for FC or AF).
        float FrArTpTimeoutAs: 0..65.535, set at post-build in variant post-build / pre-compile in variant pre-compile  # This parameter states the timeout in seconds between the PDU transmit request for the first PDU of the group used in the current connection of the Transport Layer to the FlexRay Interface and the corresponding confirmation of the FlexRay Interface (when having sent the last PDU of the | group used in this connection) on the sender side (SF-x, FF-x, CF).
        float FrArTpTimeoutBs: 0..65.535, set at post-build in variant post-build / pre-compile in variant pre-compile  # This parameter defines the timeout in seconds for waiting for an FC or AF on the sender side in a 1:1 connection.
        float FrArTpTimeoutCr: 0..65.535, set at post-build in variant post-build / pre-compile in variant pre-compile  # This parameter defines the timeout value in seconds for waiting for a CF or FF-x (in case of retry) after receiving the last CF or after sending an FC or AF on the receiver side.
        boolean FrArTpUsePduFc: set at post-build in variant post-build / pre-compile in variant pre-compile  # This switch defines, whether within this channel the dedicated FC/ACK PDU (FrArTpPduFc) shall be used or not. If this is not used FC / ACK frames are sent using the normal IDs, otherwise only FrArTpPduFc shall be used for sending / receiving FC / ACK frames.
        container FrArTpConnection [1..*]  # This container contains the configuration (parameters) of one FlexRay TP connection. | A connection can only belong to one channel.
          integer FrArTpLa: 0..65535, set at post-build in variant post-build / pre-compile in variant pre-compile  # This parameter defines the Local Address for the respective connection. | When the local instance is the sender, this is the Source Address within the TP frame. When the local instance is the receiver, this is the Target Address within the TP frame. Note that in case of 1 byte addressing only the values from 0x0000 - 0x00FF are valid.
          boolean FrArTpMultRec: set at post-build in variant post-build / pre-compile in variant pre-compile  # This parameter defines, whether this connection is an 1:1 ('false') or an 1:n ('true') connection. | Of course, if the channel to which the connection is configured has retry or acknowledgement enabled, no retry or acknowledgement will occur in case the connection is an 1:n connection.
          integer FrArTpRa: 0..65535, set at post-build in variant post-build / pre-compile in variant pre-compile  # This parameter defines the Remote Address for the respective connection. | When the local instance is the sender, this is the Target Address within the TP frame. When the local instance is the receiver, this is the Source Address within the TP frame. Note that in case of 1 byte addressing only the values from 0x0000 - 0x00FF are valid.
          reference FrArTpConPduRef [1..*]: set at post-build in variant post-build / pre-compile in variant pre-compile, destination=FrArTpPdu  # Each value defines a PDU to be used for this connection. Thus each value is a PDU-ID given in FrArTpPdu and this array cannot be longer than the array FrArTpPdu. | Please note: Only PDUs of the same size shall be used within a connection. Of course the PDU having the TxConfirmation configured has to be used by every connection.
          container FrArTpRxSdu [0..1]  # Describes the Rx SDU
            integer FrArTpSduRxId: 0..65536, set at post-build in variant post-build / pre-compile in variant pre-compile, symbolic-name-value=true  # This is a unique identifier for a received message. This Id is used in the CancelReceive API call. | ImplementationType: PduIdType
            reference FrArTpRxSduRef: set at post-build in variant post-build / pre-compile in variant pre-compile, destination=Pdu  # Reference to a PDU in the global PDU structure.
          container FrArTpTxSdu [0..1]  # Describes the Tx SDU
            integer FrArTpSduTxId: 0..65536, set at post-build in variant post-build / pre-compile in variant pre-compile, symbolic-name-value=true  # This is a unique identifier for a received or a to be transmitted message. With this (and by means of e.g. a lookup table) the PDU Router can route the message appropriately without dealing with the particularities of the Transport Layer. This parameter can also be seen as the identifier of a connection. | ImplementationType: PduIdType
            reference FrArTpTxSduRef: set at post-build in variant post-build / pre-compile in variant pre-compile, destination=Pdu  # Reference to a PDU in the global PDU structure.
        container FrArTpPdu [1..*]  # Container to hold the PDU parameters. | ImplementationType: PduInfoType
          enumeration FrArTpPduDirection: {FRARTP_RX, FRARTP_TX}, set at post-build in variant post-build / pre-compile in variant pre-compile  # This parameter defines the direction of the PDU.
          integer FrArTpPduId: 0..65536, set at post-build in variant post-build / pre-compile in variant pre-compile, symbolic-name-value=true  # This is the identifier of the FlexRay Interface PDUs (Fr N-PDU, Fr L-SDU) in which the Transport Layer Frames of this channel should be transmitted. | ImplementationType: PduIdType
          reference FrArTpPduRef: set at post-build in variant post-build / pre-compile in variant pre-compile, destination=Pdu
        container FrArTpPduFc [0..2]  # This is the identifier of the FlexRay Interface PDUs (Fr N-PDU, Fr L-SDU) in which the Transport Layer Flow Control and Acknowledgement Frames of this channel should be transmitted. | ImplementationType: PduInfoType
          enumeration FrArTpPduFcDirection: {FRARTP_FC_RX, FRARTP_FC_TX}, set at post-build in variant post-build / pre-compile in variant pre-compile  # This parameter defines the direction of the PDU.
          integer FrArTpPduFcId: 0..65536, set at post-build in variant post-build / pre-compile in variant pre-compile, symbolic-name-value=true  # This is the identifier of the FlexRay Interface PDUs (Fr N-PDU, Fr L-SDU) in which the Transport Layer Flow Control and Acknowledgement Frames of this channel should be transmitted.
          reference FrArTpPduFcRef: set at post-build in variant post-build / pre-compile in variant pre-compile, destination=Pdu

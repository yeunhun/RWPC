AUTOSAR XML (schema 4-0-3)
package /Bsw_Os
  bsw implementation BswImplementation_Os: sw-version=1.0.0, vendor-id=76, ar-release-version=4.0.3, behavior=BswInternalBehavior_Os
  bsw module description Os: module-id=1
    bsw internal behavior BswInternalBehavior_Os
      bsw distinguished partition BswDistinguishedPartition_Os

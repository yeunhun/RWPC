AUTOSAR XML (schema 4-0-3)
package /ARPackage_Det/EcuConfiuration
  bsw module entry Det_ReportError: service-id=1, is-reentrant=false, is-synchronous=false, call-type=REGULAR, execution-context=UNSPECIFIED, sw-service-impl-policy=STANDARD
  bsw module description Det: module-id=15
    bsw internal behavior BswInternalBehavior_Det
      exclusive area RAM_DATA_PROTECTION
      bsw called entity BswCalledEntity_Det: can-enter-exclusive-area=RAM_DATA_PROTECTION, implemented-entry=Det_ReportError
      bsw distinguished partition BswDistinguishedPartition_Det
  bsw implementation BswImplementation_Det: sw-version=1.0.0, vendor-id=76, ar-release-version=4.0.3, behavior=BswInternalBehavior_Det

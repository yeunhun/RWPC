AUTOSAR XML (schema 4-0-3)
package /TS_T32D3M1I0R0
  bsw implementation FeeImplementation: sw-version=1.0.25, vendor-id=66, ar-release-version=4.2.2, behavior=FeeBehavior
  16 x bsw module entry, all with execution-context=TASK, sw-service-impl-policy=STANDARD:
    Fee_Init: service-id=0, is-reentrant=false, is-synchronous=false, call-type=REGULAR
    Fee_SetMode: service-id=1, is-reentrant=false, is-synchronous=true, call-type=REGULAR
    Fee_Read: service-id=2, is-reentrant=false, is-synchronous=false, call-type=REGULAR
    Fee_Write: service-id=3, is-reentrant=false, is-synchronous=false, call-type=REGULAR
    Fee_Cancel: service-id=4, is-reentrant=false, is-synchronous=true, call-type=REGULAR
    Fee_GetStatus: service-id=5, is-reentrant=false, is-synchronous=true, call-type=REGULAR
    Fee_GetJobResult: service-id=6, is-reentrant=false, is-synchronous=true, call-type=REGULAR
    Fee_InvalidateBlock: service-id=7, is-reentrant=false, is-synchronous=false, call-type=REGULAR
    Fee_GetVersionInfo: service-id=8, is-reentrant=true, is-synchronous=true, call-type=REGULAR
    Fee_EraseImmediateBlock: service-id=9, is-reentrant=false, is-synchronous=false, call-type=REGULAR
    Fee_MainFunction: service-id=18, is-reentrant=false, is-synchronous=false, call-type=SCHEDULED
    Fee_Clear: service-id=48, is-reentrant=false, is-synchronous=false, call-type=REGULAR
    Fee_ClearEx: service-id=48, is-reentrant=false, is-synchronous=false, call-type=REGULAR
    Fee_GetRemainingPages: service-id=49, is-reentrant=false, is-synchronous=true, call-type=REGULAR
    Fee_GetRemainingPagesEx: service-id=49, is-reentrant=false, is-synchronous=true, call-type=REGULAR
    Fee_SetCycleMode: service-id=52, is-reentrant=true, is-synchronous=true, call-type=REGULAR
package /TS_T32D3M1I0R0/BswDescr
  bsw module description Fee: module-id=21
    bsw internal behavior FeeBehavior
      exclusive area FEE_EXCLUSIVE_AREA_0
      10 x bsw called entity:
        Fee_Init: can-enter-exclusive-area=FEE_EXCLUSIVE_AREA_0, implemented-entry=Fee_Init
        Fee_SetMode: can-enter-exclusive-area=FEE_EXCLUSIVE_AREA_0, implemented-entry=Fee_SetMode
        Fee_Read: can-enter-exclusive-area=FEE_EXCLUSIVE_AREA_0, implemented-entry=Fee_Read
        Fee_Write: can-enter-exclusive-area=FEE_EXCLUSIVE_AREA_0, implemented-entry=Fee_Write
        Fee_Cancel: can-enter-exclusive-area=FEE_EXCLUSIVE_AREA_0, implemented-entry=Fee_Cancel
        Fee_GetStatus: implemented-entry=Fee_GetStatus
        Fee_GetJobResult: implemented-entry=Fee_GetJobResult
        Fee_InvalidateBlock: can-enter-exclusive-area=FEE_EXCLUSIVE_AREA_0, implemented-entry=Fee_InvalidateBlock
        Fee_GetVersionInfo: implemented-entry=Fee_GetVersionInfo
        Fee_EraseImmediateBlock: can-enter-exclusive-area=FEE_EXCLUSIVE_AREA_0, implemented-entry=Fee_EraseImmediateBlock
      bsw schedulable entity Fee_MainFunction: minimum-start-interval=0.001, implemented-entry=Fee_MainFunction
      4 x bsw called entity:
        Fee_Clear: can-enter-exclusive-area=FEE_EXCLUSIVE_AREA_0, implemented-entry=Fee_Clear
        Fee_ClearEx: can-enter-exclusive-area=FEE_EXCLUSIVE_AREA_0, implemented-entry=Fee_ClearEx
        Fee_GetRemainingPages: implemented-entry=Fee_GetRemainingPages
        Fee_GetRemainingPagesEx: implemented-entry=Fee_GetRemainingPagesEx
      bsw distinguished partition BswDistinguishedPartition_Fee

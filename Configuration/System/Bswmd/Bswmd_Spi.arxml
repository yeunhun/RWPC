AUTOSAR XML (schema 4-0-3)
package /TS_T40D13M1I0R0
  bsw implementation SpiImplementation: sw-version=1.11.0, vendor-id=66, ar-release-version=4.2.2, behavior=SpiBehavior
  17 x bsw module entry, all with execution-context=TASK, sw-service-impl-policy=STANDARD:
    Spi_Init: service-id=0, is-reentrant=false, is-synchronous=true, call-type=REGULAR
    Spi_DeInit: service-id=1, is-reentrant=false, is-synchronous=true, call-type=REGULAR
    Spi_WriteIB: service-id=2, is-reentrant=true, is-synchronous=true, call-type=REGULAR
    Spi_AsyncTransmit: service-id=3, is-reentrant=true, is-synchronous=false, call-type=REGULAR
    Spi_ReadIB: service-id=4, is-reentrant=true, is-synchronous=true, call-type=REGULAR
    Spi_SetupEB: service-id=5, is-reentrant=true, is-synchronous=true, call-type=REGULAR
    Spi_GetStatus: service-id=6, is-reentrant=true, is-synchronous=true, call-type=REGULAR
    Spi_GetJobResult: service-id=7, is-reentrant=true, is-synchronous=true, call-type=REGULAR
    Spi_GetSequenceResult: service-id=8, is-reentrant=true, is-synchronous=true, call-type=REGULAR
    Spi_GetVersionInfo: service-id=9, is-reentrant=true, is-synchronous=true, call-type=REGULAR
    Spi_SyncTransmit: service-id=10, is-reentrant=true, is-synchronous=false, call-type=REGULAR
    Spi_GetHWUnitStatus: service-id=11, is-reentrant=true, is-synchronous=true, call-type=REGULAR
    Spi_Cancel: service-id=12, is-reentrant=true, is-synchronous=false, call-type=REGULAR
    Spi_SetAsyncMode: service-id=13, is-reentrant=false, is-synchronous=true, call-type=REGULAR
    Spi_MainFunction_Handling: service-id=16, is-reentrant=false, is-synchronous=true, call-type=SCHEDULED
    Spi_GetBufferStatus: service-id=65, is-reentrant=true, is-synchronous=true, call-type=REGULAR
    Spi_Terminate: service-id=67, is-reentrant=true, is-synchronous=false, call-type=REGULAR
package /TS_T40D13M1I0R0/BswDescr
  bsw module description Spi: module-id=83
    bsw internal behavior SpiBehavior
      exclusive area SPI_EXCLUSIVE_AREA_0
      14 x bsw called entity:
        Spi_Init: implemented-entry=Spi_Init
        Spi_DeInit: can-enter-exclusive-area=SPI_EXCLUSIVE_AREA_0, implemented-entry=Spi_DeInit
        Spi_WriteIB: can-enter-exclusive-area=SPI_EXCLUSIVE_AREA_0, implemented-entry=Spi_WriteIB
        Spi_AsyncTransmit: can-enter-exclusive-area=SPI_EXCLUSIVE_AREA_0, implemented-entry=Spi_AsyncTransmit
        Spi_ReadIB: can-enter-exclusive-area=SPI_EXCLUSIVE_AREA_0, implemented-entry=Spi_ReadIB
        Spi_SetupEB: can-enter-exclusive-area=SPI_EXCLUSIVE_AREA_0, implemented-entry=Spi_SetupEB
        Spi_GetStatus: implemented-entry=Spi_GetStatus
        Spi_GetJobResult: implemented-entry=Spi_GetJobResult
        Spi_GetSequenceResult: implemented-entry=Spi_GetSequenceResult
        Spi_GetVersionInfo: implemented-entry=Spi_GetVersionInfo
        Spi_SyncTransmit: can-enter-exclusive-area=SPI_EXCLUSIVE_AREA_0, implemented-entry=Spi_SyncTransmit
        Spi_GetHWUnitStatus: implemented-entry=Spi_GetHWUnitStatus
        Spi_Cancel: can-enter-exclusive-area=SPI_EXCLUSIVE_AREA_0, implemented-entry=Spi_Cancel
        Spi_SetAsyncMode: can-enter-exclusive-area=SPI_EXCLUSIVE_AREA_0, implemented-entry=Spi_SetAsyncMode
      bsw schedulable entity Spi_MainFunction_Handling: can-enter-exclusive-area=SPI_EXCLUSIVE_AREA_0, minimum-start-interval=0.001, implemented-entry=Spi_MainFunction_Handling
      bsw called entity Spi_GetBufferStatus: implemented-entry=Spi_GetBufferStatus
      bsw called entity Spi_Terminate: can-enter-exclusive-area=SPI_EXCLUSIVE_AREA_0, implemented-entry=Spi_Terminate
      bsw distinguished partition BswDistinguishedPartition_Spi

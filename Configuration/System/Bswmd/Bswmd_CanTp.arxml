AUTOSAR XML (schema 4-0-3)
package /Bsw_CanTp
  bsw implementation BswImplementation_CanTp: sw-version=1.11.2, swc-bsw-mapping=SwcBswMapping_CanTp, vendor-id=76, ar-release-version=4.0.3, behavior=BswInternalBehavior_CanTp
  bsw module description CanTp: module-id=35
    bsw module dependency BswModuleDependency0: target-module-id=60, required-entrys=CanIf_SetPduMode
    bsw internal behavior BswInternalBehavior_CanTp
      exclusive area TIMER_PROTECTION
      bsw schedulable entity BswSE_CanTp_MainFunction: can-enter-exclusive-area=TIMER_PROTECTION, implemented-entry=CanTp_MainFunction
      bsw timing event BswTE_CanTp_MainFunction: starts-on-event=BswSE_CanTp_MainFunction, period=0.005
      bsw distinguished partition BswDistinguishedPartition_CanTp
  bsw module entry CanTp_MainFunction: service-id=6, is-reentrant=false, is-synchronous=false, call-type=SCHEDULED, execution-context=TASK, sw-service-impl-policy=STANDARD
  swc bsw mapping SwcBswMapping_CanTp: bsw-behavior=BswInternalBehavior_CanTp, swc-behavior=SwcIB_CanTp

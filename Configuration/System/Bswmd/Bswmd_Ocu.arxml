AUTOSAR XML (schema 4-0-3)
package /TS_T40D13M1I0R0
  bsw implementation OcuImplementation: sw-version=1.6.0, vendor-id=66, ar-release-version=4.2.2, behavior=OcuBehavior
  bsw module entry Ocu_EnterCriticalSection: service-id=1, is-reentrant=false, is-synchronous=true, call-type=REGULAR, execution-context=TASK, sw-service-impl-policy=STANDARD
package /TS_T40D13M1I0R0/BswDescr
  bsw module description Ocu: module-id=102
    bsw internal behavior OcuBehavior
      exclusive area OCU_EXCLUSIVE_AREA_0
      bsw called entity Ocu_EnterCriticalSection: can-enter-exclusive-area=OCU_EXCLUSIVE_AREA_0, implemented-entry=Ocu_EnterCriticalSection
      bsw distinguished partition BswDistinguishedPartition_Ocu

AUTOSAR XML (schema 4-0-3)
package /TS_T40D13M1I0R0
  bsw implementation FlsImplementation: programming-language=C, sw-version=1.10.0, vendor-id=66, ar-release-version=4.2.2, behavior=FlsBehavior, vendor-specific-module-def=Fls
  12 x bsw module entry, all with execution-context=TASK, sw-service-impl-policy=STANDARD:
    Fls_Init: service-id=0, is-reentrant=false, is-synchronous=true, call-type=REGULAR
    Fls_Erase: service-id=1, is-reentrant=false, is-synchronous=false, call-type=REGULAR
    Fls_Write: service-id=2, is-reentrant=false, is-synchronous=false, call-type=REGULAR
    Fls_Cancel: service-id=3, is-reentrant=false, is-synchronous=true, call-type=REGULAR
    Fls_GetStatus: service-id=4, is-reentrant=true, is-synchronous=true, call-type=REGULAR
    Fls_GetJobResult: service-id=5, is-reentrant=true, is-synchronous=true, call-type=REGULAR
    Fls_Read: service-id=7, is-reentrant=false, is-synchronous=false, call-type=REGULAR
    Fls_Compare: service-id=8, is-reentrant=false, is-synchronous=false, call-type=REGULAR
    Fls_SetMode: service-id=9, is-reentrant=false, is-synchronous=true, call-type=REGULAR
    Fls_GetVersionInfo: service-id=16, is-reentrant=true, is-synchronous=true, call-type=REGULAR
    Fls_GetStatusSub: is-reentrant=false, is-synchronous=true, call-type=REGULAR
    Fls_MainFunction: service-id=6, is-reentrant=false, is-synchronous=false, call-type=SCHEDULED
package /TS_T40D13M1I0R0/BswDescr
  bsw module description Fls: module-id=92
    bsw internal behavior FlsBehavior
      exclusive area FLS_EXCLUSIVE_AREA_0
      bsw schedulable entity Fls_MainFunction: can-enter-exclusive-area=FLS_EXCLUSIVE_AREA_0, minimum-start-interval=0.001, implemented-entry=Fls_MainFunction
      11 x bsw called entity:
        Fls_Init: implemented-entry=Fls_Init
        Fls_Cancel: can-enter-exclusive-area=FLS_EXCLUSIVE_AREA_0, implemented-entry=Fls_Cancel
        Fls_GetStatus: implemented-entry=Fls_GetStatus
        Fls_GetJobResult: implemented-entry=Fls_GetJobResult
        Fls_Compare: can-enter-exclusive-area=FLS_EXCLUSIVE_AREA_0, implemented-entry=Fls_Compare
        Fls_Erase: can-enter-exclusive-area=FLS_EXCLUSIVE_AREA_0, implemented-entry=Fls_Erase
        Fls_Read: can-enter-exclusive-area=FLS_EXCLUSIVE_AREA_0, implemented-entry=Fls_Read
        Fls_SetMode: can-enter-exclusive-area=FLS_EXCLUSIVE_AREA_0, implemented-entry=Fls_SetMode
        Fls_GetVersionInfo: implemented-entry=Fls_GetVersionInfo
        Fls_GetStatusSub: implemented-entry=Fls_GetStatusSub
        Fls_Write: can-enter-exclusive-area=FLS_EXCLUSIVE_AREA_0, implemented-entry=Fls_Write
      bsw distinguished partition BswDistinguishedPartition_Fls

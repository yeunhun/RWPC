AUTOSAR XML (schema 4-0-3)
package /Bsw_CanTrcv_255_Autron
  bsw implementation BswImplementation_CanTrcv_255_Autron: sw-version=1.5.0, vendor-id=255, ar-release-version=4.0.3, behavior=BswInternalBehavior, vendor-api-infix=Autron
  bsw module entry CanTrcv_255_Autron_Init: service-id=0, is-reentrant=false, is-synchronous=false, call-type=REGULAR, execution-context=UNSPECIFIED, sw-service-impl-policy=STANDARD
  bsw module description CanTrcv_255_Autron: module-id=255
    bsw internal behavior BswInternalBehavior
      exclusive area INTERRUPT_PROTECTION_AREA
      bsw called entity BswCalledEntity_CANTRCV_SETOPMODE_MACRO: can-enter-exclusive-area=INTERRUPT_PROTECTION_AREA, implemented-entry=CanTrcv_255_Autron_Init
      bsw distinguished partition BswDistinguishedPartition_CanTrcv

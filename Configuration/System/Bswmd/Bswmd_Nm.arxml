AUTOSAR XML (schema 4-0-3)
package /ArPackage_Nm
  bsw module description Nm: module-id=29
    bsw internal behavior BswInternalBehavior_Nm
      exclusive area UPDATE_NETWORK_STATUS_NW0
      exclusive area UPDATE_NETWORK_STATUS_NW1
      bsw schedulable entity BswSE_Nm_MainFunction: can-enter-exclusive-area=[UPDATE_NETWORK_STATUS_NW0, UPDATE_NETWORK_STATUS_NW1], implemented-entry=Nm_MainFunction
      bsw distinguished partition BswDistinguishedPartition_Nm
  bsw implementation BswImplementation_Nm: sw-version=2.3.0, vendor-id=76, ar-release-version=4.0.3, behavior=BswInternalBehavior_Nm
  bsw module entry Nm_MainFunction: service-id=16, is-reentrant=false, is-synchronous=false, call-type=SCHEDULED, execution-context=TASK, sw-service-impl-policy=STANDARD

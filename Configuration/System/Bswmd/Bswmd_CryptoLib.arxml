AUTOSAR XML (schema 4-3-0)
package /Bsw_CryptoLib
  bsw implementation BswImplementation_CryptoLib: programming-language=C, sw-version=3.4.0, vendor-id=76, ar-release-version=4.0.3, behavior=BswInternalBehavior_CryptoLib
  bsw module description CryptoLib: category=LIBRARY, module-id=76
    bsw internal behavior BswInternalBehavior_CryptoLib
      bsw distinguished partition BswDistinguishedPartition_CryptoLib

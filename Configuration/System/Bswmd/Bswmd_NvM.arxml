AUTOSAR XML (schema 4-0-3)
package /Bsw_NvM
  bsw implementation BswImplementation_NvM: programming-language=C, sw-version=1.5.3, swc-bsw-mapping=SwcBswMapping_NvM, vendor-id=76, ar-release-version=4.0.3, behavior=BswInternalBehavior_NvM, vendor-specific-module-def=NvM
  bsw module description NvM: module-id=20
    bsw internal behavior BswInternalBehavior_NvM
      exclusive area RAM_INDEX
      exclusive area RAM_STATUS_PROTECTION
      bsw schedulable entity BswSE_NvM_MainFunction: can-enter-exclusive-area=[RAM_INDEX, RAM_STATUS_PROTECTION], implemented-entry=NvM_MainFunction
      bsw distinguished partition BswDistinguishedPartition_NvM
  bsw module entry NvM_MainFunction: service-id=14, is-reentrant=false, is-synchronous=false, call-type=SCHEDULED, execution-context=TASK, sw-service-impl-policy=STANDARD

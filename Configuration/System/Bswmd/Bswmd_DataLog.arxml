AUTOSAR XML (schema 4-0-3)
package /CDD_DataLog
  bsw module description DataLog: module-id=255
    provided-entrys:
      DataLog_MainFunction
      DataLog_SetCustomData
      DataLog_SetSleepConditionLog
      DataLog_SetSleepOKLog
      DataLog_SetWakeupEventLog
    bsw module dependency BswModuleDependency_Dem: target-module-id=54
    required-mode-groups:
      mode declaration group prototype DataLog_EM_R: type=EcuMode
    bsw internal behavior BswInternalBehavior_DataLog: included-data-type-set=data-type=[DataLog_DelayCountType, DataLog_DataSizeType], bsw-mode-receiver-policy{enhanced-mode-api=true, required-mode-group=DataLog_EM_R, supports-asynchronous-mode-switch=true}
      exclusive area DATA_PROTECTION
      bsw schedulable entity BswSE_DataLog_MainFunction: can-enter-exclusive-area=DATA_PROTECTION, implemented-entry=DataLog_MainFunction
      4 x bsw called entity:
        BswCE_DataLog_SetSleepConditionLog: implemented-entry=DataLog_SetSleepConditionLog
        BswCE_DataLog_SetSleepOKLog: implemented-entry=DataLog_SetSleepOKLog
        BswCE_DataLog_SetWakeupEventLog: implemented-entry=DataLog_SetWakeupEventLog
        BswCE_DataLog_SetCustomData: implemented-entry=DataLog_SetCustomData
      bsw timing event BswTE_DataLog_MainFunction: context-limitation=BswDistinguishedPartition_DataLog, starts-on-event=BswSE_DataLog_MainFunction, period=0.1
        disabled-in-mode:
          DataLog_EM_R.ECUM_STATE_STARTUP_ONE
          DataLog_EM_R.ECUM_STATE_STARTUP_TWO
          DataLog_EM_R.ECUM_STATE_STARTUP_THREE
      bsw distinguished partition BswDistinguishedPartition_DataLog
  bsw implementation BswImplementation_DataLog: sw-version=1.0.0, vendor-id=76, ar-release-version=4.0.3, behavior=BswInternalBehavior_DataLog
  5 x bsw module entry, all with execution-context=TASK, sw-service-impl-policy=STANDARD:
    DataLog_MainFunction: is-reentrant=false, is-synchronous=false, call-type=SCHEDULED
    DataLog_SetSleepOKLog: is-reentrant=false, is-synchronous=true, call-type=REGULAR
    DataLog_SetSleepConditionLog: is-reentrant=false, is-synchronous=true, call-type=REGULAR
    DataLog_SetWakeupEventLog: is-reentrant=false, is-synchronous=true, call-type=REGULAR
    DataLog_SetCustomData: is-reentrant=true, is-synchronous=false, call-type=REGULAR
      return type Std_ReturnType: category=TYPE_REFERENCE
      sw service arg customData: category=DATA_REFERENCE, direction=IN
      sw service arg customDataIndex: direction=IN
  impl type DataLog_DelayCountType: category=VALUE, base-type=uint32, compu {0=DATALOG_DELAY_ZERO, 5=DATALOG_DELAY_WAKEUP_LIMIT, 50=DATALOG_DELAY_SLEEP_LIMIT}
  bsw module entry DataLog_GetSleepSequence: is-reentrant=false, is-synchronous=true, call-type=REGULAR, execution-context=TASK, sw-service-impl-policy=STANDARD
    return type DataLog_SleepSeqType: category=TYPE_REFERENCE
  impl type DataLog_DataSizeType: category=VALUE, base-type=uint32, compu {6=DATALOG_DATA_BYTE_SIZE}
  bsw module entry DataLog_SetSleepSequence: is-reentrant=false, is-synchronous=true, call-type=REGULAR, execution-context=TASK, sw-service-impl-policy=STANDARD
    sw service arg seq: category=TYPE_REFERENCE, direction=IN

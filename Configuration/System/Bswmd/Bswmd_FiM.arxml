AUTOSAR XML (schema 4-0-3)
package /ARPackage_FiM/EcuConfiuration
  bsw module entry FiM_MainFunction: service-id=5, is-reentrant=false, is-synchronous=false, call-type=SCHEDULED, execution-context=TASK, sw-service-impl-policy=STANDARD
  bsw module description FiM: module-id=11
    required-mode-groups:
      mode declaration group prototype FiM_EM_R: type=EcuMode
    bsw internal behavior BswInternalBehavior_FiM
      exclusive area REQUEST_EVENTID_PROTECTION
      exclusive area REQUEST_FID_PROTECTION
      bsw schedulable entity BswSE_FiM_MainFunction: can-enter-exclusive-area=[REQUEST_EVENTID_PROTECTION, REQUEST_FID_PROTECTION], implemented-entry=FiM_MainFunction
      bsw distinguished partition BswDistinguishedPartition_FiM
  bsw implementation BswImplementation_FiM: sw-version=1.0.0, vendor-id=76, ar-release-version=4.0.3, behavior=BswInternalBehavior_FiM

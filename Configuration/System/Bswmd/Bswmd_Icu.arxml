AUTOSAR XML (schema 4-0-3)
package /TS_T40D13M1I0R0
  bsw implementation IcuImplementation: sw-version=1.10.0, vendor-id=66, ar-release-version=4.2.2, behavior=IcuBehavior
  37 x bsw module entry, all with sw-service-impl-policy=STANDARD:
    Icu_Init: service-id=0, is-reentrant=false, is-synchronous=true, call-type=REGULAR, execution-context=TASK
    Icu_DeInit: service-id=1, is-reentrant=false, is-synchronous=true, call-type=REGULAR, execution-context=TASK
    Icu_SetMode: service-id=2, is-reentrant=false, is-synchronous=true, call-type=REGULAR, execution-context=TASK
    Icu_DisableWakeup: service-id=3, is-reentrant=true, is-synchronous=true, call-type=REGULAR, execution-context=TASK
    Icu_EnableWakeup: service-id=4, is-reentrant=true, is-synchronous=true, call-type=REGULAR, execution-context=TASK
    Icu_SetActivationCondition: service-id=5, is-reentrant=true, is-synchronous=true, call-type=REGULAR, execution-context=TASK
    Icu_DisableNotification: service-id=6, is-reentrant=true, is-synchronous=true, call-type=REGULAR, execution-context=TASK
    Icu_EnableNotification: service-id=7, is-reentrant=true, is-synchronous=true, call-type=REGULAR, execution-context=TASK
    Icu_GetInputState: service-id=8, is-reentrant=true, is-synchronous=true, call-type=REGULAR, execution-context=TASK
    Icu_StartTimestamp: service-id=9, is-reentrant=true, is-synchronous=false, call-type=REGULAR, execution-context=TASK
    Icu_StopTimestamp: service-id=10, is-reentrant=true, is-synchronous=true, call-type=REGULAR, execution-context=TASK
    Icu_GetTimestampIndex: service-id=11, is-reentrant=true, is-synchronous=true, call-type=REGULAR, execution-context=TASK
    Icu_ResetEdgeCount: service-id=12, is-reentrant=true, is-synchronous=true, call-type=REGULAR, execution-context=TASK
    Icu_EnableEdgeCount: service-id=13, is-reentrant=true, is-synchronous=true, call-type=REGULAR, execution-context=TASK
    Icu_DisableEdgeCount: service-id=14, is-reentrant=true, is-synchronous=true, call-type=REGULAR, execution-context=TASK
    Icu_GetEdgeNumbers: service-id=15, is-reentrant=true, is-synchronous=true, call-type=REGULAR, execution-context=TASK
    Icu_GetTimeElapsed: service-id=16, is-reentrant=true, is-synchronous=true, call-type=REGULAR, execution-context=TASK
    Icu_GetDutyCycleValues: service-id=17, is-reentrant=true, is-synchronous=true, call-type=REGULAR, execution-context=TASK
    Icu_GetVersionInfo: service-id=18, is-reentrant=true, is-synchronous=true, call-type=REGULAR, execution-context=TASK
    Icu_StartSignalMeasurement: service-id=19, is-reentrant=true, is-synchronous=false, call-type=REGULAR, execution-context=TASK
    Icu_StopSignalMeasurement: service-id=20, is-reentrant=true, is-synchronous=true, call-type=REGULAR, execution-context=TASK
    Icu_CheckWakeup: service-id=21, is-reentrant=true, is-synchronous=true, call-type=REGULAR, execution-context=TASK
    Icu_EnableEdgeDetection: service-id=22, is-reentrant=true, is-synchronous=true, call-type=REGULAR, execution-context=TASK
    Icu_DisableEdgeDetection: service-id=23, is-reentrant=true, is-synchronous=true, call-type=REGULAR, execution-context=TASK
    Icu_CheckChannelStatus: service-id=255, is-reentrant=true, is-synchronous=true, call-type=REGULAR, execution-context=TASK
    ICU_ISR_Vector_24_CAT1: is-reentrant=false, is-synchronous=true, call-type=INTERRUPT, execution-context=INTERRUPT-CAT-1
    ICU_ISR_Vector_24_CAT2: is-reentrant=false, is-synchronous=true, call-type=INTERRUPT, execution-context=INTERRUPT-CAT-2
    ICU_ISR_Vector_25_CAT1: is-reentrant=false, is-synchronous=true, call-type=INTERRUPT, execution-context=INTERRUPT-CAT-1
    ICU_ISR_Vector_25_CAT2: is-reentrant=false, is-synchronous=true, call-type=INTERRUPT, execution-context=INTERRUPT-CAT-2
    ICU_ISR_Vector_27_CAT1: is-reentrant=false, is-synchronous=true, call-type=INTERRUPT, execution-context=INTERRUPT-CAT-1
    ICU_ISR_Vector_27_CAT2: is-reentrant=false, is-synchronous=true, call-type=INTERRUPT, execution-context=INTERRUPT-CAT-2
    ICU_ISR_Vector_29_CAT1: is-reentrant=false, is-synchronous=true, call-type=INTERRUPT, execution-context=INTERRUPT-CAT-1
    ICU_ISR_Vector_29_CAT2: is-reentrant=false, is-synchronous=true, call-type=INTERRUPT, execution-context=INTERRUPT-CAT-2
    ICU_ISR_Vector_32_CAT1: is-reentrant=false, is-synchronous=true, call-type=INTERRUPT, execution-context=INTERRUPT-CAT-1
    ICU_ISR_Vector_32_CAT2: is-reentrant=false, is-synchronous=true, call-type=INTERRUPT, execution-context=INTERRUPT-CAT-2
    ICU_ISR_Vector_36_CAT1: is-reentrant=false, is-synchronous=true, call-type=INTERRUPT, execution-context=INTERRUPT-CAT-1
    ICU_ISR_Vector_36_CAT2: is-reentrant=false, is-synchronous=true, call-type=INTERRUPT, execution-context=INTERRUPT-CAT-2
package /TS_T40D13M1I0R0/BswDescr
  bsw module description Icu: module-id=122
    bsw internal behavior IcuBehavior
      exclusive area ICU_EXCLUSIVE_AREA_0
      25 x bsw called entity:
        Icu_Init: implemented-entry=Icu_Init
        Icu_DeInit: can-enter-exclusive-area=ICU_EXCLUSIVE_AREA_0, implemented-entry=Icu_DeInit
        Icu_SetMode: can-enter-exclusive-area=ICU_EXCLUSIVE_AREA_0, implemented-entry=Icu_SetMode
        Icu_DisableWakeup: can-enter-exclusive-area=ICU_EXCLUSIVE_AREA_0, implemented-entry=Icu_DisableWakeup
        Icu_EnableWakeup: can-enter-exclusive-area=ICU_EXCLUSIVE_AREA_0, implemented-entry=Icu_EnableWakeup
        Icu_SetActivationCondition: can-enter-exclusive-area=ICU_EXCLUSIVE_AREA_0, implemented-entry=Icu_SetActivationCondition
        Icu_DisableNotification: can-enter-exclusive-area=ICU_EXCLUSIVE_AREA_0, implemented-entry=Icu_DisableNotification
        Icu_EnableNotification: can-enter-exclusive-area=ICU_EXCLUSIVE_AREA_0, implemented-entry=Icu_EnableNotification
        Icu_GetInputState: can-enter-exclusive-area=ICU_EXCLUSIVE_AREA_0, implemented-entry=Icu_GetInputState
        Icu_StartTimestamp: can-enter-exclusive-area=ICU_EXCLUSIVE_AREA_0, implemented-entry=Icu_StartTimestamp
        Icu_StopTimestamp: can-enter-exclusive-area=ICU_EXCLUSIVE_AREA_0, implemented-entry=Icu_StopTimestamp
        Icu_GetTimestampIndex: implemented-entry=Icu_GetTimestampIndex
        Icu_ResetEdgeCount: implemented-entry=Icu_ResetEdgeCount
        Icu_EnableEdgeCount: can-enter-exclusive-area=ICU_EXCLUSIVE_AREA_0, implemented-entry=Icu_EnableEdgeCount
        Icu_DisableEdgeCount: can-enter-exclusive-area=ICU_EXCLUSIVE_AREA_0, implemented-entry=Icu_DisableEdgeCount
        Icu_GetEdgeNumbers: implemented-entry=Icu_GetEdgeNumbers
        Icu_GetTimeElapsed: can-enter-exclusive-area=ICU_EXCLUSIVE_AREA_0, implemented-entry=Icu_GetTimeElapsed
        Icu_GetDutyCycleValues: can-enter-exclusive-area=ICU_EXCLUSIVE_AREA_0, implemented-entry=Icu_GetDutyCycleValues
        Icu_GetVersionInfo: implemented-entry=Icu_GetVersionInfo
        Icu_StartSignalMeasurement: can-enter-exclusive-area=ICU_EXCLUSIVE_AREA_0, implemented-entry=Icu_StartSignalMeasurement
        Icu_StopSignalMeasurement: can-enter-exclusive-area=ICU_EXCLUSIVE_AREA_0, implemented-entry=Icu_StopSignalMeasurement
        Icu_CheckWakeup: can-enter-exclusive-area=ICU_EXCLUSIVE_AREA_0, implemented-entry=Icu_CheckWakeup
        Icu_EnableEdgeDetection: can-enter-exclusive-area=ICU_EXCLUSIVE_AREA_0, implemented-entry=Icu_EnableEdgeDetection
        Icu_DisableEdgeDetection: can-enter-exclusive-area=ICU_EXCLUSIVE_AREA_0, implemented-entry=Icu_DisableEdgeDetection
        Icu_CheckChannelStatus: can-enter-exclusive-area=ICU_EXCLUSIVE_AREA_0, implemented-entry=Icu_CheckChannelStatus
      12 x bsw interrupt entity:
        ICU_ISR_Vector_24_CAT1: implemented-entry=ICU_ISR_Vector_24_CAT1, interrupt-category=CAT-1, interrupt-source=24
        ICU_ISR_Vector_24_CAT2: implemented-entry=ICU_ISR_Vector_24_CAT2, interrupt-category=CAT-2, interrupt-source=24
        ICU_ISR_Vector_25_CAT1: implemented-entry=ICU_ISR_Vector_25_CAT1, interrupt-category=CAT-1, interrupt-source=25
        ICU_ISR_Vector_25_CAT2: implemented-entry=ICU_ISR_Vector_25_CAT2, interrupt-category=CAT-2, interrupt-source=25
        ICU_ISR_Vector_27_CAT1: implemented-entry=ICU_ISR_Vector_27_CAT1, interrupt-category=CAT-1, interrupt-source=27
        ICU_ISR_Vector_27_CAT2: implemented-entry=ICU_ISR_Vector_27_CAT2, interrupt-category=CAT-2, interrupt-source=27
        ICU_ISR_Vector_29_CAT1: implemented-entry=ICU_ISR_Vector_29_CAT1, interrupt-category=CAT-1, interrupt-source=29
        ICU_ISR_Vector_29_CAT2: implemented-entry=ICU_ISR_Vector_29_CAT2, interrupt-category=CAT-2, interrupt-source=29
        ICU_ISR_Vector_32_CAT1: implemented-entry=ICU_ISR_Vector_32_CAT1, interrupt-category=CAT-1, interrupt-source=32
        ICU_ISR_Vector_32_CAT2: implemented-entry=ICU_ISR_Vector_32_CAT2, interrupt-category=CAT-2, interrupt-source=32
        ICU_ISR_Vector_36_CAT1: implemented-entry=ICU_ISR_Vector_36_CAT1, interrupt-category=CAT-1, interrupt-source=36
        ICU_ISR_Vector_36_CAT2: implemented-entry=ICU_ISR_Vector_36_CAT2, interrupt-category=CAT-2, interrupt-source=36
      bsw distinguished partition BswDistinguishedPartition_Icu

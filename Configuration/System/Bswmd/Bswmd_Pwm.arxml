AUTOSAR XML (schema 4-0-3)
package /TS_T40D13M1I0R0
  bsw implementation PwmImplementation: sw-version=1.10.0, vendor-id=66, ar-release-version=4.2.2, behavior=PwmBehavior
  11 x bsw module entry, all with is-synchronous=true, call-type=REGULAR, execution-context=TASK, sw-service-impl-policy=STANDARD:
    Pwm_Init: service-id=0, is-reentrant=false
    Pwm_DeInit: service-id=1, is-reentrant=false
    Pwm_SetDutyCycle: service-id=2, is-reentrant=false
    Pwm_SetPeriodAndDuty: service-id=3, is-reentrant=false
    Pwm_SetOutputToIdle: service-id=4, is-reentrant=false
    Pwm_GetOutputState: service-id=5, is-reentrant=false
    Pwm_DisableNotification: service-id=6, is-reentrant=false
    Pwm_EnableNotification: service-id=7, is-reentrant=false
    Pwm_GetVersionInfo: service-id=8, is-reentrant=true
    Pwm_GetChannelStatus: service-id=32, is-reentrant=true
    Pwm_StartGroupTrigger: service-id=65, is-reentrant=false
package /TS_T40D13M1I0R0/BswDescr
  bsw module description Pwm: module-id=121
    bsw internal behavior PwmBehavior
      exclusive area PWM_EXCLUSIVE_AREA_0
      11 x bsw called entity:
        Pwm_Init: implemented-entry=Pwm_Init
        Pwm_DeInit: can-enter-exclusive-area=PWM_EXCLUSIVE_AREA_0, implemented-entry=Pwm_DeInit
        Pwm_SetDutyCycle: implemented-entry=Pwm_SetDutyCycle
        Pwm_SetPeriodAndDuty: implemented-entry=Pwm_SetPeriodAndDuty
        Pwm_SetOutputToIdle: implemented-entry=Pwm_SetOutputToIdle
        Pwm_GetOutputState: implemented-entry=Pwm_GetOutputState
        Pwm_DisableNotification: implemented-entry=Pwm_DisableNotification
        Pwm_EnableNotification: implemented-entry=Pwm_EnableNotification
        Pwm_GetVersionInfo: implemented-entry=Pwm_GetVersionInfo
        Pwm_GetChannelStatus: implemented-entry=Pwm_GetChannelStatus
        Pwm_StartGroupTrigger: implemented-entry=Pwm_StartGroupTrigger
      bsw distinguished partition BswDistinguishedPartition_Pwm

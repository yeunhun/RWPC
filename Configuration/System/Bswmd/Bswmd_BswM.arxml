AUTOSAR XML (schema 4-0-3)
package /AUTOSAR_BswM/BswModuleDescriptions
  bsw module description BswM: module-id=42
    provided-mode-groups:
      mode declaration group prototype modeSwitchPort_EcuMode: type=EcuMode
    required-mode-groups:
      7 x mode declaration group prototype:
        modeNotificationPort_DcmApplicationUpdated: type=DcmApplicationUpdated
        modeNotificationPort_DcmCommunicationControl_0: type=DcmCommunicationControl
        modeNotificationPort_DcmCommunicationControl_1: type=DcmCommunicationControl
        modeNotificationPort_DcmControlDTCSetting: type=DcmControlDTCSetting
        modeNotificationPort_DcmDiagnosticSessionControl: type=DcmDiagnosticSessionControl
        modeNotificationPort_DcmEcuReset: type=DcmEcuReset
        modeNotificationPort_DcmModeRapidPowerShutDown: type=DcmModeRapidPowerShutDown
    bsw internal behavior BswIB_BswM: data-type-mapping=[DcmCommunicationControl, DcmControlDTCSetting, DcmEcuReset, DcmModeRapidPowerShutDown, DcmApplicationUpdated], bsw-mode-sender-policy{enhanced-mode-api=true, provided-mode-group=modeSwitchPort_EcuMode, queue-length=1}
      exclusive area DATA_PROTECTION
      exclusive area RULEPREVRESULT_PROTECTION
      exclusive area RULESTATUS_PROTECTION
      included-data-type-sets:
        data-type=BswM_EcuModeTransition
        data-type=BswM_ShutdownTargetType
        data-type=BswM_StateManagerType
        data-type=EcuM_StateType
      9 x bsw schedulable entity:
        BswM_Immediate_DcmApplicationUpdated: accessed-mode-groups=modeNotificationPort_DcmApplicationUpdated, implemented-entry=BswM_Immediate_DcmApplicationUpdated
        BswM_ActionList_SchMSwitch_EcuMode: implemented-entry=BswM_ActionList_SchMSwitch_EcuMode, managed-mode-groups=modeSwitchPort_EcuMode
        BswM_Immediate_DcmCommunicationControl_0: accessed-mode-groups=modeNotificationPort_DcmCommunicationControl_0, implemented-entry=BswM_Immediate_DcmCommunicationControl_0
        BswM_Immediate_DcmCommunicationControl_1: accessed-mode-groups=modeNotificationPort_DcmCommunicationControl_1, implemented-entry=BswM_Immediate_DcmCommunicationControl_1
        BswM_Immediate_DcmControlDTCSetting: accessed-mode-groups=modeNotificationPort_DcmControlDTCSetting, implemented-entry=BswM_Immediate_DcmControlDTCSetting
        BswM_Immediate_DcmDiagnosticSessionControl: accessed-mode-groups=modeNotificationPort_DcmDiagnosticSessionControl, implemented-entry=BswM_Immediate_DcmDiagnosticSessionControl
        BswM_Immediate_DcmEcuReset: accessed-mode-groups=modeNotificationPort_DcmEcuReset, implemented-entry=BswM_Immediate_DcmEcuReset
        BswM_Immediate_DcmModeRapidPowerShutDown: accessed-mode-groups=modeNotificationPort_DcmModeRapidPowerShutDown, implemented-entry=BswM_Immediate_DcmModeRapidPowerShutDown
        BswSE_BswM_MainFunction: can-enter-exclusive-area=[DATA_PROTECTION, RULEPREVRESULT_PROTECTION, RULESTATUS_PROTECTION], implemented-entry=BswM_MainFunction
      45 x bsw mode switch event, all with activation=ON-ENTRY:
        BMSE_Entry_BswM_Immediate_DcmApplicationUpdated_modeNotificationPort_DcmApplicationUpdated_APP_NOT_UPDATED: starts-on-event=BswM_Immediate_DcmApplicationUpdated, mode=modeNotificationPort_DcmApplicationUpdated.APP_NOT_UPDATED
        BMSE_Entry_BswM_Immediate_DcmApplicationUpdated_modeNotificationPort_DcmApplicationUpdated_APP_UPDATED: starts-on-event=BswM_Immediate_DcmApplicationUpdated, mode=modeNotificationPort_DcmApplicationUpdated.APP_UPDATED
        BMSE_Entry_BswM_Immediate_DcmCommunicationControl_0_modeNotificationPort_DcmCommunicationControl_0_DCM_DISABLE_RX_DISABLE_TX_NM: starts-on-event=BswM_Immediate_DcmCommunicationControl_0, mode=modeNotificationPort_DcmCommunicationControl_0.DCM_DISABLE_RX_DISABLE_TX_NM
        BMSE_Entry_BswM_Immediate_DcmCommunicationControl_0_modeNotificationPort_DcmCommunicationControl_0_DCM_DISABLE_RX_ENABLE_TX_NORM: starts-on-event=BswM_Immediate_DcmCommunicationControl_0, mode=modeNotificationPort_DcmCommunicationControl_0.DCM_DISABLE_RX_ENABLE_TX_NORM
        BMSE_Entry_BswM_Immediate_DcmCommunicationControl_0_modeNotificationPort_DcmCommunicationControl_0_DCM_DISABLE_RX_ENABLE_TX_NORM_NM: starts-on-event=BswM_Immediate_DcmCommunicationControl_0, mode=modeNotificationPort_DcmCommunicationControl_0.DCM_DISABLE_RX_ENABLE_TX_NORM_NM
        BMSE_Entry_BswM_Immediate_DcmCommunicationControl_0_modeNotificationPort_DcmCommunicationControl_0_DCM_DISABLE_RX_TX_NM: starts-on-event=BswM_Immediate_DcmCommunicationControl_0, mode=modeNotificationPort_DcmCommunicationControl_0.DCM_DISABLE_RX_TX_NM
        BMSE_Entry_BswM_Immediate_DcmCommunicationControl_0_modeNotificationPort_DcmCommunicationControl_0_DCM_DISABLE_RX_TX_NORMAL: starts-on-event=BswM_Immediate_DcmCommunicationControl_0, mode=modeNotificationPort_DcmCommunicationControl_0.DCM_DISABLE_RX_TX_NORMAL
        BMSE_Entry_BswM_Immediate_DcmCommunicationControl_0_modeNotificationPort_DcmCommunicationControl_0_DCM_DISABLE_RX_TX_NORM_NM: starts-on-event=BswM_Immediate_DcmCommunicationControl_0, mode=modeNotificationPort_DcmCommunicationControl_0.DCM_DISABLE_RX_TX_NORM_NM
        BMSE_Entry_BswM_Immediate_DcmCommunicationControl_0_modeNotificationPort_DcmCommunicationControl_0_DCM_ENABLE_RX_DISABLE_TX_NM: starts-on-event=BswM_Immediate_DcmCommunicationControl_0, mode=modeNotificationPort_DcmCommunicationControl_0.DCM_ENABLE_RX_DISABLE_TX_NM
        BMSE_Entry_BswM_Immediate_DcmCommunicationControl_0_modeNotificationPort_DcmCommunicationControl_0_DCM_ENABLE_RX_DISABLE_TX_NORM: starts-on-event=BswM_Immediate_DcmCommunicationControl_0, mode=modeNotificationPort_DcmCommunicationControl_0.DCM_ENABLE_RX_DISABLE_TX_NORM
        BMSE_Entry_BswM_Immediate_DcmCommunicationControl_0_modeNotificationPort_DcmCommunicationControl_0_DCM_ENABLE_RX_DISABLE_TX_NORM_NM: starts-on-event=BswM_Immediate_DcmCommunicationControl_0, mode=modeNotificationPort_DcmCommunicationControl_0.DCM_ENABLE_RX_DISABLE_TX_NORM_NM
        BMSE_Entry_BswM_Immediate_DcmCommunicationControl_0_modeNotificationPort_DcmCommunicationControl_0_DCM_ENABLE_RX_TX_NM: starts-on-event=BswM_Immediate_DcmCommunicationControl_0, mode=modeNotificationPort_DcmCommunicationControl_0.DCM_ENABLE_RX_TX_NM
        BMSE_Entry_BswM_Immediate_DcmCommunicationControl_0_modeNotificationPort_DcmCommunicationControl_0_DCM_ENABLE_RX_TX_NORM: starts-on-event=BswM_Immediate_DcmCommunicationControl_0, mode=modeNotificationPort_DcmCommunicationControl_0.DCM_ENABLE_RX_TX_NORM
        BMSE_Entry_BswM_Immediate_DcmCommunicationControl_0_modeNotificationPort_DcmCommunicationControl_0_DCM_ENABLE_RX_TX_NORM_NM: starts-on-event=BswM_Immediate_DcmCommunicationControl_0, mode=modeNotificationPort_DcmCommunicationControl_0.DCM_ENABLE_RX_TX_NORM_NM
        BMSE_Entry_BswM_Immediate_DcmCommunicationControl_1_modeNotificationPort_DcmCommunicationControl_1_DCM_DISABLE_RX_DISABLE_TX_NM: starts-on-event=BswM_Immediate_DcmCommunicationControl_1, mode=modeNotificationPort_DcmCommunicationControl_1.DCM_DISABLE_RX_DISABLE_TX_NM
        BMSE_Entry_BswM_Immediate_DcmCommunicationControl_1_modeNotificationPort_DcmCommunicationControl_1_DCM_DISABLE_RX_ENABLE_TX_NORM: starts-on-event=BswM_Immediate_DcmCommunicationControl_1, mode=modeNotificationPort_DcmCommunicationControl_1.DCM_DISABLE_RX_ENABLE_TX_NORM
        BMSE_Entry_BswM_Immediate_DcmCommunicationControl_1_modeNotificationPort_DcmCommunicationControl_1_DCM_DISABLE_RX_ENABLE_TX_NORM_NM: starts-on-event=BswM_Immediate_DcmCommunicationControl_1, mode=modeNotificationPort_DcmCommunicationControl_1.DCM_DISABLE_RX_ENABLE_TX_NORM_NM
        BMSE_Entry_BswM_Immediate_DcmCommunicationControl_1_modeNotificationPort_DcmCommunicationControl_1_DCM_DISABLE_RX_TX_NM: starts-on-event=BswM_Immediate_DcmCommunicationControl_1, mode=modeNotificationPort_DcmCommunicationControl_1.DCM_DISABLE_RX_TX_NM
        BMSE_Entry_BswM_Immediate_DcmCommunicationControl_1_modeNotificationPort_DcmCommunicationControl_1_DCM_DISABLE_RX_TX_NORMAL: starts-on-event=BswM_Immediate_DcmCommunicationControl_1, mode=modeNotificationPort_DcmCommunicationControl_1.DCM_DISABLE_RX_TX_NORMAL
        BMSE_Entry_BswM_Immediate_DcmCommunicationControl_1_modeNotificationPort_DcmCommunicationControl_1_DCM_DISABLE_RX_TX_NORM_NM: starts-on-event=BswM_Immediate_DcmCommunicationControl_1, mode=modeNotificationPort_DcmCommunicationControl_1.DCM_DISABLE_RX_TX_NORM_NM
        BMSE_Entry_BswM_Immediate_DcmCommunicationControl_1_modeNotificationPort_DcmCommunicationControl_1_DCM_ENABLE_RX_DISABLE_TX_NM: starts-on-event=BswM_Immediate_DcmCommunicationControl_1, mode=modeNotificationPort_DcmCommunicationControl_1.DCM_ENABLE_RX_DISABLE_TX_NM
        BMSE_Entry_BswM_Immediate_DcmCommunicationControl_1_modeNotificationPort_DcmCommunicationControl_1_DCM_ENABLE_RX_DISABLE_TX_NORM: starts-on-event=BswM_Immediate_DcmCommunicationControl_1, mode=modeNotificationPort_DcmCommunicationControl_1.DCM_ENABLE_RX_DISABLE_TX_NORM
        BMSE_Entry_BswM_Immediate_DcmCommunicationControl_1_modeNotificationPort_DcmCommunicationControl_1_DCM_ENABLE_RX_DISABLE_TX_NORM_NM: starts-on-event=BswM_Immediate_DcmCommunicationControl_1, mode=modeNotificationPort_DcmCommunicationControl_1.DCM_ENABLE_RX_DISABLE_TX_NORM_NM
        BMSE_Entry_BswM_Immediate_DcmCommunicationControl_1_modeNotificationPort_DcmCommunicationControl_1_DCM_ENABLE_RX_TX_NM: starts-on-event=BswM_Immediate_DcmCommunicationControl_1, mode=modeNotificationPort_DcmCommunicationControl_1.DCM_ENABLE_RX_TX_NM
        BMSE_Entry_BswM_Immediate_DcmCommunicationControl_1_modeNotificationPort_DcmCommunicationControl_1_DCM_ENABLE_RX_TX_NORM: starts-on-event=BswM_Immediate_DcmCommunicationControl_1, mode=modeNotificationPort_DcmCommunicationControl_1.DCM_ENABLE_RX_TX_NORM
        BMSE_Entry_BswM_Immediate_DcmCommunicationControl_1_modeNotificationPort_DcmCommunicationControl_1_DCM_ENABLE_RX_TX_NORM_NM: starts-on-event=BswM_Immediate_DcmCommunicationControl_1, mode=modeNotificationPort_DcmCommunicationControl_1.DCM_ENABLE_RX_TX_NORM_NM
        BMSE_Entry_BswM_Immediate_DcmControlDTCSetting_modeNotificationPort_DcmControlDTCSetting_DISABLEDTCSETTING: starts-on-event=BswM_Immediate_DcmControlDTCSetting, mode=modeNotificationPort_DcmControlDTCSetting.DISABLEDTCSETTING
        BMSE_Entry_BswM_Immediate_DcmControlDTCSetting_modeNotificationPort_DcmControlDTCSetting_ENABLEDTCSETTING: starts-on-event=BswM_Immediate_DcmControlDTCSetting, mode=modeNotificationPort_DcmControlDTCSetting.ENABLEDTCSETTING
        BMSE_Entry_BswM_Immediate_DcmDiagnosticSessionControl_modeNotificationPort_DcmDiagnosticSessionControl_DCM_DEFAULT_SESSION: starts-on-event=BswM_Immediate_DcmDiagnosticSessionControl, mode=modeNotificationPort_DcmDiagnosticSessionControl.DCM_DEFAULT_SESSION
        BMSE_Entry_BswM_Immediate_DcmDiagnosticSessionControl_modeNotificationPort_DcmDiagnosticSessionControl_DCM_ECU_PROGRAMMING_MODE: starts-on-event=BswM_Immediate_DcmDiagnosticSessionControl, mode=modeNotificationPort_DcmDiagnosticSessionControl.DCM_ECU_PROGRAMMING_MODE
        BMSE_Entry_BswM_Immediate_DcmDiagnosticSessionControl_modeNotificationPort_DcmDiagnosticSessionControl_DCM_EXTENDED_DIAGNOSTIC_MODE: starts-on-event=BswM_Immediate_DcmDiagnosticSessionControl, mode=modeNotificationPort_DcmDiagnosticSessionControl.DCM_EXTENDED_DIAGNOSTIC_MODE
        BMSE_Entry_BswM_Immediate_DcmDiagnosticSessionControl_modeNotificationPort_DcmDiagnosticSessionControl_DCM_EXTENDED_DIAGNOSTIC_SESSION: starts-on-event=BswM_Immediate_DcmDiagnosticSessionControl, mode=modeNotificationPort_DcmDiagnosticSessionControl.DCM_EXTENDED_DIAGNOSTIC_SESSION
        BMSE_Entry_BswM_Immediate_DcmDiagnosticSessionControl_modeNotificationPort_DcmDiagnosticSessionControl_DCM_PROGRAMMING_SESSION: starts-on-event=BswM_Immediate_DcmDiagnosticSessionControl, mode=modeNotificationPort_DcmDiagnosticSessionControl.DCM_PROGRAMMING_SESSION
        BMSE_Entry_BswM_Immediate_DcmDiagnosticSessionControl_modeNotificationPort_DcmDiagnosticSessionControl_DCM_QUIESCENT_CURRENT_DIAGNOSTIC_MODE_START: starts-on-event=BswM_Immediate_DcmDiagnosticSessionControl, mode=modeNotificationPort_DcmDiagnosticSessionControl.DCM_QUIESCENT_CURRENT_DIAGNOSTIC_MODE_START
        BMSE_Entry_BswM_Immediate_DcmDiagnosticSessionControl_modeNotificationPort_DcmDiagnosticSessionControl_DCM_SAFETY_SYSTEM_DIAGNOSTIC_SESSION: starts-on-event=BswM_Immediate_DcmDiagnosticSessionControl, mode=modeNotificationPort_DcmDiagnosticSessionControl.DCM_SAFETY_SYSTEM_DIAGNOSTIC_SESSION
        BMSE_Entry_BswM_Immediate_DcmDiagnosticSessionControl_modeNotificationPort_DcmDiagnosticSessionControl_DCM_SLEEP_MODE_START_REQUEST: starts-on-event=BswM_Immediate_DcmDiagnosticSessionControl, mode=modeNotificationPort_DcmDiagnosticSessionControl.DCM_SLEEP_MODE_START_REQUEST
        BMSE_Entry_BswM_Immediate_DcmEcuReset_modeNotificationPort_DcmEcuReset_EXECUTE: starts-on-event=BswM_Immediate_DcmEcuReset, mode=modeNotificationPort_DcmEcuReset.EXECUTE
        BMSE_Entry_BswM_Immediate_DcmEcuReset_modeNotificationPort_DcmEcuReset_HARD: starts-on-event=BswM_Immediate_DcmEcuReset, mode=modeNotificationPort_DcmEcuReset.HARD
        BMSE_Entry_BswM_Immediate_DcmEcuReset_modeNotificationPort_DcmEcuReset_JUMPTOBOOTLOADER: starts-on-event=BswM_Immediate_DcmEcuReset, mode=modeNotificationPort_DcmEcuReset.JUMPTOBOOTLOADER
        BMSE_Entry_BswM_Immediate_DcmEcuReset_modeNotificationPort_DcmEcuReset_JUMPTOSYSSUPPLIERBOOTLOADER: starts-on-event=BswM_Immediate_DcmEcuReset, mode=modeNotificationPort_DcmEcuReset.JUMPTOSYSSUPPLIERBOOTLOADER
        BMSE_Entry_BswM_Immediate_DcmEcuReset_modeNotificationPort_DcmEcuReset_KEYONOFF: starts-on-event=BswM_Immediate_DcmEcuReset, mode=modeNotificationPort_DcmEcuReset.KEYONOFF
        BMSE_Entry_BswM_Immediate_DcmEcuReset_modeNotificationPort_DcmEcuReset_NONE: starts-on-event=BswM_Immediate_DcmEcuReset, mode=modeNotificationPort_DcmEcuReset.NONE
        BMSE_Entry_BswM_Immediate_DcmEcuReset_modeNotificationPort_DcmEcuReset_SOFT: starts-on-event=BswM_Immediate_DcmEcuReset, mode=modeNotificationPort_DcmEcuReset.SOFT
        BMSE_Entry_BswM_Immediate_DcmModeRapidPowerShutDown_modeNotificationPort_DcmModeRapidPowerShutDown_DISABLE_RAPIDPOWERSHUTDOWN: starts-on-event=BswM_Immediate_DcmModeRapidPowerShutDown, mode=modeNotificationPort_DcmModeRapidPowerShutDown.DISABLE_RAPIDPOWERSHUTDOWN
        BMSE_Entry_BswM_Immediate_DcmModeRapidPowerShutDown_modeNotificationPort_DcmModeRapidPowerShutDown_ENABLE_RAPIDPOWERSHUTDOWN: starts-on-event=BswM_Immediate_DcmModeRapidPowerShutDown, mode=modeNotificationPort_DcmModeRapidPowerShutDown.ENABLE_RAPIDPOWERSHUTDOWN
      bsw timing event BswTE_BswM_MainFunction: starts-on-event=BswSE_BswM_MainFunction, period=0.01
      mode-receiver-policys:
        enhanced-mode-api=true, required-mode-group=modeNotificationPort_DcmApplicationUpdated, supports-asynchronous-mode-switch=true
        enhanced-mode-api=true, required-mode-group=modeNotificationPort_DcmCommunicationControl_0, supports-asynchronous-mode-switch=true
        enhanced-mode-api=true, required-mode-group=modeNotificationPort_DcmCommunicationControl_1, supports-asynchronous-mode-switch=true
        enhanced-mode-api=true, required-mode-group=modeNotificationPort_DcmControlDTCSetting, supports-asynchronous-mode-switch=true
        enhanced-mode-api=true, required-mode-group=modeNotificationPort_DcmDiagnosticSessionControl, supports-asynchronous-mode-switch=true
        enhanced-mode-api=true, required-mode-group=modeNotificationPort_DcmEcuReset, supports-asynchronous-mode-switch=true
        enhanced-mode-api=true, required-mode-group=modeNotificationPort_DcmModeRapidPowerShutDown, supports-asynchronous-mode-switch=true
      bsw distinguished partition BswDistinguishedPartition_BswM
package /AUTOSAR_BswM/BswImplementations
  bsw implementation BswImplementation_BswM: programming-language=C, sw-version=2.7.5, swc-bsw-mapping=SwcBswMapping_BswM, vendor-id=76, ar-release-version=4.0.3, behavior=BswIB_BswM, vendor-specific-module-def=BswM
package /AUTOSAR_BswM/BswModuleEntrys
  9 x bsw module entry, all with is-synchronous=false, call-type=SCHEDULED, sw-service-impl-policy=STANDARD:
    BswM_Immediate_DcmApplicationUpdated: is-reentrant=true, execution-context=TASK
    BswM_ActionList_SchMSwitch_EcuMode: is-reentrant=true, execution-context=UNSPECIFIED
    BswM_Immediate_DcmCommunicationControl_0: is-reentrant=true, execution-context=TASK
    BswM_Immediate_DcmCommunicationControl_1: is-reentrant=true, execution-context=TASK
    BswM_Immediate_DcmControlDTCSetting: is-reentrant=true, execution-context=TASK
    BswM_Immediate_DcmDiagnosticSessionControl: is-reentrant=true, execution-context=TASK
    BswM_Immediate_DcmEcuReset: is-reentrant=true, execution-context=TASK
    BswM_Immediate_DcmModeRapidPowerShutDown: is-reentrant=true, execution-context=TASK
    BswM_MainFunction: service-id=3, is-reentrant=false, execution-context=TASK
package /AUTOSAR_BswM/ImplementationDataTypes
  impl type BswM_EcuModeTransition: category=VALUE, base-type=uint8, compu {0=BSWM_ECUMODETRANSITION_END, 1=BSWM_ECUMODETRANSITION_ONGOING}
  impl type BswM_ShutdownTargetType: category=VALUE, base-type=uint8, compu {0=BSWM_SHUTDOWNTARGET_RUN, 1=BSWM_SHUTDOWNTARGET_SLEEP, 2=BSWM_SHUTDOWNTARGET_OFF, 3=BSWM_SHUTDOWNTARGET_RESET}
  impl type BswM_StateManagerType:
    category=VALUE
    base-type=uint8
    compu {0=BSWM_ECUSTATE_READY, 18=BSWM_ECUSTATE_ENTRY_STARTUP_TWO, 19=BSWM_ECUSTATE_ENTRY_STARTUP_THREE, 48=BSWM_ECUSTATE_ENTRY_RUN, 64=BSWM_ECUSTATE_ENTRY_SHUTDOWN, 68=BSWM_ECUSTATE_ENTRY_PREP_SHUTDOWN, 80=BSWM_ECUSTATE_ENTRY_SLEEP, 128=BSWM_ECUSTATE_ENTRY_OFF, 144=BSWM_ECUSTATE_ENTRY_RESET, 274=BSWM_ECUSTATE_EXIT_STARTUP_TWO, 275=BSWM_ECUSTATE_EXIT_STARTUP_THREE, 304=BSWM_ECUSTATE_EXIT_RUN, 320=BSWM_ECUSTATE_EXIT_SHUTDOWN, 324=BSWM_ECUSTATE_EXIT_PREP_SHUTDOWN, 336=BSWM_ECUSTATE_EXIT_SLEEP}

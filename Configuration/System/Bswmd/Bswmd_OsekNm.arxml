AUTOSAR XML (schema 4-0-3)
package /ArPackage_OsekNm
  bsw module description OsekNm: module-id=255
    bsw internal behavior BswInternalBehavior_0
      exclusive area OSEKNM_BLOCK_ALL_INTERRUPT
      bsw schedulable entity BswSE_OsekNm_MainFunction: can-enter-exclusive-area=OSEKNM_BLOCK_ALL_INTERRUPT, implemented-entry=OsekNm_MainFunction
      bsw timing event BswTE_OsekNm_MainFunction: starts-on-event=BswSE_OsekNm_MainFunction, period=0.005
      bsw distinguished partition BswDistinguishedPartition_OsekNm
  bsw implementation BswImplementation_OsekNm: sw-version=1.6.0, vendor-id=76, ar-release-version=4.0.3, behavior=BswInternalBehavior_0
  bsw module entry OsekNm_MainFunction: is-reentrant=false, is-synchronous=false, call-type=SCHEDULED, execution-context=TASK, sw-service-impl-policy=STANDARD

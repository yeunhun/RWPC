AUTOSAR XML (schema 4-0-3)
package /Bsw_Com
  bsw implementation BswImplementation_Com: sw-version=2.7.4, vendor-id=76, ar-release-version=4.0.3, behavior=BswInternalBehavior_Com
  bsw module description Com: module-id=50
    bsw module dependency BswModuleDependency0: target-module-id=51, required-entrys=PduR_LoTpTxConfirmation
    bsw internal behavior BswInternalBehavior_Com
      21 x exclusive area:
        RX_DM_STS_PROTECTION_AREA
        RX_IPDU_STS_PROTECTION_AREA
        TX_IPDU_STATUS_PROTECTION_AREA
        TX_IPDU_DATA_PROTECTION
        TX_MDT_PROTECTION_AREA
        RX_IPDU_STATUS_PROTECTION_AREA
        RX_GW_STS_PROTECTION_AREA
        SIG_DATA_PROTECTION_AREA
        RX_SIG_DATA_PROTECTION_AREA
        RX_IPDU_DATA_PROTECTION_AREA
        IPDU_GRP_STS_PROTECTION
        IPDU_STS_PROTECTION
        RX_EXT_SIG_DATA_PROTECTION_AREA
        TX_EXT_SIG_DATA_PROTECTION_AREA
        TX_IPDU_BUFFER_PROTECTION_AREA
        RX_FIFO_PROTECTION_AREA
        IPDU_GROUP_STATUS_PROTECTION
        IPDU_COUNTER_PROTECTION
        TX_TMS_STATUS_PROTECTION_AREA
        TX_MDT_STS_PROTECTION_AREA
        TX_DM_STS_PROTECTION_AREA
      bsw schedulable entity BswSE_Com_MainFunctionRx: can-enter-exclusive-area=[RX_DM_STS_PROTECTION_AREA, RX_IPDU_STS_PROTECTION_AREA, TX_IPDU_STATUS_PROTECTION_AREA, TX_IPDU_DATA_PROTECTION, RX_IPDU_STATUS_PROTECTION_AREA, RX_GW_STS_PROTECTION_AREA, SIG_DATA_PROTECTION_AREA, RX_SIG_DATA_PROTECTION_AREA, RX_IPDU_DATA_PROTECTION_AREA, IPDU_GRP_STS_PROTECTION, IPDU_STS_PROTECTION], implemented-entry=Com_MainFunctionRx
      bsw schedulable entity BswSE_Com_MainFunctionRouteSignals: can-enter-exclusive-area=[RX_DM_STS_PROTECTION_AREA, RX_IPDU_STS_PROTECTION_AREA, TX_IPDU_STATUS_PROTECTION_AREA, TX_IPDU_DATA_PROTECTION, RX_IPDU_STATUS_PROTECTION_AREA, RX_GW_STS_PROTECTION_AREA, SIG_DATA_PROTECTION_AREA, RX_SIG_DATA_PROTECTION_AREA, RX_IPDU_DATA_PROTECTION_AREA, IPDU_GRP_STS_PROTECTION, IPDU_STS_PROTECTION], implemented-entry=Com_MainFunctionRouteSignals
      bsw schedulable entity BswSE_Com_MainFunctionTx: can-enter-exclusive-area=[RX_DM_STS_PROTECTION_AREA, RX_IPDU_STS_PROTECTION_AREA, TX_IPDU_STATUS_PROTECTION_AREA, TX_IPDU_DATA_PROTECTION, TX_MDT_PROTECTION_AREA, RX_IPDU_STATUS_PROTECTION_AREA, RX_GW_STS_PROTECTION_AREA, SIG_DATA_PROTECTION_AREA, RX_SIG_DATA_PROTECTION_AREA, RX_IPDU_DATA_PROTECTION_AREA, IPDU_GRP_STS_PROTECTION, IPDU_STS_PROTECTION, RX_EXT_SIG_DATA_PROTECTION_AREA, TX_EXT_SIG_DATA_PROTECTION_AREA, TX_TMS_STATUS_PROTECTION_AREA, TX_IPDU_BUFFER_PROTECTION_AREA, IPDU_GROUP_STATUS_PROTECTION, IPDU_COUNTER_PROTECTION, RX_FIFO_PROTECTION_AREA, TX_MDT_STS_PROTECTION_AREA, TX_DM_STS_PROTECTION_AREA], implemented-entry=Com_MainFunctionTx
      bsw timing event BswTE_Com_MainFunctionRx: starts-on-event=BswSE_Com_MainFunctionRx, period=0.005
      bsw timing event BswTE_Com_MainFunctionRouteSignals: starts-on-event=BswSE_Com_MainFunctionRouteSignals, period=0.005
      bsw timing event BswTE_Com_MainFunctionTx: starts-on-event=BswSE_Com_MainFunctionTx, period=0.005
      bsw distinguished partition BswDistinguishedPartition_Com
  bsw module entry Com_MainFunctionRx: service-id=24, is-reentrant=false, is-synchronous=false, call-type=SCHEDULED, execution-context=TASK, sw-service-impl-policy=STANDARD
  bsw module entry Com_MainFunctionTx: service-id=25, is-reentrant=false, is-synchronous=false, call-type=SCHEDULED, execution-context=TASK, sw-service-impl-policy=STANDARD
  bsw module entry Com_MainFunctionRouteSignals: service-id=26, is-reentrant=false, is-synchronous=false, call-type=SCHEDULED, execution-context=TASK, sw-service-impl-policy=STANDARD

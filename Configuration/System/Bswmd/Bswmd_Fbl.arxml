AUTOSAR XML (schema 4-3-0)
package /Bsw_Fbl
  bsw implementation BswImplementation_Fbl: programming-language=C, sw-version=1.1.0, vendor-id=76, ar-release-version=4.0.3, behavior=BswInternalBehavior_Fbl
  bsw module description Fbl: category=BSW_MODULE
    bsw internal behavior BswInternalBehavior_Fbl

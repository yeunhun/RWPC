AUTOSAR XML (schema 4-0-3)
package /Bsw_RamTst
  bsw implementation BswImplementation_RamTst: sw-version=1.3.3, vendor-id=76, ar-release-version=4.0.3, behavior=BswInternalBehavior_RamTst
  bsw module entry RamTst_MainFunction: service-id=4, is-reentrant=true, is-synchronous=true, call-type=SCHEDULED, execution-context=TASK, sw-service-impl-policy=STANDARD
  bsw module description RamTst: category=BSW_MODULE, module-id=93
    bsw internal behavior BswInternalBehavior_RamTst
      exclusive area RAM_PROTECTION
      exclusive area PATTERN_CHECK_PROTECT
      bsw schedulable entity BswSE_RamTst_MainFunction: can-enter-exclusive-area=[RAM_PROTECTION, PATTERN_CHECK_PROTECT], implemented-entry=RamTst_MainFunction
      bsw distinguished partition BswDistinguishedPartition_RamTst

AUTOSAR XML (schema 4-0-3)
package /MODE/ApplicationPrimitiveDataTypes
  app type ENUM_ComMMode: category=VALUE, compu {0=COMM_MODE_NO_COM, 2=COMM_MODE_FULL_COM}
  app type ENUM_PduRouter: category=VALUE, compu {0=PDU_ROUTER_ENABLE, 1=PDU_ROUTER_DISABLE}
  app type ENUM_AppMode: category=VALUE, compu {0=APP_MODE_ACTIVE, 1=APP_MODE_INACTIVE_OFF, 2=APP_MODE_INACTIVE_RESET, 3=APP_MODE_INACTIVE_SLEEP}
package /MODE/ModeDeclarationGroups
  8 x mode declaration group:
    MDG_ComMMode: category=EXPLICIT_ORDER, initial-mode=MDG_ComMMode/NO_COM, on-transition-value=255
      mode NO_COM: value=0
      mode SILENT_COM: value=1
      mode FULL_COM: value=2
    MDG_CanSMState: category=EXPLICIT_ORDER, initial-mode=MDG_CanSMState/NO_COM, on-transition-value=255
      5 x mode:
        NO_COM: value=0
        SILENT_COM: value=1
        FULL_COM: value=2
        BUS_OFF: value=3
        CHANGE_BAUDRATE: value=4
    MDG_CanSMBORState: category=EXPLICIT_ORDER, initial-mode=MDG_CanSMBORState/COMPLETE, on-transition-value=255
      mode COMPLETE: value=0
      mode START: value=1
    MDG_LinSMState: category=EXPLICIT_ORDER, initial-mode=MDG_LinSMState/NO_COM, on-transition-value=255
      mode NO_COM: value=0
      mode FULL_COM: value=1
    MDG_WakeupEvent: category=EXPLICIT_ORDER, initial-mode=INITIAL_MODE, on-transition-value=255
      12 x mode:
        POWER: value=0
        RESET: value=1
        INTERNAL_RESET: value=2
        INTERNAL_WDG: value=3
        EXTERNAL_WDG: value=4
        GPT: value=5
        BCAN_RX: value=6
        BCAN_RX_POLL: value=7
        IGN_WakeUP: value=8
        LOCALCAN_RX: value=9
        LOCALCAN_RX_POLL: value=10
        INITIAL_MODE: value=32
    MDG_InitState: category=EXPLICIT_ORDER, initial-mode=MDG_InitState/START, on-transition-value=255
      mode START: value=0
      mode COMPLETE: value=1
    MDG_PduGroup: category=EXPLICIT_ORDER, initial-mode=STOP, on-transition-value=255
      mode STOP: value=0
      mode START: value=1
    MDG_WaitMode: category=ALPHABETIC_ORDER, initial-mode=READY, on-transition-value=3
      mode READY: value=0
      mode RUN: value=1
      mode COMPLETE: value=2
package /MODE/DataTypeMappingSets
  10 x data type mapping set:
    MAP_ComMMode: data-type-map{application-data-type=ENUM_ComMMode, implementation-data-type=uint8}, mode-request-type-map{implementation-data-type=uint8, mode-group=MDG_ComMMode}
    MAP_CanSMState: mode-request-type-map{implementation-data-type=uint8, mode-group=MDG_CanSMState}
    MAP_CanSMBORState: mode-request-type-map{implementation-data-type=uint8, mode-group=MDG_CanSMBORState}
    MAP_LinSMState: mode-request-type-map{implementation-data-type=uint8, mode-group=MDG_LinSMState}
    MAP_WakeupEvent: mode-request-type-map{implementation-data-type=uint8, mode-group=MDG_WakeupEvent}
    MAP_PduRouter: data-type-map{application-data-type=ENUM_PduRouter, implementation-data-type=uint8}
    MAP_InitState: mode-request-type-map{implementation-data-type=uint8, mode-group=MDG_InitState}
    MAP_AppMode: data-type-map{application-data-type=ENUM_AppMode, implementation-data-type=uint8}
    MAP_PduGroup: mode-request-type-map{implementation-data-type=uint8, mode-group=MDG_PduGroup}
    MAP_WaitMode: mode-request-type-map{implementation-data-type=uint8, mode-group=MDG_WaitMode}
package /MODE/SenderReceiverInterfaces
  sender receiver interface PduRouterRequestInterface: is-service=true, service-kind=BASIC-SOFTWARE-MODE-MANAGER
    data PduRouter_Test: type=ENUM_PduRouter
  sender receiver interface AppModeRequestInterface: is-service=true, service-kind=BASIC-SOFTWARE-MODE-MANAGER
    data AppMode: type=ENUM_AppMode
package /MODE/ModeSwitchInterfaces
  5 x mode switch interface, all with is-service=true, service-kind=BASIC-SOFTWARE-MODE-MANAGER:
    WakeupEventInterface
      mode group WakeupEvent: type=MDG_WakeupEvent
    InitStateInterface
      mode group InitState: type=MDG_InitState
    EcuModeInterface
      mode group EcuMode: type=EcuMode
    WaitModeComplete
      mode group WaitModeComplete: type=MDG_WaitMode
    WaitModeRun
      mode group WaitModeRun: type=MDG_WaitMode
package /MODE_LOCALCAN/SenderReceiverInterfaces
  sender receiver interface ComMModeRequestInterface_LOCALCAN: is-service=true, service-kind=BASIC-SOFTWARE-MODE-MANAGER
    data ComMMode_LOCALCAN: type=ENUM_ComMMode
package /MODE_LOCALCAN/ModeSwitchInterfaces
  5 x mode switch interface, all with is-service=true, service-kind=BASIC-SOFTWARE-MODE-MANAGER:
    CanSMBORStateInterface_LOCALCAN
      mode group CanSMBORState_LOCALCAN: type=MDG_CanSMBORState
    CanSMStateInterface_LOCALCAN
      mode group CanSMState_LOCALCAN: type=MDG_CanSMState
    ComMModeInterface_LOCALCAN
      mode group ComMMode_LOCALCAN: type=MDG_ComMMode
    PduGroupTxInterface_LOCALCAN
      mode group PduGroupTx_LOCALCAN: type=MDG_PduGroup
    PduGroupRxInterface_LOCALCAN
      mode group PduGroupRx_LOCALCAN: type=MDG_PduGroup
package /MODE_BCAN/SenderReceiverInterfaces
  sender receiver interface ComMModeRequestInterface_BCAN: is-service=true, service-kind=BASIC-SOFTWARE-MODE-MANAGER
    data ComMMode_BCAN: type=ENUM_ComMMode
package /MODE_BCAN/ModeSwitchInterfaces
  5 x mode switch interface, all with is-service=true, service-kind=BASIC-SOFTWARE-MODE-MANAGER:
    CanSMBORStateInterface_BCAN
      mode group CanSMBORState_BCAN: type=MDG_CanSMBORState
    CanSMStateInterface_BCAN
      mode group CanSMState_BCAN: type=MDG_CanSMState
    ComMModeInterface_BCAN
      mode group ComMMode_BCAN: type=MDG_ComMMode
    PduGroupTxInterface_BCAN
      mode group PduGroupTx_BCAN: type=MDG_PduGroup
    PduGroupRxInterface_BCAN
      mode group PduGroupRx_BCAN: type=MDG_PduGroup

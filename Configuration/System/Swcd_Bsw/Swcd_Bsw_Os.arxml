AUTOSAR XML (schema 4-0-3)
package /Os/ServiceSwComponentTypes
  service sw component type Os_Master
    behavior SwcIB_Os_Master
      timing event Os_TE_100ms_Master: start-on-event=Os_MeasureCPULoad0, period=0.1
      runnable Os_MeasureCPULoad0: symbol=Os_MeasureCPULoadRun

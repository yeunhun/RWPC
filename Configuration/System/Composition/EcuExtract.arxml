AUTOSAR XML (schema 4-2-1)
package /ECU_EXTRACT
  system EcuExtract: category=ECU_EXTRACT
    system mapping PncMappings
    system mapping DataMappings
      data-mappings:
        communication-direction=IN, data-element=SWC_Input.RootSwCompositionPrototype.BCAN_BCM_07_200ms.Lamp_IntTailLmpOnReq, system-signal=SystemSignal_BCAN_BCM_07_200ms_Lamp_IntTailLmpOnReq
        communication-direction=IN, data-element=SWC_Input.RootSwCompositionPrototype.BCAN_CLU_01_20ms_2.CLU_AutoBrightSta, system-signal=SystemSignal_BCAN_CLU_01_20ms_2_CLU_AutoBrightSta
        communication-direction=IN, data-element=SWC_Input.RootSwCompositionPrototype.BCAN_HU_USM_E_04.CF_AVN_CluUSMReset, system-signal=SystemSignal_BCAN_HU_USM_E_04_CF_AVN_CluUSMReset
        communication-direction=IN, data-element=SWC_Input.RootSwCompositionPrototype.BCAN_SBCM_RR_01_200ms.Warn_RrRtDrSwSta_SBCM, system-signal=SystemSignal_BCAN_SBCM_RR_01_200ms_Warn_RrRtDrSwSta_SBCM
        communication-direction=IN, data-element=SWC_Input.RootSwCompositionPrototype.BCAN_ICU_02_200ms.Warn_DrvDrSwSta, system-signal=SystemSignal_BCAN_ICU_02_200ms_Warn_DrvDrSwSta
        communication-direction=IN, data-element=SWC_Input.RootSwCompositionPrototype.BCAN_HU_USM_E_02.CF_Gway_RWPCNValueSet, system-signal=SystemSignal_BCAN_HU_USM_E_02_CF_Gway_RWPCNValueSet
        communication-direction=IN, data-element=SWC_Input.RootSwCompositionPrototype.BCAN_IAU_16_200ms.IAU_ProfileIDRVal, system-signal=SystemSignal_BCAN_IAU_16_200ms_IAU_ProfileIDRVal
        communication-direction=IN, data-element=SWC_Input.RootSwCompositionPrototype.BCAN_ICU_02_200ms.Warn_AsstDrSwSta, system-signal=SystemSignal_BCAN_ICU_02_200ms_Warn_AsstDrSwSta
        communication-direction=IN, data-element=SWC_Input.RootSwCompositionPrototype.BCAN_ICU_02_200ms.Warn_RrRtDrSwSta, system-signal=SystemSignal_BCAN_ICU_02_200ms_Warn_RrRtDrSwSta
        communication-direction=IN, data-element=SWC_Input.RootSwCompositionPrototype.BCAN_BCM_12_200ms.BCM_SmkOptTyp, system-signal=SystemSignal_BCAN_BCM_12_200ms_BCM_SmkOptTyp
        communication-direction=IN, data-element=SWC_Input.RootSwCompositionPrototype.BCAN_SBCM_RL_01_200ms.Warn_RrLftDrSwSta_SBCM, system-signal=SystemSignal_BCAN_SBCM_RL_01_200ms_Warn_RrLftDrSwSta_SBCM
        communication-direction=IN, data-element=SWC_Input.RootSwCompositionPrototype.BCAN_VCU_01_10ms_1.VCU_EvDrvRdySta, system-signal=SystemSignal_BCAN_VCU_01_10ms_1_VCU_EvDrvRdySta
        communication-direction=OUT, data-element=SWC_Output.RootSwCompositionPrototype.BCAN_RWPC_01_200ms.RWPC_SWVerMajor1, system-signal=SystemSignal_BCAN_RWPC_01_200ms_RWPC_SWVerMajor1
        communication-direction=IN, data-element=SWC_Input.RootSwCompositionPrototype.BCAN_CLU_01_20ms_1.CLU_RhstaLvlSta, system-signal=SystemSignal_BCAN_CLU_01_20ms_1_CLU_RhstaLvlSta
        communication-direction=IN, data-element=SWC_Input.RootSwCompositionPrototype.BCAN_ICU_02_200ms.Warn_RrLftDrSwSta, system-signal=SystemSignal_BCAN_ICU_02_200ms_Warn_RrLftDrSwSta
        communication-direction=OUT, data-element=SWC_Output.RootSwCompositionPrototype.BCAN_RWPC_01_200ms.RWPC_SWVerMinor2, system-signal=SystemSignal_BCAN_RWPC_01_200ms_RWPC_SWVerMinor2
        communication-direction=IN, data-element=SWC_Input.RootSwCompositionPrototype.BCAN_HCU_03_10ms_2.HCU_HevRdySta, system-signal=SystemSignal_BCAN_HCU_03_10ms_2_HCU_HevRdySta
        communication-direction=OUT, data-element=SWC_Output.RootSwCompositionPrototype.BCAN_RWPC_01_200ms.RWPC_SWVerMinor1, system-signal=SystemSignal_BCAN_RWPC_01_200ms_RWPC_SWVerMinor1
        communication-direction=IN, data-element=SWC_Input.RootSwCompositionPrototype.BCAN_HU_USM_E_14.CF_Gway_WPCAnimationNvalueSet, system-signal=SystemSignal_BCAN_HU_USM_E_14_CF_Gway_WPCAnimationNvalueSet
        communication-direction=IN, data-element=SWC_Input.RootSwCompositionPrototype.BCAN_EMS_02_10ms_1.ENG_EngSta, system-signal=SystemSignal_BCAN_EMS_02_10ms_1_ENG_EngSta
        communication-direction=IN, data-element=SWC_Input.RootSwCompositionPrototype.BCAN_SMK_06_200ms.LFAnt_SrchSta, system-signal=SystemSignal_BCAN_SMK_06_200ms_LFAnt_SrchSta
        communication-direction=OUT, data-element=SWC_Output.RootSwCompositionPrototype.BCAN_RWPC_01_200ms.WPC_PhnLftWrngRWPCSta, system-signal=SystemSignal_BCAN_RWPC_01_200ms_WPC_PhnLftWrngRWPCSta
        communication-direction=OUT, data-element=SWC_Output.RootSwCompositionPrototype.BCAN_RWPC_01_200ms.USM_ValCmdStaforATS, system-signal=SystemSignal_BCAN_RWPC_01_200ms_USM_ValCmdStaforATS
        communication-direction=IN, data-element=SWC_Input.RootSwCompositionPrototype.BCAN_SBCM_DRV_01_200ms.Warn_DrvDrSwSta_SBCM, system-signal=SystemSignal_BCAN_SBCM_DRV_01_200ms_Warn_DrvDrSwSta_SBCM
        communication-direction=IN, data-element=SWC_Input.RootSwCompositionPrototype.BCAN_SBCM_DRV_01_200ms.Latch_TypeOption_DRV, system-signal=SystemSignal_BCAN_SBCM_DRV_01_200ms_Latch_TypeOption_DRV
        communication-direction=IN, data-element=SWC_Input.RootSwCompositionPrototype.BCAN_ATS_00_00ms.ATS_RWPC_RWPCNValueSet, system-signal=SystemSignal_BCAN_ATS_00_00ms_ATS_RWPC_RWPCNValueSet
        communication-direction=OUT, data-element=SWC_Output.RootSwCompositionPrototype.BCAN_RWPC_01_200ms.RWPC_IndSyncVal, system-signal=SystemSignal_BCAN_RWPC_01_200ms_RWPC_IndSyncVal
        communication-direction=IN, data-element=SWC_Input.RootSwCompositionPrototype.BCAN_WPC_01_200ms.USM_CmdWPCIndSta, system-signal=SystemSignal_BCAN_WPC_01_200ms_USM_CmdWPCIndSta
        communication-direction=IN, data-element=SWC_Input.RootSwCompositionPrototype.BCAN_SBCM_AST_02_200ms.Warn_AsstDrSwSta_SBCM, system-signal=SystemSignal_BCAN_SBCM_AST_02_200ms_Warn_AsstDrSwSta_SBCM
        communication-direction=IN, data-element=SWC_Input.RootSwCompositionPrototype.BCAN_WPC2_01_200ms.WPC2_IndSyncVal, system-signal=SystemSignal_BCAN_WPC2_01_200ms_WPC2_IndSyncVal
        communication-direction=IN, data-element=SWC_Input.RootSwCompositionPrototype.BCAN_HU_GW_PE_01.CF_AVN_ProfileIDRValue, system-signal=SystemSignal_BCAN_HU_GW_PE_01_CF_AVN_ProfileIDRValue
        communication-direction=IN, data-element=SWC_Input.RootSwCompositionPrototype.BCAN_CLU_01_20ms_1.CLU_DtntOutSta, system-signal=SystemSignal_BCAN_CLU_01_20ms_1_CLU_DtntOutSta
        communication-direction=IN, data-element=SWC_Input.RootSwCompositionPrototype.BCAN_EMS_07_10ms_2.HEV_EngOpSta, system-signal=SystemSignal_BCAN_EMS_07_10ms_2_HEV_EngOpSta
        communication-direction=IN, data-element=SWC_Input.RootSwCompositionPrototype.BCAN_CLU_01_20ms_2.CLU_DisSpdVal_KPH, system-signal=SystemSignal_BCAN_CLU_01_20ms_2_CLU_DisSpdVal_KPH
        communication-direction=IN, data-element=SWC_Input.RootSwCompositionPrototype.BCAN_WPC_01_200ms.WPC_IndSyncVal, system-signal=SystemSignal_BCAN_WPC_01_200ms_WPC_IndSyncVal
        communication-direction=OUT, data-element=SWC_Output.RootSwCompositionPrototype.BCAN_RWPC_01_200ms.USM_ValCmdSta, system-signal=SystemSignal_BCAN_RWPC_01_200ms_USM_ValCmdSta
    system mapping SwMappings
      sw-mappings:
        swc to ecu mapping SwMapping0: ecu-instance=SCM
          component:
            RootSwCompositionPrototype.SWC_AppMode
            RootSwCompositionPrototype.SWC_DiagnosticMonitor
            RootSwCompositionPrototype.SWC_DiagnosticService
            RootSwCompositionPrototype.SWC_Input
            RootSwCompositionPrototype.SWC_NvM
            RootSwCompositionPrototype.SWC_Output
            RootSwCompositionPrototype.SWC_P9450Update_Process
            RootSwCompositionPrototype.SWC_Task
            RootSwCompositionPrototype.SWC_WPC_Process
            RootSwCompositionPrototype.SWC_WdgMTest
            RootSwCompositionPrototype.CDD_NFCIC
            RootSwCompositionPrototype.CDD_SLPWUP
            RootSwCompositionPrototype.CDD_UDS
            RootSwCompositionPrototype.CDD_WPCIC
            RootSwCompositionPrototype.IoHwAb
            RootSwCompositionPrototype.BswM
            RootSwCompositionPrototype.CanTp
            RootSwCompositionPrototype.ComM
            RootSwCompositionPrototype.Csm
            RootSwCompositionPrototype.DataLog
            RootSwCompositionPrototype.Dcm
            RootSwCompositionPrototype.Dem
            RootSwCompositionPrototype.Det
            RootSwCompositionPrototype.EcuM
            RootSwCompositionPrototype.FiM
            RootSwCompositionPrototype.NvM
            RootSwCompositionPrototype.Os_Master
            RootSwCompositionPrototype.WdgM
    root-software-compositions:
      root sw composition prototype RootSwCompositionPrototype: software-composition=EcuComposition
  ecu instance SCM: associated-com-i-pdu-group=[ISignalIPduGroupRx_SCM_LOCALCAN, ISignalIPduGroupTx_SCM_LOCALCAN, ISignalIPduGroupRx_SCM_BCAN, ISignalIPduGroupTx_SCM_BCAN]
    4 x can communication controller:
      SCM_B_CAN
      SCM_L_CAN
      SCM_LOCALCAN
      SCM_BCAN
    can communication connector Conn_SCM_B_CAN: comm-controller=SCM_B_CAN
    can communication connector Conn_SCM_L_CAN: comm-controller=SCM_L_CAN
    can communication connector Conn_SCM_LOCALCAN: comm-controller=SCM_LOCALCAN
    can communication connector Conn_SCM_BCAN: comm-controller=SCM_BCAN
  composition sw component type EcuComposition
    28 x component:
      SWC_AppMode: type=SWC_AppMode
      SWC_DiagnosticMonitor: type=SWC_DiagnosticMonitor
      SWC_DiagnosticService: type=SWC_DiagnosticService
      SWC_Input: type=SWC_Input
      SWC_NvM: type=SWC_NvM
      SWC_Output: type=SWC_Output
      SWC_P9450Update_Process: type=SWC_P9450Update_Process
      SWC_Task: type=SWC_Task
      SWC_WPC_Process: type=SWC_WPC_Process
      SWC_WdgMTest: type=SWC_WdgMTest
      CDD_NFCIC: type=CDD_NFCIC
      CDD_SLPWUP: type=CDD_SLPWUP
      CDD_UDS: type=CDD_UDS
      CDD_WPCIC: type=CDD_WPCIC
      IoHwAb: type=IoHwAb
      BswM: type=BswM
      CanTp: type=CanTp
      ComM: type=ComM
      Csm: type=Csm
      DataLog: type=DataLog
      Dcm: type=Dcm
      Dem: type=Dem
      Det: type=Det
      EcuM: type=EcuM
      FiM: type=FiM
      NvM: type=NvM
      Os_Master: type=Os_Master
      WdgM: type=WdgM
    connect SWC_DiagnosticMonitor.CBReadData_DE_0001 -> Dem.CBReadData_DE_0001
    connect SWC_DiagnosticMonitor.CBReadData_DE_0002 -> Dem.CBReadData_DE_0002
    connect DataLog.CBReadData_DE_DataLog -> Dem.CBReadData_DE_DataLog
    connect SWC_DiagnosticMonitor.CBStatusEvt_DEM_E_TEST_EVENT1 -> Dem.CBStatusEvt_DEM_E_TEST_EVENT1_DemCallbackEventStatusChanged0
    connect SWC_DiagnosticMonitor.CBStatusEvt_E_MODE_CHANGE_BCAN -> Dem.CBStatusEvt_CANSM_E_MODE_CHANGE_BCAN_DemCallbackEventStatusChanged0
    connect SWC_DiagnosticMonitor.CBStatusEvt_E_MODE_CHANGE_LOCALCAN -> Dem.CBStatusEvt_CANSM_E_MODE_CHANGE_LOCALCAN_DemCallbackEventStatusChanged0
    connect SWC_DiagnosticService.CallbackDCMRequestServices -> Dcm.CallbackDCMRequestServices_ECU1
    connect Dem.Cdd -> CDD_UDS.R_Cdd
    connect Dcm.DCMServices -> SWC_DiagnosticService.DCM_Services
    connect Det.DS000 -> SWC_DiagnosticMonitor.DS000
    connect SWC_WPC_Process.DataServices_CANDataBaseVersionNumberDataIdentifier_0xF100 -> Dcm.DataServices_CANDataBaseVersionNumberDataIdentifier_0xF100
    connect SWC_WPC_Process.DataServices_ChargingECUSoftwareVersionMobase_0xF101 -> Dcm.DataServices_ChargingECUSoftwareVersionMobase_0xF101
    connect SWC_DiagnosticService.DataServices_DIDRange_DID_0100h_0110h -> Dcm.DataServices_DIDRange_DIDs_0100h_0110h
    connect SWC_WPC_Process.DataServices_ECUManufacturingDateDataIdentifier_0xF18B -> Dcm.DataServices_ECUManufacturingDateDataIdentifier_0xF18B
    connect SWC_WPC_Process.DataServices_ECUSerialNumberDataIdentifier_0xF18C -> Dcm.DataServices_ECUSerialNumberDataIdentifier_0xF18C
    connect SWC_WPC_Process.DataServices_ECUSoftwareInternalVersion_0xF189 -> Dcm.DataServices_ECUSoftwareInternalVersion_0xF189
    connect SWC_WPC_Process.DataServices_ECUSoftwareUNIT1VersionDataIdentifier_0xF1B1 -> Dcm.DataServices_ECUSoftwareUNIT1VersionDataIdentifier_0xF1B1
    connect SWC_WPC_Process.DataServices_ECUSoftwareUNITnumberDataIdentifier_0xF1B0 -> Dcm.DataServices_ECUSoftwareUNITnumberDataIdentifier_0xF1B0
    connect SWC_WPC_Process.DataServices_ECUSoftwareUnit1IVDDataIdentifier_0xF1C1 -> Dcm.DataServices_ECUSoftwareUnit1IVDDataIdentifier_0xF1C1
    connect SWC_WPC_Process.DataServices_ECUSupplierCodeDataIdentifier_0xF1A1 -> Dcm.DataServices_ECUSupplierCodeDataIdentifier_0xF1A1
    connect SWC_WPC_Process.DataServices_InputOutputRecordLocalIdentifier_0xBE02 -> Dcm.DataServices_InputOutputRecordLocalIdentifier_0xBE02
    connect SWC_WPC_Process.DataServices_InputOutputRecordLocalIdentifier_0xBE03 -> Dcm.DataServices_InputOutputRecordLocalIdentifier_0xBE03
    connect SWC_WPC_Process.DataServices_ReadECUIdentificationLocalRXSWINDataIdentifier_0xF1EF -> Dcm.DataServices_ReadECUIdentificationLocalRXSWINDataIdentifier_0xF1EF
    connect SWC_WPC_Process.DataServices_SystemSupplierECUHardwareVersionNumberDataIdentifier_0xF193 -> Dcm.DataServices_SystemSupplierECUHardwareVersionNumberDataIdentifier_0xF193
    connect SWC_WPC_Process.DataServices_UserOptionRecordLocalIdentifier_0xBE01 -> Dcm.DataServices_UserOptionRecordLocalIdentifier_0xBE01
    connect SWC_WPC_Process.DataServices_VehicleManufacturerECUHardwareNumberDataIdentifier_0xF191 -> Dcm.DataServices_VehicleManufacturerECUHardwareNumberDataIdentifier_0xF191
    connect SWC_WPC_Process.DataServices_VehicleManufacturerSparePartNumberDataIdentifier_0xF187 -> Dcm.DataServices_VehicleManufacturerSparePartNumberDataIdentifier_0xF187
    connect SWC_WPC_Process.DataServices_WDBI_Factory_SerialNumber_0x12A3 -> Dcm.DataServices_WDBI_Factory_SerialNumber_0x12A3
    connect SWC_WPC_Process.DataServices_WDBI_ManufacturingDate_0x12A4 -> Dcm.DataServices_WDBI_ManufacturingDate_0x12A4
    connect Dem.EnableCond_DemEnableCondition -> SWC_DiagnosticMonitor.EnableCond_EnableCondtion_0
    connect Dem.EventInfo_CANSM_E_BUS_OFF_BCAN -> CDD_UDS.EventInfo_CANSM_E_BUS_OFF_BCAN
    connect Dem.EventInfo_CANSM_E_BUS_OFF_LOCALCAN -> CDD_UDS.EventInfo_CANSM_E_BUS_OFF_LCAN
    connect Dem.Event_DEM_E_TEST_EVENT{1..4} -> SWC_DiagnosticMonitor.Event_DEM_E_TEST_EVENT{1..4}
    connect Csm.HaeAdvSeedKey_L9_Hash -> SWC_DiagnosticService.HaeAdvSeedKey_L9
    connect Csm.HaeHsmPseudoRandomGenerate_L9_RandomGenerate -> SWC_DiagnosticService.HaeHsmPseudoRandomGenerate_L9
    connect Csm.HaePseudoRandomGenerate_L9_RandomGenerate -> SWC_DiagnosticService.HaePseudoRandomGenerate_L9
    connect Csm.HaePseudoRandomSeed_L9_RandomSeed -> SWC_DiagnosticService.HaePseudoRandomSeed_L9
    connect Dem.IndStatus_DemIndicator_0 -> SWC_DiagnosticMonitor.IndStatus_DemIndicator_0
    connect SWC_DiagnosticMonitor.InitEvt_DEM_E_TEST_EVENT -> Dem.CBInitEvt_DEM_E_TEST_EVENT1
    connect Dem.OpCycle_IGNITION_CYCLE -> SWC_AppMode.OpCycle_IGNITION_CYCLE
    connect Dem.OpCycle_IGNITION_CYCLE -> SWC_DiagnosticMonitor.OpCycle_IGNITION_CYCLE
    connect Dem.OpCycle_POWER_CYCLE -> SWC_AppMode.OpCycle_POWER_CYCLE
    connect Dem.OpCycle_POWER_CYCLE -> SWC_DiagnosticMonitor.OpCycle_POWER_CYCLE
    connect SWC_NvM.PNJF_NvMBlock_DTCInfo -> NvM.PNJF_NvMBlock_DTCInfo
    connect SWC_NvM.PNJF_NvMBlock_Dummy -> NvM.PNJF_NvMBlock_Dummy
    connect SWC_NvM.PNJF_NvMBlock_Function -> NvM.PNJF_NvMBlock_Function
    connect SWC_NvM.PNJF_NvMBlock_MDate -> NvM.PNJF_NvMBlock_MDate
    connect SWC_NvM.PNJF_NvMBlock_Option -> NvM.PNJF_NvMBlock_Option
    connect SWC_NvM.PNJF_NvMBlock_PartNO -> NvM.PNJF_NvMBlock_PartNO
    connect SWC_NvM.PNJF_NvMBlock_SerialNO -> NvM.PNJF_NvMBlock_SerialNO
    connect NvM.PS_NvMBlock_DTCInfo -> SWC_NvM.PS_NvMBlock_DTCInfo
    connect NvM.PS_NvMBlock_Dummy -> SWC_NvM.PS_NvMBlock_Dummy
    connect NvM.PS_NvMBlock_Function -> SWC_NvM.PS_NvMBlock_Function
    connect NvM.PS_NvMBlock_MDate -> SWC_NvM.PS_NvMBlock_MDate
    connect NvM.PS_NvMBlock_Option -> SWC_NvM.PS_NvMBlock_Option
    connect NvM.PS_NvMBlock_PartNO -> SWC_NvM.PS_NvMBlock_PartNO
    connect NvM.PS_NvMBlock_SerialNO -> SWC_NvM.PS_NvMBlock_SerialNO
    connect IoHwAb.P_AnaInDir_ACC_Real -> SWC_Input.R_AnaInDir_ACC
    connect IoHwAb.P_AnaInDir_Battery_Real -> SWC_Input.R_AnaInDir_Battery_Real
    connect IoHwAb.P_AnaInDir_Thermistor2 -> SWC_Input.R_AnalnDir_Thermistor2
    connect IoHwAb.P_AnaInDir_Thermistor3 -> SWC_Input.R_AnalnDir_Thermistor3
    connect IoHwAb.P_AnaInDir_Thermistor -> SWC_Input.R_AnaInDir_Thermistor
    connect SWC_AppMode.P_BCANBusState -> SWC_Input.R_BCANBusState
    connect IoHwAb.P_DigDir_FAN_DIAG -> SWC_Input.R_DigDir_FAN_DIAG
    connect IoHwAb.P_DigDir_NFC_INTERRUPT_INT -> CDD_NFCIC.R_DigDir_NFC_INTERRUPT_INT
    connect IoHwAb.P_DigDir_NFC_OPTION -> SWC_AppMode.R_DigDir_NFC_OPTION
    connect IoHwAb.P_DigDir_SPI_CS -> CDD_NFCIC.R_DigDir_SPI_CS
    connect IoHwAb.P_DigDir_VBATSW_EN -> SWC_Input.R_DigDir_VBATSW_EN
    connect IoHwAb.P_DigDir_VBATSW_EN -> SWC_Output.R_DigDir_VBATSW_EN
    connect IoHwAb.P_DigDir_VN7140AS_IN -> SWC_Output.R_DigDir_VN7140AS_IN
    connect IoHwAb.P_DigDir_VN7140AS_MULTI -> SWC_Input.R_DigDir_VN7140AS_MULTI
    connect IoHwAb.P_DigDir_VN7140AS_SEN -> SWC_Output.R_DigDir_VN7140AS_SEN
    connect IoHwAb.P_Gpt_NFC_TickTimer -> CDD_NFCIC.R_Gpt_NFC_TickTimer
    connect CDD_NFCIC.P_Gpt_NFC_TickTimer_Cbk -> IoHwAb.R_Gpt_NFC_TickTimer_Cbk
    connect IoHwAb.P_Icu_NFC_INTERRUPT -> CDD_NFCIC.R_Icu_NFC_INTERRUPT
    connect CDD_NFCIC.P_Icu_NFC_INTERRUPT_Cbk -> IoHwAb.R_Icu_NFC_INTERRUPT_Cbk
    connect SWC_AppMode.P_LCANBusState -> SWC_Input.R_LCANBusState
    connect IoHwAb.P_Pwm_AMBER_IND_OUT -> SWC_Output.Pwm_Duty_R_AMBER_IND_OUT
    connect IoHwAb.P_Pwm_FAN_OUT -> SWC_Output.Pwm_Duty_R_FAN_OUT
    connect IoHwAb.P_Pwm_GREEN_IND_OUT{1..3} -> SWC_Output.Pwm_Duty_R_GREEN_IND_OUT{1..3}
    connect SWC_Task.P_RE_Input_10ms -> SWC_Input.R_RE_Input_10ms
    connect SWC_Task.P_RE_Output_10ms -> SWC_Output.R_RE_Output_10ms
    connect SWC_Task.P_RE_P9450_Update_5ms -> SWC_P9450Update_Process.R_RE_P9450_Update_Process_5ms
    connect SWC_Task.P_RE_WPC_Process_10ms -> SWC_WPC_Process.R_RE_WPC_Process_10ms
    connect SWC_AppMode.P_Slpwup_ComMNoti_BCAN -> CDD_SLPWUP.R_Slpwup_ComMNoti_BCAN
    connect SWC_AppMode.P_Slpwup_ComMNoti_LCAN -> CDD_SLPWUP.R_Slpwup_ComMNoti_LCAN
    connect SWC_AppMode.P_Slpwup_EcuM_StateRequest -> CDD_SLPWUP.R_Slpwup_EcuM_StateRequest
    connect SWC_AppMode.P_Slpwup_EcuMode -> CDD_SLPWUP.R_Slpwup_EcuMode
    connect SWC_AppMode.P_Slpwup_FullComM_BCAN -> CDD_SLPWUP.R_Slpwup_FullComM_BCAN
    connect SWC_AppMode.P_Slpwup_FullComM_LCAN -> CDD_SLPWUP.R_Slpwup_FullComM_LCAN
    connect SWC_NvM.P_Slpwup_NvMJobFinished -> CDD_SLPWUP.R_Slpwup_NvMJobFinished
    connect SWC_AppMode.P_Slpwup_RequestMode_BCAN -> CDD_SLPWUP.R_Slpwup_RequestMode_BCAN
    connect SWC_AppMode.P_Slpwup_RequestMode_LCAN -> CDD_SLPWUP.R_Slpwup_RequestMode_LCAN
    connect SWC_Output.P_Start_WPCDiagState -> SWC_DiagnosticService.R_Start_WPCDiagState
    connect SWC_DiagnosticService.SecurityAccess_L9 -> Dcm.SecurityAccess_L9
    connect SWC_DiagnosticService.ServiceRequestSupplierNotification_DcmDslServiceRequestSupplierNotification0 -> Dcm.ServiceRequestSupplierNotification_DcmDslServiceRequestSupplierNotification0
    connect SWC_Task.Trg_interface_5ms_NP3 -> SWC_WPC_Process.R_Trg_Interface_5ms_NP3
    connect WdgM.WdgM_API_P -> SWC_WdgMTest.WdgM_API_R
    connect WdgM.alive_SE_Init -> SWC_WdgMTest.SE_Init
    connect WdgM.alive_SE_WdgMTest -> SWC_WdgMTest.SE_WdgMTest
    connect WdgM.globalMode -> SWC_WdgMTest.globalMode
    connect SWC_AppMode.modeRequestPort_ComMMode_BCAN -> BswM.modeRequestPort_ComMMode_BCAN
    connect BswM.modeSwitchPort_CanSMBORState_BCAN -> SWC_AppMode.modeNotificationPort_CanSMBORState_BCAN
    connect BswM.modeSwitchPort_CanSMState_BCAN -> SWC_AppMode.modeNotificationPort_CanSMState_BCAN
    connect BswM.modeSwitchPort_ComMMode_BCAN -> SWC_AppMode.modeNotificationPort_ComMMode_BCAN
    connect BswM.modeSwitchPort_DcmDiagnosticSessionControl -> SWC_DiagnosticService.modeNotificationPort_SessionControl
    connect BswM.modeSwitchPort_EcuMode -> SWC_AppMode.modeNotificationPort_EcuMode
    connect BswM.modeSwitchPort_InitState -> SWC_AppMode.modeNotificationPort_InitState
    connect BswM.modeSwitchPort_PduGroupRx_BCAN -> SWC_AppMode.modeNotificationPort_PduGroupRx_BCAN
    connect BswM.modeSwitchPort_PduGroupTx_BCAN -> SWC_AppMode.modeNotificationPort_PduGroupTx_BCAN
    connect BswM.modeSwitchPort_WakeupEvent -> SWC_AppMode.modeNotificationPort_WakeupEvent
    connect EcuM.staterequest -> SWC_AppMode.clientPort_StateRequest
    connect SWC_WPC_Process.DataServices_PlatformHardwareVersion_0xF17D -> Dcm.DataServices_PlatformHardwareVersion_0xF17D
    connect SWC_WPC_Process.DataServices_PlatformVersion_0xF17F -> Dcm.DataServices_PlatformVersion_0xF17F
    connect SWC_WPC_Process.DataServices_SystemName_0xF197 -> Dcm.DataServices_SystemName_0xF197
    connect SWC_WPC_Process.RoutineServices_RID_0300h_OTAReady -> Dcm.RoutineServices_RID_0300h_OTAReady
    connect SWC_DiagnosticService.RoutineServices_RID_B194h_HSMConfigLockSecureDebug -> Dcm.RoutineServices_RID_B194h_HSMConfigLockSecureDebug
    connect SWC_DiagnosticService.RoutineServices_RID_B199h_HSMSecureBootEnable -> Dcm.RoutineServices_RID_B199h_HSMSecureBootEnable
    connect SWC_DiagnosticService.RoutineServices_RID_B19Ah_HSMFTDDisable -> Dcm.RoutineServices_RID_B19Ah_HSMFTDDisable
    connect SWC_DiagnosticService.RoutineServices_RID_B19Bh_HSMSecureDebugEnable -> Dcm.RoutineServices_RID_B19Bh_HSMSecureDebugEnable
    connect SWC_DiagnosticService.RoutineServices_RID_B19Ch_HSMConfigurationLockEnable -> Dcm.RoutineServices_RID_B19Ch_HSMConfigurationLockEnable
    connect SWC_DiagnosticService.RoutineServices_RID_B19Dh_HSMChallengeRequest -> Dcm.RoutineServices_RID_B19Dh_HSMChallengeRequest
    connect SWC_DiagnosticService.RoutineServices_RID_B19Eh_HSMResponseData -> Dcm.RoutineServices_RID_B19Eh_HSMResponseData
    connect SWC_WPC_Process.DataServices_NonSleepCollectedEachEcuDataIdentifier_0xED90 -> Dcm.DataServices_NonSleepCollectedEachEcuDataIdentifier_0xED90

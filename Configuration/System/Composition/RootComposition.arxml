AUTOSAR XML (schema 4-1-1)
package /AUTOSAR
  composition sw component type CSWC_RootComposition
    14 x component:
      SWC_DiagnosticService: type=SWC_DiagnosticService
      SWC_WdgMTest: type=SWC_WdgMTest
      SWC_DiagnosticMonitor: type=SWC_DiagnosticMonitor
      SWC_AppMode: type=SWC_AppMode
      SWC_NvM: type=SWC_NvM
      SWC_Input: type=SWC_Input
      SWC_Output: type=SWC_Output
      SWC_Task: type=SWC_Task
      CDD_NFCIC: type=CDD_NFCIC
      SWC_WPC_Process: type=SWC_WPC_Process
      CDD_SLPWUP: type=CDD_SLPWUP
      CDD_WPCIC: type=CDD_WPCIC
      SWC_P9450Update_Process: type=SWC_P9450Update_Process
      CDD_UDS: type=CDD_UDS
    connect SWC_AppMode.P_BCANBusState -> SWC_Input.R_BCANBusState
    connect SWC_AppMode.P_LCANBusState -> SWC_Input.R_LCANBusState
    connect SWC_Task.P_RE_Input_10ms -> SWC_Input.R_RE_Input_10ms
    connect SWC_Task.P_RE_Output_10ms -> SWC_Output.R_RE_Output_10ms
    connect SWC_Task.P_RE_P9450_Update_5ms -> SWC_P9450Update_Process.R_RE_P9450_Update_Process_5ms
    connect SWC_Task.P_RE_WPC_Process_10ms -> SWC_WPC_Process.R_RE_WPC_Process_10ms
    connect SWC_AppMode.P_Slpwup_ComMNoti_BCAN -> CDD_SLPWUP.R_Slpwup_ComMNoti_BCAN
    connect SWC_AppMode.P_Slpwup_ComMNoti_LCAN -> CDD_SLPWUP.R_Slpwup_ComMNoti_LCAN
    connect SWC_AppMode.P_Slpwup_EcuM_StateRequest -> CDD_SLPWUP.R_Slpwup_EcuM_StateRequest
    connect SWC_AppMode.P_Slpwup_EcuMode -> CDD_SLPWUP.R_Slpwup_EcuMode
    connect SWC_AppMode.P_Slpwup_FullComM_BCAN -> CDD_SLPWUP.R_Slpwup_FullComM_BCAN
    connect SWC_AppMode.P_Slpwup_FullComM_LCAN -> CDD_SLPWUP.R_Slpwup_FullComM_LCAN
    connect SWC_NvM.P_Slpwup_NvMJobFinished -> CDD_SLPWUP.R_Slpwup_NvMJobFinished
    connect SWC_AppMode.P_Slpwup_RequestMode_BCAN -> CDD_SLPWUP.R_Slpwup_RequestMode_BCAN
    connect SWC_AppMode.P_Slpwup_RequestMode_LCAN -> CDD_SLPWUP.R_Slpwup_RequestMode_LCAN
    connect SWC_Task.Trg_interface_5ms_NP3 -> SWC_WPC_Process.R_Trg_Interface_5ms_NP3
    connect SWC_Output.P_Start_WPCDiagState -> SWC_DiagnosticService.R_Start_WPCDiagState

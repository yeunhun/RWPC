AUTOSAR XML (schema 4-3-0)
package /ARP_Interface
  sender receiver interface SRIF_u8
    data SR_u8: type=tVAR
  sender receiver interface SRIF_u16
    data SR_u16: type=tVARu16
package /ARP_io_interface
  7 x sender receiver interface:
    SR_BCAN_Input
      data BCM_07_200ms_Lamp_IntTailLmpOnReq: type=tVAR
    SR_BCAN_Output
      6 x data, all with type=tVAR:
        RWPC_01_200ms_USM_ValCmdSta
        RWPC_01_200ms_USM_ValCmdStaforATS
        RWPC_01_200ms_WPC_PhnLftWrngRWPCSta
        RWPC_01_200ms_RWPC_SWVerMajor1
        RWPC_01_200ms_RWPC_SWVerMinor1
        RWPC_01_200ms_RWPC_SWVerMinor2
    SR_LCAN_Input
      data BDC_01_C_WPCNFCcmd: type=tVAR
      data BDC_01_C_BDCWPCNFCCmd: type=tVAR
    SR_LCAN_Ouput
      data WPC_01_C_WPC_NFCReset: type=tVAR
      data WPC_01_C_WPC_NFCDetection: type=tVAR
    SR_Analog_Input
      data A_Thermistor_In_WPC: type=tVAR
      data A_Thermistor2_In_WPC: type=tVAR
      data A_Thermistor3_In_WPC: type=tVAR
    SR_Digital_Input
      data D_VN7140AS_MULTI_In_WPC: type=tVAR
    SR_Digital_Output
      data D_VBATSW_EN_Out_WPC: type=tVAR
package /ARP_Slpwup
  client server interface CS_RequestMode
    operation RequestComMode
      arg Data: type=uint8, direction=IN
  client server interface CS_EcuM_StateRequest
    operation RequestState
      arg Data: type=uint8, direction=IN
package /ARP_EepData
  7 x client server interface:
    CS_ReadEep
      operation ReadEep
        arg Read_EepBlock: type=tEepBlock, direction=IN
        arg Read_EepData: type=tEepDataArray_u8, direction=OUT
    CS_WriteEep
      operation WriteEep
        arg Write_EepBlock: type=tEepBlock, direction=IN
        arg Write_EepWriteReq: type=tEepWriteReq, direction=IN
        arg Write_EepData: type=tEepDataArray_u8, direction=IN
    CS_ModeReq
      operation ECUMode
        arg ECUMode_Req: type=tModeReq, direction=IN
    CS_AppOperating
      operation AppOperating
        arg OperatingCmd: type=tOperatingCmd, direction=IN
    CS_ReadArrayData_u8
      operation ArrayData
        arg Length: type=uint8, direction=OUT
        arg Data: type=tDataArrayType_u8, direction=OUT
    CS_WriteArrayData_u8
      operation ArrayData
        arg Length: type=uint8, direction=IN
        arg Data: type=tDataArrayType_u8, direction=IN
    CS_ReadSts
      operation AppStatus
        arg Status: type=uint8, direction=OUT

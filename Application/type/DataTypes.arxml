AUTOSAR XML (schema 4-3-0)
package /DataTypes/ImplementationDataTypes
  12 x impl type:
    tVAR: category=STRUCTURE
      element New: implementation-data-type=uint8
      element Old: implementation-data-type=uint8
    tVARf32: category=STRUCTURE
      element New: implementation-data-type=float32
      element Old: implementation-data-type=float32
    tVARs16: category=STRUCTURE
      element New: implementation-data-type=sint16
      element Old: implementation-data-type=sint16
    tVARu16: category=STRUCTURE
      element New: implementation-data-type=uint16
      element Old: implementation-data-type=uint16
    tVARu32: category=STRUCTURE
      element New: implementation-data-type=uint32
      element Old: implementation-data-type=uint32
    tEepData: category=STRUCTURE
      28 x element, all with category=TYPE_REFERENCE, implementation-data-type=uint8:
        Length: array-size-semantics=FIXED-SIZE
        State
        Data{0..25}
    tEepWriteReq: category=STRUCTURE
      element MainReq: implementation-data-type=uint8
      element SubReq: implementation-data-type=uint8
    tModeReq: category=STRUCTURE
      element ModeMainReq: implementation-data-type=uint8
      element ModeSubReq: implementation-data-type=uint8
      element ModeState: implementation-data-type=uint8
    tOperatingCmd: implementation-data-type=uint8
    tDataArrayType_u8: category=ARRAY
      element DataArrayType: array-size=255, array-size-semantics=FIXED-SIZE, implementation-data-type=uint8
    tEepBlock: category=STRUCTURE
      28 x element, all with category=TYPE_REFERENCE, implementation-data-type=uint8:
        Length: array-size-semantics=FIXED-SIZE
        State
        Data{0..25}
    tEepDataArray_u8: category=ARRAY
      element DataArrayType: array-size=255, array-size-semantics=FIXED-SIZE, implementation-data-type=uint8

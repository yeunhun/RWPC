AUTOSAR XML (schema 4-0-1)
# (C) 2013 HYUNDAI AUTOEVER Co., Ltd.
# Confidential Proprietary Information. Distribution Limited.
# Do Not Copy Without Prior Permission
package /AUTRON
  ecuc definition collection ParameterDefinition_PduR: module=PduR
  module definition PduR: refined-module-def=PduR, variants post-build/pre-compile  # Configuration of the PduR (PDU Router) module.
    container PduRBswModules [0..*]  # Each container describes a specific BSW module (upper/CDD/lower/IpduM) that the PDU Router shall interface to. | The reason to have it as own configuration container instead of implication of the routing path is to be able to configure CDD:s properly and to force module's to be used in a post-build situation even though no routing is made to/from this module (future configurations may include these modules).
      boolean PduRCancelReceive: set at pre-compile  # Specifies if the Transport protocol module supports the CancelReceive API or not. Value true the API is supported. true: The transport protocol module should support the CancelReceive API. false: The transport protocol module should not support the CancelReceive API.
      boolean PduRCancelTransmit: set at pre-compile  # Specifies if the BSW module supports the CancelTransmit API or not. Value true the API is supported. true: The BSW module should support the CancelTransmit API. false: The BSW module should not support the CancelTransmit API.
      boolean PduRChangeParameterRequestApi: category=NOT_SUPPORTED, set at pre-compile  # This parameter, if set to true, enables the PduR_<Up>ChangeParameterRequest Api for this Module. true: the PduR_<Up>ChangeParameterRequest Api are enabled for the module. false: the PduR_<Up>ChangeParameterRequest Api are disabled for the module.
      boolean PduRCommunicationInterface: set at pre-compile  # Specifies if the BSW module supports the Communication Interface APIs or not. Value true the APIs are supported. true: The BSW module should support the Communication Interface APIs. false: The BSW module should not support the Communication Interface APIs. | A module can have both Communication Interface APIs and Transport Protocol APIs (e.g. the COM module).
      boolean PduRLowerModule: set at pre-compile  # The PduRLowerModule will decide who will call the APIs and who will implement the APIs. true: The PduRLowerModule will decide who will call the APIs and who will implement the APIs. false: The PduRLowerModule will not decide who will call the APIs and who will implement the APIs. | For example, if the CanIf module is referenced then the PDU Router module will implement the PduR_CanIfRxIndication API. And the PDUR module will call the CanIf_Transmit API. Other APIs are of course also covered. An upper module can also be an lower module (e.g. the IpduM module).
      boolean PduRRetransmission: category=NOT_SUPPORTED, set at pre-compile  # If set to true this means that the destination transport protocol module will use the retransmission feature. This parameter might be set to false if the retransmission feature is not used, even though the destination transport protocol is supporting it. true: The destination transport protocol module will use the retransmission feature. false: The destination transport protocol module will not use the retransmission feature. | This parameter is only valid for transport protocol modules and gateway operations. If transmission from a local upper layer module this module will handle the retransmission.
      boolean PduRTransportProtocol: set at pre-compile  # The PDU Router module shall use the API parameters specified for transport protocol interface. true: The PDU Router module shall use the API parameters specified for transport protocol interface. false: The PDU Router module shall not use the API parameters specified for transport protocol interface.
      boolean PduRTriggertransmit: set at pre-compile  # Specifies if the BSW module supports the TriggerTransmit API or not. Value true the API is supported. true: The BSW module supports the TriggerTransmit API. false: The BSW module does not supports the TriggerTransmit API.
      boolean PduRTxConfirmation: set at pre-compile  # Specifies if the BSW module supports the TxConfirmation API or not. Value true the API is supported. true: The BSW module supports the TxConfirmation API false: The BSW module does not supports the TTxConfirmation API.
      boolean PduRUpperModule: set at pre-compile  # The PduRUpperModule will decide who will call the APIs and who will implement the APIs. true: The PduRUpperModule will decide who will call the APIs and who will implement the APIs. false: The PduRUpperModule will not decide who will call the APIs and who will implement the APIs. | For example, if the COM module is referenced then the PDU Router module will implement the PduR_Transmit API. And the PDUR module will call the Com_RxIndication API. Other APIs are of course also covered. An upper module can also be an lower module (e.g. the IpduM module).
      boolean PduRUseTag: category=NOT_SUPPORTED, set at pre-compile  # This parameter, if set to true, enables the usage of the tag (<up>) in the following API calls: true: it enables the usage of the tag (<up>) false: it disables the usage of the tag (<up>) | * PduR_<Up>CancelReceiveRequest * PduR_<Up>CancelTransmitRequest * PduR_<Up>ChangeParameterRequest Example: If used by COM and the parameter is enabled the PduR_ComCancelTransmitRequest is used. The background is that upper layer modules differ in usage of this tag (e.g. COM is using the tag, DCM is not).
      foreign reference PduRBswModuleRef: set at pre-compile, destination-type=ECUC-MODULE-CONFIGURATION-VALUES  # This is a reference to one BSW module's configuration (i.e. not the ECUC parameter definition template). | Example, there could be several configurations of LinIf and this reference selects one of them.
    container PduRGeneral  # This container is a subcontainer of PduR and specifies the general configuration parameters of the PDU Router.
      boolean PduRDevErrorDetect: set at pre-compile  # If true then PDU Router will enable the error-reporting to the Development Error Tracer (DET). true: The PDU Router will enable the error-reporting to the Development Error Tracer (DET). false: The PDU Router will disable the error-reporting to the Development Error Tracer (DET).
      boolean PduRVersionInfoApi: set at pre-compile  # If true the PduR_GetVersionInfo API is available. true: The PduR_GetVersionInfo API is available. false: The PduR_GetVersionInfo API is unavailable.
      boolean PduRZeroCostOperation: category=NOT_SUPPORTED, set at pre-compile  # If set the PduR configuration generator will report an error if zero-cost-operation cannot be fulfilled. true: The PduR configuration generator will report an error if zero-cost-operation cannot be fulfilled. false: The PduR configuration generator will not report an error if zero-cost-operation cannot be fulfilled. | This parameter shall be seen as an input requirement to the configuration generator.
      boolean PduRRxInterruptBased: set at pre-compile, origin=AUTRON  # If true the unnecessary suspend/resume interrupt will be removed. This parameter is allowed when lower layer is configured as interrupt based indication | This parameter shall be seen as an input requirement to the configuration generator.
      boolean PduRTxInterruptBased: set at pre-compile, origin=AUTRON  # If true the unnecessary suspend/resume interrupt will be removed. This parameter is allowed when lower layer is configured as interrupt based indication | This parameter shall be seen as an input requirement to the configuration generator.
      string PduRHeaderFileInclusion [0..*]: set at pre-compile, regular-expression=[a-zA-Z0-9_]([a-zA-Z0-9\._])*  # Name of the header file(s) to be included by the PduR module.
      boolean PduRSharedGatewayIfBuffer: set at pre-compile, origin=AUTRON  # If true the unnecessary suspend/resume interrupt will be removed. This parameter is allowed when lower layer is configured as interrupt based indication | This parameter shall be seen as an input requirement to the configuration generator.
    container PduRRoutingTables: multiple-configuration-container=true  # Represents one table of routing paths. | This routing table allows multiple configurations that can be used to create several routing tables in the same configuration. This is mainly used for post-build (e.g. post-build selectable) but can be used by pre-compile and link-time for variant handling.
      integer PduRConfigurationId: 0..65534, category=FIXED, set at post-build in variant post-build / pre-compile in variant pre-compile  # Identification of the configuration of the PduR configuration. This identification can be read using the PduR API.
      integer PduRMaxRoutingPathGroupCnt [0..1]: 0..65535, category=FIXED, set at link in variant post-build / pre-compile in variant pre-compile, origin=v1.0.0  # Maximum number of RoutingPathGroups. This parameter is needed only in case of post-build loadable implementation using static memory allocation.Autosar Bugzilla #53197
      integer PduRMaxRoutingTableCnt [0..1]: 0..65535, category=FIXED, set at link in variant post-build / pre-compile in variant pre-compile, origin=v1.0.0  # Maximum number of RoutingTables. This parameter is needed only in case of post-build loadable implementation using static memory allocation.Autosar Bugzilla #53197
      integer PduRMaxRoutingPathCnt [0..1]: 0..65535, category=FIXED, set at link in variant post-build / pre-compile in variant pre-compile, origin=v1.0.0  # Maximum number of RoutingPaths in all RoutingTables. This parameter is needed only in case of post-build loadable implementation using static memory allocation.Autosar Bugzilla #53197
      container PduRRoutingPathGroup [0..65534]: post-build-changeable=true  # This container groups routing path destinations. Destinations are used instead of routing paths since a routing path can be 1:n. It is desirable to be able to enable/disable a specific bus (i.e. a destination) rather than a routing path. Of course it is possible to create groups that covers specific routing paths as well. | Enabling and disabling of routing path groups are made using the PduR API
        boolean PduRIsEnabledAtInit: set at post-build in variant post-build / pre-compile in variant pre-compile  # If set to true this routing path group will be enabled after initializing the PDU Router module (i.e. enabled in the PduR_Init function).
        integer PduRRoutingPathGroupId: 0..65534, set at post-build in variant post-build / pre-compile in variant pre-compile, symbolic-name-value=true  # Identification of the routing group. | The identification will be used by the disable/enable API in the PDU Router module API.
        reference PduRDestPduRef [1..*]: set at post-build in variant post-build / pre-compile in variant pre-compile, destination=PduRDestPdu  # This reference selects one destination of the routing path.
      container PduRRoutingTable [0..*]: post-build-changeable=true  # Represents one container of routing paths. Each container is either minimum routing or not.
        boolean PduRIsMinimumRouting: category=NOT_SUPPORTED, set at pre-compile  # Specifies if the container contains routing paths that are of the type minimum routing or not. true: It specifies that containers contain routing paths of the minimum routing type. false: It specifies that containers contain routing paths that are not of the minimum routing type.
        container PduRRoutingPath [0..*]: post-build-changeable=true  # This container is a subcontainer of PduRRoutingTable and specifies the routing path of a PDU.
          function name PduRRxIndUserCallOut [0..1]: set at pre-compile, origin=AUTRON  # Name of the callout function to be called if PduLoRxIndication() or PduR_LoTpStartOfReception is called.
          container PduRDestPdu [1..*]: post-build-changeable=true  # This container is a subcontainer of PduRRoutingPath and specifies one destination for the PDU to be routed.
            enumeration PduRDestPduDataProvision [0..1]: {PDUR_DIRECT, PDUR_TRIGGERTRANSMIT}, set at post-build in variant post-build / pre-compile in variant pre-compile  # Specifies how data are provided: direct (as part of the Transmit call) or via the TriggerTransmit callback function. Only required for non-TP I-PDUs (local and gatewayed). Direct Transmit: Data is not stored in the buffer before transmission. Trigger Transmit: Data is stored in the buffer before transmission.
            integer PduRDestPduHandleId [0..1]: 0..65535, set at post-build in variant post-build / pre-compile in variant pre-compile, symbolic-name-value=true  # PDU identifier assigned by PDU Router. Used by communication interface and transport protocol modules for confirmation.
            integer PduRTpThreshold [0..1]: 1..65535, set at post-build in variant post-build / pre-compile in variant pre-compile  # Defines the number of bytes which shall be received before transmission on the destination bus may start. Only required for routing-on-the-fly TP gateway PDUs. The threshold shall not be larger than the length of the related TP Buffer.
            boolean PduRTransmissionConfirmation [0..1]: set at pre-compile  # This parameter is only for communication interfaces. Transport protocol modules will always call the TxConfirmation function. true: Transport protocol modules will always call the TxConfirmation function. false: Transport protocol modules will not always call the TxConfirmation function. | If set the destination communication interface module will call the TxConfirmation. However the TxConfirmation may be not called due to error. So the PduR shall not block until the TxConfirmation is called. One background for this parameter is for the PduR to know when all modules have confirmed a multicast operation.
            reference PduRDestPduRef: set at post-build in variant post-build / pre-compile in variant pre-compile, destination=Pdu  # Destination PDU reference; reference to unique PDU identifier which shall be used by the PDU Router instead of the source PDU ID when calling the related function of the destination module.
            reference PduRDestTxBufferRef [0..1]: set at post-build in variant post-build / pre-compile in variant pre-compile, destination=PduRTxBuffer  # Reference to a buffer that is allocated in the PduRTxBuffer. Having a global (for PduR) list of buffers allows reusage and hence less memory consumption.
            container PduRDefaultValue [0..1]  # Specifies the default value of the I-PDU. Only required for gateway operation and if at least one PDU specified by PduRDestPdu uses TriggerTransmit Data provision. | Represented as an array of IntegerParamDef.
              container PduRDefaultValueElement [0..*]: post-build-changeable=true  # Each value element is represented by the element and the position in an array.
                integer PduRDefaultValueElement: 0..255, set at post-build in variant post-build / pre-compile in variant pre-compile  # The default value consists of a number of elements. Each element is one byte long and the number of elements is specified by SduLength. The position of this parameter in the container is specified by the PduRElementBytePosition parameter.
                integer PduRDefaultValueElementBytePosition: 0..255, set at post-build in variant post-build / pre-compile in variant pre-compile  # This parameter specifies the byte position of the element within the default value
          container PduRSrcPdu  # This container is a subcontainer of PduRRoutingPath and specifies the source of the PDU to be routed.
            integer PduRSourcePduHandleId: 0..65535, set at post-build in variant post-build / pre-compile in variant pre-compile, symbolic-name-value=true  # PDU identifier assigned by PDU Router.
            reference PduRSrcPduRef: set at post-build in variant post-build / pre-compile in variant pre-compile, destination=Pdu  # Source PDU reference; reference to unique PDU identifier which shall be used for the requested PDU Router operation.
      container PduRTpBufferTable [0..1]  # This container will specify the needed buffers for gatewaying using TP. It is not connected to the specific routing path destination to allow a more efficient buffer handling.
        integer PduRMaxTpBufferNumber [0..1]: 0..65535, set at pre-compile
        container PduRTpBuffer [0..*]  # Specifies a buffer used for gatwaying through TP.
          integer PduRTpBufferLength: 1..65535, set at pre-compile  # Length of the TP buffer in number of bytes
      container PduRTxBufferTable [0..1]  # This container will specify the needed buffers for gatewaying using communication interface. It not defined per routing path to allow reusage of buffers.
        integer PduRMaxTxBufferNumber: 0..65535, set at pre-compile  # maximum number of Tx buffers.
        container PduRTxBuffer [0..*]  # Specifies a buffer used for gatwaying through communication interface.
          integer PduRPduMaxLength: 1..255, set at pre-compile  # Length of the Tx buffer in number of bytes.
          integer PduRTxBufferDepth: 1..255, set at pre-compile  # Number of Pdus that can be stored in the buffer. If value is 1 then the buffer semantic is "last is best". If the value is greater then 1 then the buffer semnatic is a FiFo.

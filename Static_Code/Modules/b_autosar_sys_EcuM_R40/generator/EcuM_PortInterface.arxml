AUTOSAR XML (schema 4-0-3)
package /EcuM/ImplementationDataTypes
  10 x impl type, all with category=TYPE_REFERENCE:
    EcuM_BootTargetType: compu {0=ECUM_BOOT_TARGET_APP, 1=ECUM_BOOT_TARGET_OEM_BOOTLOADER, 2=ECUM_BOOT_TARGET_SYS_BOOTLOADER}, implementation-data-type=uint8
    EcuM_CallerType: implementation-data-type=uint16
    EcuM_ModeType: implementation-data-type=uint8
    EcuM_ResetType: implementation-data-type=uint8
    EcuM_ShutdownCauseType: implementation-data-type=uint8
    EcuM_StateType: compu {16=ECUM_STATE_STARTUP, 17=ECUM_STATE_STARTUP_ONE, 18=ECUM_STATE_STARTUP_TWO, 19=ECUM_STATE_STARTUP_THREE, 20=ECUM_STATE_STARTUP_FOUR, 32=ECUM_STATE_WAKEUP, 33=ECUM_STATE_WAKEUP_ONE, 34=ECUM_STATE_WAKEUP_VALIDATION, 35=ECUM_STATE_WAKEUP_REACTION, 36=ECUM_STATE_WAKEUP_TWO, 37=ECUM_STATE_WAKEUP_WAKESLEEP, 38=ECUM_STATE_WAKEUP_TTII, 48=ECUM_STATE_RUN, 50=ECUM_STATE_APP_RUN, 51=ECUM_STATE_APP_POST_RUN, 64=ECUM_STATE_SHUTDOWN, 68=ECUM_STATE_PREP_SHUTDOWN, 73=ECUM_STATE_GO_SLEEP, 77=ECUM_STATE_GO_OFF_ONE, 78=ECUM_STATE_GO_OFF_TWO, 80=ECUM_STATE_SLEEP, 128=ECUM_STATE_OFF, 144=ECUM_STATE_RESET}, implementation-data-type=uint8
    EcuM_TimeType: implementation-data-type=uint32
    EcuM_UserType: implementation-data-type=uint8
    EcuM_WakeupSourceType: implementation-data-type=uint32
    EcuM_RequestType: compu {0=ECUM_REQUEST_RUN, 1=ECUM_REQUEST_SLEEP, 3=ECUM_REQUEST_RESET, 2=ECUM_REQUEST_OFF}, implementation-data-type=uint8
package /EcuM/ModeDeclarationGroups
  mode declaration group BootTarget: category=EXPLICIT_ORDER, initial-mode=ECUM_BOOT_TARGET_APP, on-transition-value=3
    mode ECUM_BOOT_TARGET_APP: value=0
    mode ECUM_BOOT_TARGET_OEM_BOOTLOADER: value=1
    mode ECUM_BOOT_TARGET_SYS_BOOTLOADER: value=2
  mode declaration group EcuMode: category=EXPLICIT_ORDER, initial-mode=ECUM_STATE_STARTUP_ONE, on-transition-value=0
    11 x mode:
      ECUM_STATE_STARTUP_ONE: value=17
      ECUM_STATE_STARTUP_TWO: value=18
      ECUM_STATE_STARTUP_THREE: value=19
      ECUM_STATE_RUN: value=48
      ECUM_STATE_APP_RUN: value=50
      ECUM_STATE_APP_POST_RUN: value=51
      ECUM_STATE_SHUTDOWN: value=64
      ECUM_STATE_PREP_SHUTDOWN: value=68
      ECUM_STATE_SLEEP: value=80
      ECUM_STATE_OFF: value=128
      ECUM_STATE_RESET: value=144
package /EcuM/DataTypeMappingSets
  data type mapping set BootTargetMap: mode-request-type-map{implementation-data-type=EcuM_BootTargetType, mode-group=BootTarget}
  data type mapping set EcuModeMap: mode-request-type-map{implementation-data-type=EcuM_StateType, mode-group=EcuMode}
package /EcuM/ClientServerInterfaces
  5 x client server interface, all with is-service=true, service-kind=ECU-MANAGER:
    EcuM_ShutdownTarget
      10 x operation, all with possible-error=EcuM_ShutdownTarget/E_NOT_OK:
        GetLastShutdownTarget
          arg shutdownTarget: type=EcuM_StateType, direction=OUT
          arg shutdownMode: type=EcuM_ModeType, direction=OUT
        GetMostRecentShutdown
          4 x arg, all with direction=OUT:
            shutdownTarget: type=EcuM_StateType
            shutdownMode: type=EcuM_ModeType
            shutdownCause: type=EcuM_ShutdownCauseType
            shutdownTime: type=EcuM_TimeType
        GetNextRecentShutdown
          4 x arg, all with direction=OUT:
            shutdownTarget: type=EcuM_StateType
            shutdownMode: type=EcuM_ModeType
            shutdownCause: type=EcuM_ShutdownCauseType
            shutdownTime: type=EcuM_TimeType
        GetShutdownCause
          arg shutdownCause: type=EcuM_ShutdownCauseType, direction=OUT
        GetShutdownTarget
          arg shutdownTarget: type=EcuM_StateType, direction=OUT
          arg shutdownMode: type=EcuM_ModeType, direction=OUT
        GoDown
          arg caller: type=EcuM_CallerType, direction=IN
        GoHalt
        GoPoll
        SelectShutdownCause
          arg shutdownCause: type=EcuM_ShutdownCauseType, direction=IN
        SelectShutdownTarget
          arg shutdownTarget: type=EcuM_StateType, direction=IN
          arg shutdownMode: type=EcuM_ModeType, direction=IN
      5 x error:
        E_NOT_OK: error-code=1
        E_EARLIER_ACTIVE: error-code=2
        E_PAST: error-code=3
        E_NOT_ACTIVE: error-code=4
        E_NOT_ALLOWED: error-code=5
    EcuM_BootTarget
      operation GetBootTarget: possible-error=EcuM_BootTarget/E_NOT_OK
        arg target: type=EcuM_BootTargetType, direction=OUT
      operation SelectBootTarget: possible-error=EcuM_BootTarget/E_NOT_OK
        arg target: type=EcuM_BootTargetType, direction=IN
      5 x error:
        E_NOT_OK: error-code=1
        E_EARLIER_ACTIVE: error-code=2
        E_PAST: error-code=3
        E_NOT_ACTIVE: error-code=4
        E_NOT_ALLOWED: error-code=5
    EcuM_AlarmClock
      6 x operation:
        AbortWakeupAlarm: possible-error=[EcuM_AlarmClock/E_NOT_OK, EcuM_AlarmClock/E_NOT_ACTIVE]
          arg user: type=EcuM_UserType, direction=IN
        GetCurrentTime: possible-error=EcuM_AlarmClock/E_NOT_OK
          arg currentTime: type=EcuM_TimeType, direction=OUT
        GetWakeupTime: possible-error=EcuM_AlarmClock/E_NOT_OK
          arg wakeupTime: type=EcuM_TimeType, direction=OUT
        SetAbsWakeupAlarm: possible-error=[EcuM_AlarmClock/E_EARLIER_ACTIVE, EcuM_AlarmClock/E_NOT_OK, EcuM_AlarmClock/E_PAST]
          arg user: type=EcuM_UserType, direction=IN
          arg wakeupTime: type=EcuM_TimeType, direction=IN
        SetClock: possible-error=[EcuM_AlarmClock/E_NOT_OK, EcuM_AlarmClock/E_NOT_ALLOWED]
          arg user: type=EcuM_UserType, direction=IN
          arg setTime: type=EcuM_TimeType, direction=IN
        SetRelWakeupAlarm: possible-error=[EcuM_AlarmClock/E_EARLIER_ACTIVE, EcuM_AlarmClock/E_NOT_OK]
          arg user: type=EcuM_UserType, direction=IN
          arg wakeupTime: type=EcuM_TimeType, direction=IN
      5 x error:
        E_NOT_OK: error-code=1
        E_EARLIER_ACTIVE: error-code=2
        E_PAST: error-code=3
        E_NOT_ACTIVE: error-code=4
        E_NOT_ALLOWED: error-code=5
    EcuM_WakeupSource
      operation DisableWakeupSources
        arg wakeupSource: type=EcuM_WakeupSourceType, direction=IN
      operation EnableWakeupSources
        arg wakeupSource: type=EcuM_WakeupSourceType, direction=IN
      operation ClearWakeupEvent
        arg wakeupSource: type=EcuM_WakeupSourceType, direction=IN
      5 x error:
        E_NOT_OK: error-code=1
        E_EARLIER_ACTIVE: error-code=2
        E_PAST: error-code=3
        E_NOT_ACTIVE: error-code=4
        E_NOT_ALLOWED: error-code=5
    EcuM_StateRequest
      6 x operation:
        ReleaseRUN: possible-error=EcuM_StateRequest/E_NOT_OK
          arg user: type=EcuM_UserType, direction=IN
        RequestRUN: possible-error=EcuM_StateRequest/E_NOT_OK
          arg user: type=EcuM_UserType, direction=IN
        RequestSleep: possible-error=EcuM_StateRequest/E_NOT_OK
          arg user: type=EcuM_UserType, direction=IN
        RequestReset: possible-error=EcuM_StateRequest/E_NOT_OK
          arg user: type=EcuM_UserType, direction=IN
        RequestOff: possible-error=EcuM_StateRequest/E_NOT_OK
          arg user: type=EcuM_UserType, direction=IN
        SetRunState
      5 x error:
        E_NOT_OK: error-code=1
        E_EARLIER_ACTIVE: error-code=2
        E_PAST: error-code=3
        E_NOT_ACTIVE: error-code=4
        E_NOT_ALLOWED: error-code=5

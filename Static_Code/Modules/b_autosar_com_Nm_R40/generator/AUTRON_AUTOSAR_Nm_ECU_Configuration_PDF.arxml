AUTOSAR XML (schema 4-0-3)
# (C) 2013 HYUNDAI AUTRON Co., Ltd.
# Confidential Proprietary Information. Distribution Limited.
# Do Not Copy Without Prior Permission
package /AUTRON
  ecuc definition collection ParameterDefinition_Nm: module=Nm
  module definition Nm: refined-module-def=Nm, variants pre-compile  # The Generic Network Management Interface module
    container NmChannelConfig [1..*]  # This container contains the configuration (parameters) of the bus channel(s). The channel parameter shall be harmonized within the whole communication stack.
      boolean NmActiveCoordinator [0..1]: category=NOT_SUPPORTED, set at pre-compile  # This parameter indicates whether a NM Coordinator is an active gateway (NmActiveCoordinator = TRUE) or a passive. | true: Indicates that NM Coordinator is an active gateway. false: Indicates that NM Coordinator is an active gateway.
      integer NmChannelId: 0..255, set at pre-compile, symbolic-name-value=true  # This parameter holds the unique channel index value. The value shall be the same as the ComMChannelId of the ComMChannel referenced by NmComMChannelRef. | Implementation Type: NetworkHandleType
      boolean NmChannelSleepMaster: category=NOT_SUPPORTED, set at pre-compile  # This parameter shall be set to indicate if the sleep of this network can be absolutely decided by the local node only and that no other nodes can oppose that decision. | If this parameter is set to TRUE, the Nm shall assume that the channel is always ready to go to sleep and that no callouts to Nm_RemoteSleepIndication or Nm_RemoteSleepCancellation will be made from the <BusNm> representing this channel. If this parameter is set to FALSE, the Nm shall not assume that the network is ready to sleep until a callout has been made to Nm_RemoteSleepCancellation. true: Nm shall assume that the channel is always ready to go to sleep. false: Nm shall not assume that the network is ready to sleep until a callout has been made to Nm_RemoteSleepCancellation.
      integer NmCoordClusterIndex [0..1]: 0..255, category=NOT_SUPPORTED, set at pre-compile  # If this parameter is undefined for a channel, the corresponding bus does not belong to an NM coordination cluster.
      boolean NmPassiveModeEnabled: category=NOT_SUPPORTED, set at pre-compile  # Pre-processor switch for enabling support of Passive Mode of the <BusNm>s. | true: Enable support of Passive Mode of the BusNm. false: Disable support of Passive Mode of the BusNm.
      float NmShutdownDelayTimer: 0..65.535, category=NOT_SUPPORTED, set at pre-compile  # This parameter defines the time in seconds which the NM Coordination algorithm shall delay the release of this channel with.
      boolean NmStateReportEnabled: category=NOT_SUPPORTED, set at pre-compile  # Specifies if the NMS shall be set for the corresponding network. | false: No NMS shall be set true: The NMS shall be set
      function name NmStateChangeIndUserCallout [0..1]: set at pre-compile, origin=AUTRON  # Name of the callout function to be called if Nm_StateChangeNotification() is called.
      function name NmPduRxIndUserCallout [0..1]: set at pre-compile, origin=AUTRON  # Name of the callout function to be called if Nm_PduRxIndication() is called.
      boolean NmSynchronizingNetwork: category=NOT_SUPPORTED, set at pre-compile  # If this parameter is true, then this network is a synchronizing network for the NM coordination cluster which it belongs to. The network is expected to call Nm_SynchronizationPoint() at regular intervals. | true: Network is a synchronizing network false: Network is not a synchronizing network
      symbolic name reference NmComMChannelRef: set at pre-compile, destination=ComMChannel  # Reference to the corresponding ComM Channel.
      symbolic name reference NmStateReportSignalRef [0..1]: category=NOT_SUPPORTED, set at pre-compile, destination=ComSignal  # Reference to the signal for setting the NMS by calling Com_SendSignal for the respective channel.
      choice container NmBusType
        container NmGenericBusNmConfig
          string NmGenericBusNmPrefix: set at pre-compile  # The prefix which identifies the generic <BusNm>. This will be used to determine the API name to be called by Nm for the provided interfaces of the <BusNm>. This string will used for the module prefix before the "_" character in the API call name.
        container NmStandardBusNmConfig
          enumeration NmStandardBusType: {NM_BUSNM_CANNM, NM_BUSNM_FRNM, NM_BUSNM_LINNM, NM_BUSNM_UDPNM}, set at pre-compile  # Identifies the bus type of the channel for standard AUTOSAR <BusNm>s and is used to determine which set of API calls to be called by Nm for the <BusNm>s. NM_BUSNM_CANNM: CAN bus NM_BUSNM_FRNM: FlexRay bus NM_BUSNM_LINNM: LIN bus NM_BUSNM_UDPNM: Ethernet bus (using UDP) | Note: The Ethernet bus' NM is UdpNm !
    container NmGlobalConfig  # This container contains all global configuration parameters of the Nm Interface.
      container NmGlobalConstants
        integer NmNumberOfChannels: 1..255, set at pre-compile  # Number of NM channels allowed within one ECU.
      container NmGlobalFeatures
        boolean NmBusSynchronizationEnabled: category=NOT_SUPPORTED, set at pre-compile  # Pre-processor switch for enabling bus synchronization support of the <BusNm>s. This feature is required for NM Coordinator nodes only. | true: Enable bus synchronization support false: Disable bus synchronization support
        function name NmCarWakeUpCallback [0..1]: category=NOT_SUPPORTED, set at pre-compile  # Name of the callback function to be called if Nm_CarWakeUpIndication() is called.
        boolean NmCarWakeUpRxEnabled: category=NOT_SUPPORTED, set at pre-compile, default-value=false  # Enables or disables CWU detection. | false - CarWakeUp not supported true - CarWakeUp supported
        boolean NmComControlEnabled: set at pre-compile  # Pre-processor switch for enabling the Communication Control support. | true: Enable the Communication Control support. false: Disable the Communication Control support.
        boolean NmComUserDataSupport: set at pre-compile, default-value=false  # Enable/Disable setting of NMUserData via SW-C. If NmComUserDataSupport is enabled the API Nm_SetUserData shall not be available. | true: Enable setting of NMUserData via SW-C. false: Disable setting of NMUserData via SW-C.
        boolean NmCoordinatorSupportEnabled: category=NOT_SUPPORTED, set at pre-compile, default-value=false  # Pre-processor switch for enabling NM Coordinator support. | true: Enable NM Coordinator support. false: Disable NM Coordinator support.
        float NmGlobalCoordinatorTime [0..1]: 0..65.535, category=NOT_SUPPORTED, set at pre-compile  # This parameter defines the maximum shutdown time of a connected and coordinated NM-Cluster. | Note:This includes nested connections.
        boolean NmNodeDetectionEnabled: set at pre-compile  # Pre-processor switch for enabling the Node Detection feature. | true: Enable the Node Detection feature. false: Disable the Node Detection feature.
        boolean NmNodeIdEnabled: set at pre-compile  # Pre-processor switch for enabling transmission of the source node identifier in NM messages. | true: Enable transmission of the source node identifier in NM messages. false: Disable transmission of the source node identifier.
        boolean NmPduRxIndicationEnabled: set at pre-compile  # Pre-processor switch for enabling the PDU Rx Indication. | true: Enable the PDU Rx Indication. false: Disable the PDU Rx Indication.
        boolean NmRemoteSleepIndEnabled: category=NOT_SUPPORTED, set at pre-compile  # Pre-processor switch for enabling Remote Sleep Indication support. This feature is required for NM Coordinator nodes only. | true: Enable Remote Sleep Indication support. false: Disable Remote Sleep Indication support.
        boolean NmRepeatMsgIndEnabled: category=NOT_SUPPORTED, set at pre-compile  # Pre-processor switch for enabling the Repeat Message Bit Indication. | true: Enable the Repeat Message Bit Indication. false: Disable the Repeat Message Bit Indication.
        boolean NmStateChangeIndEnabled: set at pre-compile  # Pre-processor switch for enabling the Network Management state change notification. | true: Enable the Network Management state change notification. false: Disable the Network Management state change notification.
        boolean NmUserDataEnabled: set at pre-compile  # Pre-processor switch for enabling User Data support. | true: Enable User Data support. false: Disable User Data support.
        string NmHeaderFileInclusion [0..*]: set at pre-compile, origin=AUTRONv_1.0.0, regular-expression=[a-zA-Z0-9_]([a-zA-Z0-9\._])*  # Name of the header file(s) to be included by the Nm module.
        boolean NmCoordinatorSyncSupport: category=NOT_SUPPORTED, set at pre-compile, default-value=false  # Pre-processor switch for enabling Coordinator Sync Support. | true: Enable Coordinator Sync Support. false: Disable Coordinator Sync Support.
      container NmGlobalProperties
        float NmCycletimeMainFunction: 0..65.535, set at pre-compile  # The period between successive calls to the Main Function of the NM Interface in seconds.
        boolean NmDevErrorDetect: set at pre-compile, default-value=false  # Pre-processor switch for enabling development error detection and notification. | true: Enable development error detection and notification. false: Disable development error detection and notification.
        boolean NmVersionInfoApi: set at pre-compile, default-value=false  # Pre-processor switch for enabling Version Info API support. | true: Enable Version Info API support. false: Disble Version Info API support.

AUTOSAR XML (schema 4-0-3)
# (C) 2018~2019 HYUNDAI AUTRON Co., Ltd.
# Confidential Proprietary Information. Distribution Limited.
# Do Not Copy Without Prior Permission
package /AUTRON
  ecuc definition collection ParameterDefinition_CryptoLib: module=CryptoLib
  module definition CryptoLib: variants pre-compile  # Configuration Parameters for the CryptoLib module.
    container CryptoLibGeneral  # General configuration parameters of CryptoLib.
      enumeration CryptoLibSupportHsm [0..1]: {HAE_HSM_2_X, ICUS, ICUM, SPC584BX, SPC584CX, SPC58ECX, SPC58XEX, SPC58XGX, CSEC}, category=FIXED, origin=AUTRON
      boolean CryptoLibEnableDevInfo: category=FIXED, origin=AUTRON, default-value=false
    container CryptoLibAutronHsm [0..1]  # Configuration parameters for Autron Hsm driver
      boolean CryptoLibUseOs [0..1]: category=FIXED, origin=AUTRON, default-value=false
      enumeration CryptoLibSupportECU [0..1]: {IAU}, category=FIXED, origin=AUTRON
    container CryptoLibHaeHsm [0..1]  # Configuration parameters for Autron Hsm driver
      integer CryptoLibHaeHsmTimeout: 1..4294967295, default-value=100000000
      integer CryptoLibHaeHsmMaxErrorCount: 1..4294967295, default-value=20
    container CryptoLibAutronIcus [0..1]  # Configuration parameters for Autron ICUS driver
      integer CryptoLibAutronIcusTimeoutLevel1: 0..4294967295, category=FIXED, origin=AUTRON, default-value=512  # This parameter is used for internal purpose.
      integer CryptoLibAutronIcusTimeoutLevel2: 0..4294967295, category=FIXED, origin=AUTRON, default-value=8192  # This parameter is used for internal purpose.
      integer CryptoLibAutronIcusTimeoutLevel3: 0..4294967295, category=FIXED, origin=AUTRON, default-value=262144  # This parameter is used for internal purpose.
      integer CryptoLibAutronIcusTimeoutLevel4: 0..4294967295, category=FIXED, origin=AUTRON, default-value=1048575  # This parameter is used for internal purpose.
      boolean CryptoLibAutronIcusSupportDebugCommand: category=FIXED, origin=AUTRON, default-value=false  # Pre-processor switch to enable and disable CMD_DEBUG command. This feature needs the third-party algorithm library (HAE CryptoLib).
    container CryptoLibAutronCsec [0..0]  # Configuration parameters for Autron CSEc driver
      integer CryptoLibAutronCsecTimeout: 0..4294967295, origin=AUTRON, default-value=1048575  # Internal timeout for CSEc
      enumeration CryptoLibAutronCsecFlashKeySize: {CSEC_NO_FLASH_KEYS, CSEC_5_FLASH_KEYS, CSEC_10_FLASH_KEYS, CSEC_20_FLASH_KEYS}, origin=AUTRON, default-value=CSEC_20_FLASH_KEYS  # Number of flash keys for CSEc
      enumeration CryptoLibAutronCsecSecurityFlagExtension: {CSEC_FLASH_KEY_VERIFY_ONLY_DISABLED, CSEC_FLASH_KEY_VERIFY_ONLY_ENABLED}, origin=AUTRON, default-value=CSEC_FLASH_KEY_VERIFY_ONLY_DISABLED  # Flash key Verify Only attribute option
      enumeration CryptoLibAutronCsecFlexRAMLoadOption: {CSEC_FLEXRAM_LOADED_EEPROM_DATA, CSEC_FLEXRAM_NOT_LOADED}, origin=AUTRON, default-value=CSEC_FLEXRAM_LOADED_EEPROM_DATA  # FlexRAM load during reset option
      enumeration CryptoLibAutronCsecEEPROMDataSetSizeCode: {CSEC_EEPROM_DATA_SET_SIZE_0B, CSEC_EEPROM_DATA_SET_SIZE_2KB, CSEC_EEPROM_DATA_SET_SIZE_4KB}, origin=AUTRON, default-value=CSEC_EEPROM_DATA_SET_SIZE_4KB  # EEPROM data set size
      enumeration CryptoLibAutronCsecFlexNVMPartitionCode: {CSEC_EEPROM_BACKUP_SIZE_0B, CSEC_EEPROM_BACKUP_SIZE_24KB, CSEC_EEPROM_BACKUP_SIZE_32KB, CSEC_EEPROM_BACKUP_SIZE_48KB, CSEC_EEPROM_BACKUP_SIZE_64KB}, origin=AUTRON, default-value=CSEC_EEPROM_BACKUP_SIZE_64KB  # EEPROM-backup size
      integer CryptoLibAutronCsecSecureBootSize: 1..4294967295, origin=AUTRON, default-value=8192  # The size in bits of the area to be checked for integrity by the secure boot process. The secure boot is run on the program flash block starting at address '0' and finishing at this bits size.
      enumeration CryptoLibAutronCsecSecureBootFlavor: {CSEC_SECURE_BOOT_NONE, CSEC_SECURE_BOOT_SERIAL, CSEC_SECURE_BOOT_PARALLEL, CSEC_SECURE_BOOT_STRICT}, origin=AUTRON, default-value=CSEC_SECURE_BOOT_NONE  # Boot Flavor CSEC_SECURE_BOOT_NONE : No secure boot defined. CSEC_SECURE_BOOT_SERIAL : Application shall boot only after successful completion of secure boot. CSEC_SECURE_BOOT_PARALLEL : Secure boot and application boot shall happen in parallel. Also even if the secure boot fails, the application shall boot. CSEC_SECURE_BOOT_STRICT : If secure boot fails, the chip will not boot at all and will remain stuck in reset. Once set can't be changed.
      boolean CryptoLibAutronCsecSecureBootApply: origin=AUTRON, default-value=false  # Whether the secure boot configurations are applied. true : try to apply secure boot configurations when initializing CSEc false : Do not try to apply secure boot configurations when initializing CSEc

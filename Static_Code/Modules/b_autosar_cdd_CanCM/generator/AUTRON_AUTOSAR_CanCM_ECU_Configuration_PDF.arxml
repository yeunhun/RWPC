AUTOSAR XML (schema 4-0-3)
# (C) 2013 HYUNDAI AUTRON Co., Ltd.
# Confidential Proprietary Information. Distribution Limited.
# Do Not Copy Without Prior Permission
package /AUTRON
  ecuc definition collection ParameterDefinition_CanCM: module=CanCM
  module definition CanCM: variants pre-compile  # Configuration Parameters for the CanCM module.
    container CanCMGlobalConfig  # This container contains the global configuration parameter of the CanCM. | This container is a MultipleConfigurationContainer (only for variant 3), i.e. this container and its sub-containers exit once per configuration set.
      boolean CanCMVersionInfoApi: category=FIXED, set at pre-compile, default-value=false  # Enabling Version Info API
      boolean CanCMDevErrorDetect: category=FIXED, set at pre-compile, default-value=false  # Pre-processor switch for enabling development error detection support. | true:API parameter checking is enabled. false:API parameter checking is disabled.
      float CanCMMainFunctionPeriod: 0.001..1, category=FIXED, set at pre-compile  # Period of invoking CanCM_MainFunction in seconds .
      boolean CanCMDemStatusReport: category=FIXED, set at pre-compile, default-value=true  # Precompile option for voltage status reporting to Dem
      boolean CanCMDisableDMOnAbnormalVoltage: category=FIXED, default-value=true  # Precompile option to disable deadline monitoring on abnormal voltage in order to prevent recording DTC by signal timeout
      boolean CanCMWakeupSupport: category=FIXED, default-value=true  # Precompile option for wake-up support to check port pin assigned as wake-up source
      boolean CanCMHysteresisSupport: category=FIXED, default-value=false  # Precompile option for hysteresis support to decide recovery from voltage error
      integer CanCMFilteringConstant: 0..255, default-value=128  # Link-time option for filtering Adc value for battery voltage
      function name CanCMNetworkActivationCallout [0..1]: set at pre-compile, origin=AUTRON  # Name of the callout function to be called if NetworkActivation Timer is zero and Tx enable
    container CanCMChannelConfig [1..*]  # This container contains the global configuration parameter of the CanCM. | This container is a MultipleConfigurationContainer (only for variant 3), i.e. this container and its sub-containers exit once per configuration set.
      integer CanCMChannelId: 0..255, category=FIXED, set at pre-compile  # Channel Identifier. | This parameter specifies channel identifier
      float CanCMNetworkActivationTime: 0..60, set at pre-compile  # Time interval between Network Start-up and Network Activation specified in seconds. | This parameter specifies time interval between Network Start-up and Network Activation.
      float CanCMVoltageErrorDelayTime: 0.001..60, set at pre-compile  # Time which the CanCM shall wait before voltage mode transition from voltage critical to voltage non-critical specified in seconds. | This parameter specifies the time which the CanCM shall wait before voltage mode transition from voltage critical to voltage non-critical in seconds.
      float CanCMTimeoutMonitoringStartTime: 0.001..60, set at pre-compile  # Time(in seconds) which the CanCM shall wait before starting Reception DM of the Com module | This parameter specifies the time which the CanCM shall wait before starting Reception Deadline Monitoring of the Com module
      float CanCMVoltageAbnormalUpper: 0..4096, set at pre-compile  # upper limit of abnormal voltage range | This parameter specifies upper limit of abnormal voltage range.
      float CanCMVoltageAbnormalLower: 0..4096, set at pre-compile  # lower limit of abnormal voltage range | This parameter specifies lower limit of abnormal voltage range.
      float CanCMVoltageCriticalUpper: 0..4096, set at pre-compile  # upper limit of critical voltage range | This parameter specifies upper limit of critical voltage range.
      float CanCMVoltageCriticalLower: 0..4096, set at pre-compile  # lower limit of critical voltage range | This parameter specifies lowerlimit of critical voltage range.
      float CanCMVoltageHysteresis: 0..4096, default-value=0  # Hysteresis value | This parameter specifies hysteresis value to decide voltage recovery.
      reference CanCMComMChannelId: category=FIXED, set at pre-compile, destination=ComMChannel  # Reference to the ComM channel that is mapped to this CanCMChannel instance.
      container CanCMDemEventParameterRefs [0..1]: category=FIXED
        reference CANCM_E_BAT_FAIL: destination=DemEventParameter
      container CanCMWakeupParameterRefs [0..1]: category=FIXED
        reference CanCMEcuMWakeupSourceRef: category=FIXED, destination=EcuMWakeupSource
        reference CanCMIoHwAbWakeupPinNameRef: category=FIXED, destination=IoHwAbDigitalDirectLogical
    container CanCMBatMonConfig [1..10]
      integer CanCMAdcDefault: 0..65535, default-value=500  # Initial value for ADC buffer saving battery voltage | ADC buffer saving battery voltage shall be initialized with this value
      reference CanCMBatAnalogInputRef: set at pre-compile, destination=IoHwAbAnalogInputDirectLogical  # Reference to AdcGroup container that is used for battery voltage acquisition

AUTOSAR XML (schema 4-0-3)
# (C) 2013 HYUNDAI AUTRON Co., Ltd.
# Confidential Proprietary Information. Distribution Limited.
# Do Not Copy Without Prior Permission
package /AUTRON
  ecuc definition collection ParameterDefinition_RamTst: module=RamTst
  module definition RamTst: refined-module-def=RamTst, variants pre-compile  # Module Description.
    container RamTstCommon  # This container holds a list of all available functions in the RamTst module.Each function is turned ON or OFF before compiling so that only the desired functions and test algorithms are in the compiled code.
      boolean RamTstAllowApi: set at pre-compile  # Preprocessor switch to disable/enable the function "RamTst_Allow". | true:Preprocessor switch will be enabled. false:Preprocessor switch will be disabled.
      boolean RamTstChangeNumOfTestedCellsApi: set at pre-compile  # Preprocessor switch to disable/enable the function "RamTst_ChangeNumberOfTestedCells". | true:Preprocessor switch will be enabled. false:Preprocessor switch will be disabled.
      boolean RamTstDevErrorDetect: set at pre-compile  # Preprocessor switch to select the development error tracer (DET) | true:development error tracer ON. false:development error tracer OFF.
      boolean RamTstGetAlgParamsApi: set at pre-compile  # Preprocessor switch to disable/enable the function RamTst_GetAlgParams. | true:Preprocessor switch will be enabled. false:Preprocessor switch will be disabled.
      boolean RamTstGetExecutionStatusApi: set at pre-compile  # Preprocessor switch to disable/enable the function | true: Enable the function RamTst_GetExecutionStatus. false: Disable the function RamTst_GetExecutionStatus.
      boolean RamTstGetNumberOfTestedCellsApi: set at pre-compile  # Preprocessor switch to disable/enable the function RamTst_GetNumberOfTestedCells. | true: Enable the function RamTst_GetNumberOfTestedCells. false: Disable the function RamTst_GetNumberOfTestedCells.
      boolean RamTstGetTestAlgorithmApi: set at pre-compile  # Preprocessor switch to disable / enable the function | true: Enable the function RamTst_GetTestAlgorithm. false: Disable the function RamTst_GetTestAlgorithm.
      boolean RamTstGetTestResultApi: set at pre-compile  # Preprocessor switch to disable/enable the function | true: Enable the function RamTst_GetTestResult. false: Disable the function RamTst_GetTestResult.
      boolean RamTstGetTestResultPerBlockApi: set at pre-compile  # Preprocessor switch to disable / enable the function | true: Enable the function RamTst_GetTestResultPerBlock. false: Disable the function RamTst_GetTestResultPerBlock.
      boolean RamTstGetVersionInfoApi: set at pre-compile  # Preprocessor switch to disable/enable the function | true: Enable the function RamTst_GetVersionInfo. false: Disable the function RamTst_GetVersionInfo.
      boolean RamTstResumeApi: set at pre-compile  # Preprocessor switch to disable/enable the function RamTst_Resume. | true: Enable the function RamTst_Resume. false: Disable the function RamTst_Resume.
      boolean RamTstRunFullTestApi: set at pre-compile  # Preprocessor switch to disable / enable the function | true: Enable the function RamTst_RunFullTest. false: Disable the function RamTst_RunFullTest.
      boolean RamTstRunPartialTestApi: set at pre-compile  # Preprocessor switch to disable / enable the function | true: Enable the function RamTst_RunPartialTest. false: Disable the function RamTst_RunPartialTest.
      boolean RamTstSelectAlgParamsApi: set at pre-compile  # Preprocessor switch to disable / enable the function RamTst_SelectAlgParams. | true: Enable the function RamTst_SelectAlgParams. false: Disable the function RamTst_SelectAlgParams.
      boolean RamTstStopApi: set at pre-compile  # Preprocessor switch to disable / enable the function | true: Enable the function RamTst_Stop. false: Disable the function RamTst_Stop.
      boolean RamTstSuspendApi: set at pre-compile  # Preprocessor switch to disable / enable the function RamTst_Suspend. | true: Enable the function RamTst_Suspend. false: Disable the function RamTst_Suspend.
      enumeration RamTstParityBit [0..1]: {EVEN_PARITY, ODD_PARITY}, set at pre-compile, origin=AUTRON  # Every word of the memory is extended by one bit (the parity bit) which completes each word to an even or odd number of logical 1s.
      boolean RamTstChkTransitionOneToZero [0..1]: set at pre-compile, origin=AUTRON  # Preprocessor switch to select the extra check in Pattern Test ON or OFF. | true: Enable Preprocessor switch to select the extra check in Pattern Test ON. false: Disable Preprocessor switch to select the extra check in Pattern Test OFF.
      enumeration RamTstCrcAlgorithm [0..1]: {RAMTST_CRC_8, RAMTST_CRC_8H2F, RAMTST_CRC_16, RAMTST_CRC_32}, set at pre-compile, origin=AUTRON  # This is the coverage of the defined RamTstAlgParams setNote that the same algorithm can be used in more than one RamTstAlgParams.
      container RamTstAlgorithms  # This container holds all of the available test algorithms for the specific microcontroller.Each test algorithm is selected ON or OFF before compiling so that only the desired test algorithms are in the compiled code.
        boolean RamTstAbrahamTestSelected [0..0]: category=NOT_SUPPORTED, set at pre-compile  # Preprocessor switch to select the Abraham Test ON or OFF | true: Abraham Test ON. false: Abraham Test OFF.
        boolean RamTstCheckerboardTestSelected [0..0]: category=NOT_SUPPORTED, set at pre-compile  # Preprocessor switch to select the Checkerboard Test ON or OFF | true: Checkerboard Test ON. false: Checkerboard Test OFF.
        boolean RamTstGalpatTestSelected [0..0]: category=NOT_SUPPORTED, set at pre-compile  # Preprocessor switch to select the Galpat Test ON or OFF | true: Galpat Test ON. false: Galpat Test OFF.
        boolean RamTstMarchTestSelected [0..0]: category=NOT_SUPPORTED, set at pre-compile  # Preprocessor switch to select the March Test ON or OFF | true: March Test ON. false: March Test OFF.
        boolean RamTstTranspGalpatTestSelected [0..0]: category=NOT_SUPPORTED, set at pre-compile  # Preprocessor switch to select the Transparent Galpat Test ON or OFF | true: Transparent Galpat Test ON. false: Transparent Galpat Test OFF.
        boolean RamTstWalkPathTestSelected [0..0]: category=NOT_SUPPORTED, set at pre-compile  # Preprocessor switch to select the Walking Path Test ON or OFF | true: Walking Path Test ON. false: Walking Path Test OFF.
        boolean RamTstLowCoverageTestSelected: set at pre-compile, origin=AUTRON  # Preprocessor switch to select the test with low coverage ON or OFF | true: Low coverage ON. false: Low coverage OFF.
        boolean RamTstMediumCoverageTestSelected: set at pre-compile, origin=AUTRON  # Preprocessor switch to select the test with Medium coverage ON or OFF | true: Medium coverage ON. false: Medium coverage OFF.
        boolean RamTstHighCoverageTestSelected: set at pre-compile, origin=AUTRON  # Preprocessor switch to select the test with high coverage ON or OFF | true: High coverage ON. false: High coverage OFF.
      container RamTstConfigParams  # This container specifies configuration parameters which are set at pre-compile or link time.
        integer RamTstDefaultAlgParamsId: 1..255, set at pre-compile  # This is the identifier for the default RamTstAlgParams valid after the RamTst_Init(..) function. It is the initial value for a RAM variable which could be changed by the function "RamTst_SelectAlgParams".
        integer RamTstMinNumberOfTestedCells: 1..4294967295, set at pre-compile  # Minimum number of tested cells for one cycle of a background test, as defined by implementer.
        integer RamTstNumberOfAlgParamSets: 1..255, set at pre-compile  # Number of configured parameter sets for the available test algorithms. | calculationFormula = count of the container RamTst_AlgParams
        function name RamTstTestCompletedNotification: category=FIXED, set at pre-compile  # This function will be called from a background test after finishing the RAM test without an error. If the background test is not used, this paramater can be configured to NULL_PTR.
        function name RamTstTestErrorNotification: category=FIXED, set at pre-compile  # This function will be called from a background test if an error occurs during the RAM test. If the background test is not used, this paramater can be configured to NULL_PTR.
        container RamTstAlgParams [1..255]  # This container holds parameters for configuring an algorithm. For each algorithm selected in the RamTst_Algorithms container there can be one or more RamTstAlgParams containers. The multiplicity of the included container RamTstBlockParams depends on the number of separate blocks of RAM which are defined for the particular test configuration.
          integer RamTstAlgParamsId: 1..255, set at pre-compile  # This is the identifier by which this RamTstAlgParams set can be selected.
          enumeration RamTstAlgorithm [0..0]: {RAMTST_ABRAHAM_TEST, RAMTST_CHECKERBOARD_TEST, RAMTST_GALPAT_TEST, RAMTST_MARCH_TEST, RAMTST_TRANSP_GALPAT_TEST, RAMTST_WALK_PATH_TEST}, category=NOT_SUPPORTED, set at pre-compile  # This is the algorithm for which this RamTstAlgParams set is defined. Note that the same algorithm can be used in more than one RamTstAlgParams.. | Constraint: Only the algorithms selected by RamTstCommon/ RamTstAlgorithms can be used.
          enumeration RamTstAlgorithmCoverage: {RAMTST_ALGORITHM_COVERAGE_LOW, RAMTST_ALGORITHM_COVERAGE_MEDIUM, RAMTST_ALGORITHM_COVERAGE_HIGH}, set at pre-compile, origin=AUTRON  # This is the coverage of the defined RamTstAlgParams set.Note that the same algorithm can be used in more than one RamTstAlgParams | Constraint: Only the algorithms selected by RamTstCommon/ RamTstAlgorithms can be used.
          integer RamTstExtNumberOfTestedCells: 1..4294967295, set at pre-compile  # This is the absolute maximum value for the number of cells that NUMBER_OF_TESTED_CELLS and MAX_NUMBER_OF_TESTED_CELLS can be.
          integer RamTstMaxNumberOfTestedCells: 1..4294967295, set at pre-compile  # This is the maximum value for the number of cells that can be tested in one cycle of a background test.
          integer RamTstNumberOfBlocks: 1..65535, set at pre-compile  # Number of RAM blocks configured using the container | "RamTst_BlockParams" calculationFormula = Count of RamTstBlockParams contained in this RamTstAlgParams.
          integer RamTstNumberOfTestedCells: 1..4294967295, set at pre-compile  # This is the initial value for a RAM variable, which can be changed by the function RamTst_ChangeNumberOfTestedCells
          container RamTstBlockParams [1..65535]  # This container holds the description for one block of RAM. For each RAM block to be tested by a given algorithm, there is one container which describes the block. Multiple instances of this container are included in each container RamTst_AlgParams.
            integer RamTstBlockId: 1..65535, set at pre-compile  # ID of the RAM block
            integer RamTstStartAddress: 1..4294967295, set at pre-compile  # Start Address of the RAM block. | Constraint: It must be smaller than the RamTstEndAddress.
            integer RamTstEndAddress: 1..4294967295, set at pre-compile  # End Address of the RAM block. | Constraint: It must be larger than the RamTstStartAddress.
            integer RamTstFillPattern: 0..4294967295, set at pre-compile  # Pattern to be filled into each memory cell after destructive test of this block.
            enumeration RamTstTestPolicy: {RAMTEST_DESTRUCTIVE, RAMTEST_NON_DESTRUCTIVE}, set at pre-compile  # Policy regading destruction or non-destruction of memory content.
    container RamTstDemEventParameterRefs [0..1]  # Container to refer to DemEventParameter elements which shall be invoked using the API Dem_ReportErrorStatus in case the corresponding error occurs. The EventId is taken from the referenced DemEventParameters DemEventId value. | The standardized errors are provided in the container and can be extended by vendor-specific error references.
      symbolic name reference RAMTST_E_RAM_FAILURE [0..1]: set at pre-compile, destination=DemEventParameter  # Reference to the DemEventParameter which shall be issued when the error RAM failure has occurred.
    container RamTstPublishedInformation  # Container holding all RamTst specific published information parameter.
      integer RamTstCellSize: 1..64, category=FIXED, set at published-information  # Size of RAM cells (in bits) which can be tested individually by the given implementation.

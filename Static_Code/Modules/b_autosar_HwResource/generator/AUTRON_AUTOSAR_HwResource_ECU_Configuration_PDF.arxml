AUTOSAR XML (schema 4-0-3)
# (C) 2015-2020 HYUNDAI AUTRON Co., Ltd.
# Confidential Proprietary Information. Distribution Limited.
# Do Not Copy Without Prior Permission
package /AUTRON
  ecuc definition collection ParameterDefinition_HwResource: module=HwResource
  module definition HwResource: variants pre-compile  # Configuration Parameters for the HwResource module.
    container HwResourceGeneral  # General configuration parameters of HwResource.
      reference HwResourceMcuPackageType: destination=HwResourcePackage
      container HwResourceVendor [1..*]
        container HwResourceFamily [1..*]
          container HwResourceMcu [1..*]
            container HwResourcePackage [1..*]
    container FeatureDefinition [0..*]
      string HwResourceFeatureValue [0..1]

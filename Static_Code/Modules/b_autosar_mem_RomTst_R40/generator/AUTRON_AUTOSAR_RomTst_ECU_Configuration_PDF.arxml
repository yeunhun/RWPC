AUTOSAR XML (schema 4-0-1)
package /AUTRON
  ecuc definition collection AUTOSARParameterDefinition_RomTst: module=RomTst
  module definition RomTst [0..1]: post-build-variant-support=true, variants post-build/pre-compile
    container RomTstConfigSet  # This container contains the configuration parameters and sub containers of the RomTst module.
      integer RomTstBlockNumberBgnd: 0..4294967295, category=NOT_SUPPORTED, post-build-variant-value=true, set at post-build in variant post-build / pre-compile in variant pre-compile  # This parameter shall represent the number of test blocks available for the background test. | calculationFormula = Number of configured RomTstBlocks in the RomTstBlockBgndConfigSet (or 0 if no RomTstBlocks are configured).
      integer RomTstBlockNumberFgnd: 0..4294967295, category=NOT_SUPPORTED, post-build-variant-value=true, set at post-build in variant post-build / pre-compile in variant pre-compile  # This parameter shall represent the number of test blocks available for the foreground test. | calculationFormula = Number of configured RomTstBlocks in the RomTstBlockFgndConfigSet (or 0 if no RomTstBlocks are configured).
      function name RomTstTestCompletedNotification: set at pre-compile, origin=AUTOEVER  # Entry address of the common callback routine which shall be invoked on termination of background testing
      container RomTstBlockBgnd [0..*]  # This container specifies configuration parameters for an individual background test block.
        integer RomTstBgndBlockIndex: 0..4294967295, set at pre-compile, symbolic-name-value=true  # The scheduling for background test shall follow an order defined by this index. '0' means highest priority.
        integer RomTstCrcAreaAddressFirst: 0..18446744073709551615, origin=AUTRON, post-build-variant-value=true, set at post-build in variant post-build / pre-compile in variant pre-compile  # Address of the signature reference value of the Flash test block.
        integer RomTstCrcAreaAddressSecond [0..1]: 0..18446744073709551615, origin=AUTRON, post-build-variant-value=true, set at post-build in variant post-build / pre-compile in variant pre-compile  # Address of the signature reference value of the Flash test block.
        integer RomTstBlockBaseAddress: 0..18446744073709551615, category=NOT_SUPPORTED, post-build-variant-value=true, set at post-build in variant post-build / pre-compile in variant pre-compile  # Start Address of the Flash block.
        integer RomTstBlockSize: 0..4294967295, category=NOT_SUPPORTED, post-build-variant-value=true, set at post-build in variant post-build / pre-compile in variant pre-compile  # This parameter shall represent the Flash Test block size.
        integer RomTstSignatureAddress: 0..18446744073709551615, category=NOT_SUPPORTED, post-build-variant-value=true, set at post-build in variant post-build / pre-compile in variant pre-compile  # Address of the signature reference value of the Flash test block.
        enumeration RomTstTestAlgorithm: {FLSTST_16BIT_CRC, FLSTST_32BIT_CRC, FLSTST_8BIT_CRC, FLSTST_CHECKSUM, FLSTST_DUPLICATED_MEMORY, FLSTST_ECC}, category=FIXED, post-build-variant-value=true, set at post-build in variant post-build / pre-compile in variant pre-compile, default-value=FLSTST_16BIT_CRC  # This is the configuration of the test algorithm. The availability of algorithm is implementation specific.
      container RomTstBlockFgnd [0..*]  # This container specifies configuration parameters for an individual foreground test block.
        integer RomTstFgndBlockIndex: 0..4294967295, set at pre-compile, symbolic-name-value=true  # Index identifies block to be tested by RomTst_StartFgnd();
        integer RomTstCrcAreaAddressFirst: 0..18446744073709551615, origin=AUTRON, post-build-variant-value=true, set at post-build in variant post-build / pre-compile in variant pre-compile  # Address of the signature reference value of the Flash test block.
        integer RomTstCrcAreaAddressSecond [0..1]: 0..18446744073709551615, origin=AUTRON, post-build-variant-value=true, set at post-build in variant post-build / pre-compile in variant pre-compile  # Address of the signature reference value of the Flash test block.
        integer RomTstBlockBaseAddress: 0..18446744073709551615, category=NOT_SUPPORTED, post-build-variant-value=true, set at post-build in variant post-build / pre-compile in variant pre-compile  # Start Address of the Flash block.
        integer RomTstBlockSize: 0..4294967295, category=NOT_SUPPORTED, post-build-variant-value=true, set at post-build in variant post-build / pre-compile in variant pre-compile  # This parameter shall represent the Flash Test block size.
        integer RomTstSignatureAddress: 0..18446744073709551615, category=NOT_SUPPORTED, post-build-variant-value=true, set at post-build in variant post-build / pre-compile in variant pre-compile  # Address of the signature reference value of the Flash test block.
        enumeration RomTstTestAlgorithm: {FLSTST_16BIT_CRC, FLSTST_32BIT_CRC, FLSTST_8BIT_CRC, FLSTST_CHECKSUM, FLSTST_DUPLICATED_MEMORY, FLSTST_ECC}, category=FIXED, post-build-variant-value=true, set at post-build in variant post-build / pre-compile in variant pre-compile, default-value=FLSTST_16BIT_CRC  # This is the configuration of the test algorithm. The availability of algorithm is implementation specific.
    container RomTstConfigurationOfOptApiServices [0..0]
      boolean RomTstGetCurrentStateApi: set at pre-compile, default-value=false  # Adds / removes the service RomTst_GetCurrentState() from the code.
      boolean RomTstGetErrorDetailsApi: set at pre-compile, default-value=false  # Adds / removes the service RomTst_GetErrorDetails() from the code.
      boolean RomTstGetTestResultBgndApi: set at pre-compile, default-value=false  # Adds / removes the service RomTst_GetTestResultBgnd() from the code.
      boolean RomTstGetTestResultFgndApi: set at pre-compile, default-value=false  # Adds / removes the service RomTst_GetTestResultFgnd() from the code.
      boolean RomTstGetTestSignatureBgndApi: set at pre-compile, default-value=false  # Adds / removes the service RomTst_GetTestSignatureBgnd() from the code.
      boolean RomTstGetTestSignatureFgndApi: set at pre-compile, default-value=false  # Adds / removes the service RomTst_GetTestSignatureFgnd() from the code.
      boolean RomTstStartFgndApi: set at pre-compile, default-value=false  # Adds / removes the service RomTst_StartFgnd() from the code.
      boolean RomTstSuspendResumeApi: set at pre-compile, default-value=false  # Adds / removes the services RomTst_Suspend() and RomTst_Resume() from the code.
      boolean RomTstTestEccApi: set at pre-compile, default-value=false  # Adds / removes the service RomTst_TestEcc() from the code.
      boolean RomTstVersionInfoApi: set at pre-compile, default-value=false  # Adds / removes the service RomTst_GetVersionInfo() from the code.
    container RomTstDemEventParameterRefs [0..0]  # Container for the references to DemEventParameter elements which shall be invoked using the API Dem_SetEventStatus in case the corresponding error occurs. The EventId is taken from the referenced DemEventParameter's DemEventId symbolic value. The standardized errors are provided in this container and can be extended by vendor-specific error references.
      reference FLSTST_E_FLSTST_FAILURE [0..1]: multiplicity set at pre-compile, set at pre-compile, destination=DemEventParameter  # Reference to the DemEventParameter which shall be issued when the error "Flash Failure" has occurred.
    container RomTstGeneral
      boolean RomTstDevErrorDetect: set at pre-compile, default-value=false  # Switches the development error detection and notification on or off. | * true: detection and notification is enabled. * false: detection and notification is disabled.
      float RomTstMainFunctionPeriod: 0..Inf, category=NOT_SUPPORTED, scope=ECU, set at pre-compile  # Determines the frequency at which the RomTstMainFunction is called in [s].
      integer RomTstNumberOfTestedCells [0..1]: 0..4294967295, category=NOT_SUPPORTED, set at pre-compile  # Configures the Number of cells to be tested in background mode during one scheduled task (RomTst_MainFunction() call).
      integer RomTstNumberOfTestedCellsAtomic: 0..4294967295, category=NOT_SUPPORTED, set at pre-compile  # Configures the Number of cells to be tested in background mode without checking user requests (Abort, Suspend).
      boolean RomTstTestCompletedNotificationSupported: set at pre-compile, default-value=true  # Switch to indicate that the notification is supported.
      integer RomTstTestIntervalIdEndValue: 0..4294967295, category=NOT_SUPPORTED, set at pre-compile  # Defines the end value of the Test Interval Id.
      boolean RomTstTestResultSignature: category=NOT_SUPPORTED, set at pre-compile, default-value=false  # Configures the result of the test in background mode: | True: Test Result is a signature (see SWS_FlsTst_00155, SWS_FlsTst_00054) False: Test Result is ok/not ok (see SWS_FlsTst_00153, SWS_FlsTst_00042)
      reference RomTstEcucPartitionRef [0..1]: category=NOT_SUPPORTED, scope=ECU, multiplicity set at pre-compile, post-build-variant-multiplicity=true, post-build-variant-value=true, set at pre-compile, destination=EcucPartition  # Maps the Flash test driver to zero or one ECUC partition to make the driver API available in this partition. Tags: atp.Status=draft

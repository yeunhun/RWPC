AUTOSAR XML (schema 4-0-1)
# (C) 2013 HYUNDAI AUTRON Co., Ltd.
# Confidential Proprietary Information. Distribution Limited.
# Do Not Copy Without Prior Permission
package /AUTRON
  ecuc definition collection ParameterDefinition_ComM: module=ComM
  module definition ComM: refined-module-def=ComM, variants pre-compile  # Configuration of the ComM (Communications Manager) module.
    container ComMConfigSet  # This container is the base for a multiple configuration set.
      boolean ComMPncEnabled [0..1]: set at pre-compile, default-value=false  # Defines whether in this configuration set the partial networking is enabled. | true: partial networking is enabled. false: partial networking is Disabled.
      container ComMChannel [1..*]  # This container contains the configuration (parameters) of the bus channel(s). The channel parameters shall be harmonized within the whole communication stack.
        enumeration ComMBusType: {COMM_BUS_TYPE_CAN, COMM_BUS_TYPE_ETH, COMM_BUS_TYPE_FR, COMM_BUS_TYPE_INTERNAL, COMM_BUS_TYPE_LIN}, category=FIXED, set at pre-compile  # Identifies the bus type of the channel. | Description of Enumeration Parameter: COMM_BUS_TYPE_CAN: bus type of the channel is CAN. COMM_BUS_TYPE_ETH: bus type of the channel is Ethernet(ETH). COMM_BUS_TYPE_FR: bus type of the channel is FR. COMM_BUS_TYPE_INTERNAL:bus type of the channel is INTERNAL. COMM_BUS_TYPE_LIN: bus type of the channel is LIN.
        integer ComMChannelId: 0..255, category=FIXED, set at pre-compile, symbolic-name-value=true  # Channel identification number of the corresponding channel.
        boolean ComMFullCommRequestNotificationEnabled: category=NOT_SUPPORTED, set at pre-compile, default-value=false  # Defines if the optional SenderReceiver Port of Interface ComM_CurrentChannelRequest will be provided for this channel. | true: SenderReceiver Port of Interface ComM_CurrentChannelRequest is Enabled. false: SenderReceiver Port of Interface ComM_CurrentChannelRequest is Disabled.
        boolean ComMGlobalNvmBlockDescriptor: category=NOT_SUPPORTED, set at pre-compile, default-value=false  # If this parameter is set to "true", the NoWakeUp inhibition state of the channel shall be stored (in some implementation specific way) in the block pointed to by ComMGlobalNvmBlockDescriptor. | true: NoWakeUp inhibition state of the channel shall be stored. false: NoWakeUp inhibition state of the channel is not stored.
        float ComMMainFunctionPeriod: 0.001..0.1, set at pre-compile, default-value=0.01  # Specifies the period in seconds that the MainFunction has to be triggered with. | Comment: ComM scheduling shall be at least as fast as the communication stack and a schedule longer than 100ms makes no sense for communication.
        boolean ComMNoCom: category=NOT_SUPPORTED, set at pre-compile, default-value=false  # Not allowed to change state of ComM channel to COMM_SILENT_COMMUNICATION or COMM_FULL_COMMUNICATION. | true: Enabled - Not allowed to switch to Communication Modes above. false: Disabled - Allowed to switch Communication Modes above. Shall be possible to change parameter during runtime with ComM API's. ECU/All channels: ComM_LimitECUToNoComMode(). Separate channels: ComM_LimitChannelToNoComMode().
        boolean ComMNoWakeup: category=NOT_SUPPORTED, set at pre-compile, default-value=false  # Defines if an ECU is not allowed to wake-up the channel. | true: Enabled (not allowed to wake-up)) false: Disabled (allowed to wake-up). This is the default/init value of a runtime variable that can be changed during runtime using ComM_PreventWakeUp().
        enumeration ComMPncGatewayType [0..1]: {COMM_GATEWAY_TYPE_ACTIVE, COMM_GATEWAY_TYPE_PASSIVE}, category=NOT_SUPPORTED, set at pre-compile  # Identifies the Partial Network Gateway behaviour of a ComMChannel. | COMM_GATEWAY_TYPE_ACTIVE: Partial Network Gateway behaviour ACTIVE. COMM_GATEWAY_TYPE_PASSIVE: Partial Network Gateway behaviour PASSIVE.
        container ComMNetworkManagement  # This container contains the configuration parameters of the networkmanagement.
          float ComMNmLightTimeout [0..1]: 0..255, set at pre-compile, default-value=10  # Defines the timeout (in seconds) after COMM_FULL_COMMUNICATION sub-state COMM_FULL_COM_READY_SLEEP is left. | The range shall be greater than 0.0 and less or equal to 255.0.
          enumeration ComMNmVariant: {FULL, LIGHT, NONE, PASSIVE}, set at pre-compile, default-value=FULL  # Defines the functionality of the networkmanagement. | Shall be harmonized with NM configuration. FULL: AUTOSAR NM available. LIGHT: No AUTOSAR NM available but the functionality to shut down a channel. NONE: No NM available. PASSIVE: AUTOSAR NM running in passive mode available.
          boolean ComMPncNmRequest: category=NOT_SUPPORTED, set at pre-compile, default-value=false  # If this parameter equals true then every time a FULL Communication is requested due to a change in the PNC state machine to PNC_REQUESTED Nm shall be called using the API Nm_NetworkRequest. | true: FULL Communication is requested. false: FULL Communication is not requested.
        container ComMUserPerChannel [0..*]  # This container contains a list of identifiers that are needed to refer to a user in the system which is linked to a channel.
          reference ComMUserChannel: category=FIXED, set at pre-compile, destination=ComMUser  # Reference to the ComMUser that corresponds to this channel user. | ImplementationType: COMM_UserHandleType
      container ComMPnc [0..*]  # This container contains the configuration of the partial network cluster (PNC).
        integer ComMPncId: 8..511, set at pre-compile, symbolic-name-value=true  # Partial network cluster identification number.
        reference ComMChannelPerPnc [1..*]: set at pre-compile, destination=ComMChannel  # Reference to the ComMChannel that is required for this PNC. | ImplementationType: COMM_ChannelType.
        reference ComMUserPerPnc [0..*]: set at pre-compile, destination=ComMUser  # Reference to the ComMUsers that correspond to this PNC. | ImplementationType: COMM_UserHandleType.
        container ComMPncComSignal [0..*]  # Represents the PncComSignals which are used to communicate the EIRA and ERA status of this PNC.
          enumeration ComMPncComSignalDirection: {RX, TX}, set at pre-compile  # Indicates the communication direction of this PncComSignal. | Shall be harmonized with NM configuration. RX: Indicates the communication direction Reception. TX: Indicates the communication direction Transmission.
          enumeration ComMPncComSignalKind: {EIRA, ERA}, set at pre-compile  # Indicates whether this PncComSignal represents EIRA or ERA PNC information. | Shall be harmonized with NM configuration. EIRA: Indicates PncComSignal is EIRA. ERA: Indicates PncComSignal is ERA.
          reference ComMPncComSignalChannelRef [0..1]: set at pre-compile, destination=ComMChannel  # Reference to the ComMChannel which is used to determine whether this PncComSignal shall participate in the active or passive role (via the parameter ComMPncGatewayType of the ComMChannel). | Not applicable if ComMPncComSignalKind is EIRA.
          symbolic name reference ComMPncComSignalRef: set at pre-compile, destination=ComSignal  # Reference to the ComSignal which is used to transport the partial network channel request information.
      container ComMUser [1..*]  # This container contains a list of identifiers that are needed to refer to a user in the system which is designated to request Communication modes.
        integer ComMUserIdentifier: 0..255, set at pre-compile, symbolic-name-value=true  # An identifier that is needed to refer to a user in the system which is designated to request Communication Modes. | ImplementationType: ComM_UserHandleType.
        reference ComMUserEcucPartitionRef [0..1]: category=NOT_SUPPORTED, set at pre-compile, destination=EcucPartition  # Denotes in which "EcucPartition" the requester is executed. When the | partition is stopped, the communication request shall be cancelled in the ComM to avoid a stay-awake situation of the bus due to a stopped partition.
    container ComMGeneral  # General configuration parameters of the Communication Manager.
      boolean ComMDevErrorDetect: category=FIXED, set at pre-compile, default-value=false  # Switches the Development Error Detection and Notification ON or OFF. | true: Development Error Detection and Notification is ON. false: Development Error Detection and Notification is OFF.
      boolean ComMDirectUserMapping [0..1]: category=NOT_SUPPORTED, set at pre-compile, default-value=false  # If this parameter is set to true the configuration tool shall automatically create a ComMUser per ComMPnc and a ComMUser per ComMChannel. | The shortName of the generated ComMUsers shall follow the following naming convention: PNCUser_ComMPncId, e.g. PNCUser_13 ChannelUser_ComMChannelId, e.g. ChannelUser_25 Restriction: ComMUser, which are created due to this configuration parameter, shall not be used by SWCs (only available for BswM).
      integer ComMEcuGroupClassification: 0..255, category=NOT_SUPPORTED, set at pre-compile, default-value=3  # Defines whether a mode inhibition affects the ECU or not. | Examples: 000: No mode inhibition can be activated. 001: Wake up inhibition can be enabled. Forcing into COMM_NO_COMMUNICATION mode shall be switched on if ComMNmVariant=PASSIVE.
      boolean ComMModeLimitationEnabled: category=NOT_SUPPORTED, set at pre-compile, default-value=false  # Enables or disables mode limitation functionality. | true:limitation functionality shall be enabled. false: limitation functionality shall be Disabled.
      boolean ComMPncGatewayEnabled [0..1]: category=NOT_SUPPORTED, set at pre-compile, default-value=false  # Enables or disables support of Partial Network Gateway. | false: Partial Networking Gateway is disabled. true: Partial Networking Gateway is enabled.
      float ComMPncPrepareSleepTimer [0..1]: 0..63, set at pre-compile  # Time in seconds the PNC state machine shall wait in PNC_PREPARE_SLEEP.
      boolean ComMPncSupport: set at pre-compile, default-value=false  # Enables or disables support of partial networking. | false: Partial Networking is disabled. true: Partial Networking is enabled.
      boolean ComMSynchronousWakeUp: category=NOT_SUPPORTED, set at pre-compile, default-value=true  # Wake up of one channel shall lead to a wake up of all channels if true. | true: Wake up of all channels is enabled. false: Wake up of all channels is disabled.
      float ComMTMinFullComModeDuration: 0.001..65, set at pre-compile, default-value=5  # Minimum time duration in seconds, spent in the COMM_FULL_COMMUNICATION sub-state COMM_FULL_COM_NETWORK_REQUESTED.
      boolean ComMVersionInfoApi: category=FIXED, set at pre-compile, default-value=false  # Switches the possibility to read the published information with the service ComM_GetPublishedInformation(). | true: possibility to read the published information is Enabled. false: possibility to read the published information is Disabled.
      boolean ComMWakeupInhibitionEnabled: category=NOT_SUPPORTED, set at pre-compile, default-value=false  # Enables or disables wake up inhibition functionality. | true: wake up inhibition functionality is enabled. false: wake up inhibition functionality is disabled.
      boolean ComMCanCMSupport [0..1]: origin=AUTRON
      boolean ComMBusloadDetectingApi [0..1]: category=FIXED, origin=AUTRON, default-value=false  # Selects support for CAN Busload Detecting Api If True, CanIfBusloadDetectingSupport should be True
      symbolic name reference ComMGlobalNvMBlockDescriptor [0..1]: category=NOT_SUPPORTED, set at pre-compile, destination=NvMBlockDescriptor  # Reference to NVRAM block containing the none volatile data. If this parameter is not configured it means that no NVRam is used at all.

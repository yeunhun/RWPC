AUTOSAR XML (schema 4-0-3)
# (C) 2013 Hyundai Autron
# Confidential Proprietary Information
# Distribution Limited
# Do Not Copy Without Prior Permission
package /AUTRON
  ecuc definition collection AUTRONParameterDefinition_OsekNm: module=OsekNm
  module definition OsekNm: variants pre-compile  # Configuration Parameters for the OsekNm module.
    container OsekNmGlobalConfig  # This container contains the global configuration parameter of the OsekNm. The parameters and the parameters of the sub containers shall be mapped to the C data type OsekNm_ConfigType (for parameters where it is possible) which is passed to the OsekNm_Init function.
      boolean OsekNmBusSynchronizationEnabled: category=NOT_SUPPORTED, set at pre-compile  # Pre-processor switch for enabling bus synchronization support. This feature is required for gateway nodes only.
      boolean OsekNmComControlEnabled: set at pre-compile, symbolic-name-value=true  # Pre-processor switch for enabling the Communication Control support.
      boolean OsekNmDevErrorDetect: set at pre-compile, default-value=false  # Pre-processor switch for enabling development error detection support.
      float OsekNmMainFunctionPeriod: 0.001..0.255, set at pre-compile  # Call cycle in seconds of OsekNm_MainFunction.
      integer OsekNmNumberOfChannels: 1..255, set at pre-compile  # Number of Can NM channels allowed within one ECU.
      boolean OsekNmPassiveModeEnabled: category=NOT_SUPPORTED, set at pre-compile  # Pre-processor switch for enabling support of the Passive Mode.
      boolean OsekNmPduRxIndicationEnabled: set at pre-compile  # Pre-processor switch for enabling the PDU Rx Indication.
      boolean OsekNmRemoteSleepIndEnabled: category=NOT_SUPPORTED, set at pre-compile  # Pre-processor switch for enabling remote sleep indication support. This feature is required for gateway nodes only.
      boolean OsekNmStateChangeIndEnabled: category=NOT_SUPPORTED, set at pre-compile  # Pre-processor switch for enabling the CAN NM state change notification.
      boolean OsekNmUserDataEnabled: set at pre-compile  # Pre-processor switch for enabling user data support.
      boolean OsekNmVersionInfoApi: set at pre-compile, default-value=false  # Pre-processor switch for enabling version info API support.
    container OsekNmChannelConfig [1..*]  # This container contains the channel specific configuration parameter of the OsekNm.
      float OsekNmTimeoutMax: 0..65.535, set at pre-compile  # Maximum time interval between 2 RING messages specified in seconds.
      float OsekNmTimeoutError: 0.001..65.535, set at pre-compile  # Time interval between 2 LIMPHOME messages specified in seconds.
      float OsekNmTimeoutWaitSleep: 0.001..65.535, set at pre-compile  # Time which OsekNm module waits after Sleep Acknowledgement to go to SLEEP specified in seconds.
      float OsekNmTimeoutTyp: 0.001..65.535, set at pre-compile  # Typical time interval between transmission of NM messages specified in seconds.
      integer OsekNmNodeId: 0..255, set at pre-compile  # Node identifier of local node.
      symbolic name reference OsekNmChannelIdRef: set at pre-compile, destination=NmChannelConfig  # This reference points to the unique channel defined by the NmChannelConfig and provides access to the unique channel index value in NmChannelId.
      container OsekNmRxPdu [1..*]  # This container is used to configure the Rx PDU properties that are used for the OsekNm Channel.
        integer OsekNmRxPduId: 0..65535, set at pre-compile, symbolic-name-value=true  # This parameter defines the Rx PDU ID of the CanIf L-PDU range that is associated with this OsekNmChannel instance.
        reference OsekNmRxPduRef: set at pre-compile, destination=Pdu  # Reference to the global PDU that is used by this OsekNmChannel instance.
      container OsekNmTxPdu [0..1]  # This container contains the OsekNmTxConfirmationPduId and the OsekNmTxPduRef.
        integer OsekNmTxPduId: 0..65535, set at pre-compile, symbolic-name-value=true  # Handle Id to be used by the Lower Layer to confirm the transmission of the OsekNmTxPdu to the LowerLayer.
        function name OsekNmTxPduCallout [0..1]: set at pre-compile, origin=AUTRON  # This parameter defines the existence and the name of a callout function for the corresponding NM Tx Pdu. If this parameter is omitted no NM Tx Pdu callout shall take place for the corresponding Nm Tx Pdu.
        reference OsekNmTxPduRef: set at pre-compile, destination=Pdu  # The reference to the common PDU structure.

AUTOSAR XML (schema 4-0-3)
# (C) 2013 HYUNDAI AUTRON Co., Ltd.
# Confidential Proprietary Information. Distribution Limited.
# Do Not Copy Without Prior Permission
package /AUTRON
  module definition Csm: refined-module-def=Csm, variants pre-compile  # Configuration of the Csm (CryptoServiceManager) module.
    container CsmAsymDecrypt [0..1]  # Container for incorporation of AsymDecrypt primitives.
      integer CsmAsymDecryptMaxKeySize: 1..4294967295, set at pre-compile, default-value=1  # The maximum, in bytes, of all key length used in all CRY primitives which implement an asymmetrical decryption.
      integer CsmAsymDecryptMaxDataBufferSize: 1..4294967295, set at pre-compile, origin=AUTRON, default-value=1
      integer CsmAsymDecryptMaxResultBufferSize: 1..4294967295, set at pre-compile, origin=AUTRON, default-value=1
      container CsmAsymDecryptConfig [0..32]  # Container for configuration of service AsymDecrypt. The container name serves as a symbolic name for the identifier of a service configuration.
        string CsmAsymDecryptInitConfiguration: set at pre-compile  # Name of a C symbol which contains the configuration of the underlying cryptographic primitive.
        string CsmAsymDecryptPrimitiveName: set at pre-compile  # Name of the cryptographic primitive to use.
        function name CsmCallbackAsymDecrypt: set at pre-compile  # Callback function to be called if service has finished. If the parameter is set, requests will be processed asynchronously and then callback function called. If the parameter is not set, or set with the value 'NULL' or 'NULL_PTR', requests will be processed synchronously.
        boolean CsmAsymDecryptUsePort: origin=AUTRON, default-value=false  # Need to use RTE interfaces? | True: Need to use RTE interfaces False: No need to use RTE interfaces
        boolean CsmAsymDecryptUseExternalTask: origin=AUTRON, default-value=false  # Whether to use a external task. | True: Use external task False: Use internal task of Csm module
    container CsmAsymEncrypt [0..1]  # Container for incorporation of AsymEncrypt primitives.
      integer CsmAsymEncryptMaxKeySize: 1..4294967295, set at pre-compile, default-value=1  # The maximum, in bytes, of all key length used in all CRY primitives which implement an asymmetrical encryption.
      integer CsmAsymEncryptMaxDataBufferSize: 1..4294967295, set at pre-compile, origin=AUTRON, default-value=1
      integer CsmAsymEncryptMaxResultBufferSize: 1..4294967295, set at pre-compile, origin=AUTRON, default-value=1
      container CsmAsymEncryptConfig [0..32]  # Container for configuration of service AsymEncrypt. The container name serves as a symbolic name for the identifier of a service configuration.
        string CsmAsymEncryptInitConfiguration: set at pre-compile  # Name of a C symbol which contains the configuration of the underlying cryptographic primitive.
        string CsmAsymEncryptPrimitiveName: set at pre-compile  # Name of the cryptographic primitive to use.
        function name CsmCallbackAsymEncrypt: set at pre-compile  # Callback function to be called if service has finished. If the parameter is set, requests will be processed asynchronously and then callback function called. If the parameter is not set, or set with the value 'NULL' or 'NULL_PTR', requests will be processed synchronously.
        boolean CsmAsymEncryptUsePort: origin=AUTRON, default-value=false  # Need to use RTE interfaces? | True: Need to use RTE interfaces False: No need to use RTE interfaces
        boolean CsmAsymEncryptUseExternalTask: origin=AUTRON, default-value=false  # Whether to use a external task. | True: Use external task False: Use internal task of Csm module
    container CsmAsymPrivateKeyExtract [0..1]: category=NOT_SUPPORTED  # Container for incorporation of AsymPrivateKeyExtract primitives.
      integer CsmAsymPrivateKeyExtractMaxKeySize: 1..4294967295, set at pre-compile, default-value=1  # The maximum, in bytes, of all key length used in all CRY primitives which implement an asymmetrical private key extraction.
      container CsmAsymPrivateKeyExtractConfig [0..32]  # Container for configuration of service AsymPrivateKeyExtract.The container name serves as a symbolic name for the identifier of a service configuration.
        string CsmAsymPrivateKeyExtractInitConfiguration: set at pre-compile  # Name of a C symbol which contains the configuration of the underlying cryptographic primitive.
        string CsmAsymPrivateKeyExtractPrimitiveName: set at pre-compile  # Name of the cryptographic primitive to use.
        function name CsmCallbackAsymPrivateKeyExtract: set at pre-compile  # Callback function to be called if service has finished. If the parameter is set, requests will be processed asynchronously and then callback function called. If the parameter is not set, or set with the value 'NULL' or 'NULL_PTR', requests will be processed synchronously.
        boolean CsmAsymPrivateKeyExtractUsePort: origin=AUTRON, default-value=false  # Need to use RTE interfaces? | True: Need to use RTE interfaces False: No need to use RTE interfaces
        boolean CsmAsymPrivateKeyExtractUseExternalTask: origin=AUTRON, default-value=false  # Whether to use a external task. | True: Use external task False: Use internal task of Csm module
    container CsmAsymPrivateKeyWrapAsym [0..1]: category=NOT_SUPPORTED  # Container for incorporation of AsymPrivateKeyWrapSym primitives.
      integer CsmAsymPrivateKeyWrapAsymMaxPrivKeySize: 1..4294967295, set at pre-compile  # The maximum length, in bytes, of all private key types used in all CRY primitives which implement an asymmetrical private key wrapping.
      integer CsmAsymPrivateKeyWrapAsymMaxPubKeySize: 1..4294967295, set at pre-compile  # The maximum length, in bytes, of all public key types used in all CRY primitives which implement an asymmetrical private key wrapping.
      container CsmAsymPrivateKeyWrapAsymConfig [0..32]  # Container for configuration of service SymKeyWrapAsym. The container name serves as a symbolic name for the identifier of a service configuration.
        string CsmAsymPrivateKeyWrapAsymInitConfiguration: set at pre-compile  # Name of a C symbol which contains the configuration of the underlying cryptographic primitive.
        string CsmAsymPrivateKeyWrapAsymPrimitiveName: set at pre-compile  # Name of the cryptographic primitive to use.
        function name CsmCallbackAsymPrivateKeyWrapAsym: set at pre-compile  # Callback function to be called if service has finished. If the parameter is set, requests will be processed asynchronously and then callback function called. If the parameter is not set, or set with the value 'NULL' or 'NULL_PTR', requests will be processed synchronously.
        boolean CsmAsymPrivateKeyWrapAsymUsePort: origin=AUTRON, default-value=false  # Need to use RTE interfaces? | True: Need to use RTE interfaces False: No need to use RTE interfaces
        boolean CsmAsymPrivateKeyWrapAsymUseExternalTask: origin=AUTRON, default-value=false  # Whether to use a external task. | True: Use external task False: Use internal task of Csm module
    container CsmAsymPrivateKeyWrapSym [0..1]: category=NOT_SUPPORTED  # Container for incorporation of AsymPrivateKeyWrapSym primitives.
      integer CsmAsymPrivateKeyWrapSymMaxPrivKeySize: 1..4294967295, set at pre-compile  # The maximum length, in bytes, of all private information types used in all CRY primitives which implement an asymetric private key wrapping.
      integer CsmAsymPrivateKeyWrapSymMaxSymKeySize: 1..4294967295, set at pre-compile  # The maximum, in bytes, of all key length used in all CRY primitives which implement an asymetrical private key wrapping.
      container CsmAsymPrivateKeyWrapSymConfig [0..32]  # Container for configuration of service AsymPrivateKeyWrapSym. The container name serves as a symbolic name for the identifier of a service configuration.
        string CsmAsymPrivateKeyWrapSymInitConfiguration: set at pre-compile  # Name of a C symbol which contains the configuration of the underlying cryptographic primitive.
        string CsmAsymPrivateKeyWrapSymPrimitiveName: set at pre-compile  # Name of the cryptographic primitive to use.
        function name CsmCallbackAsymPrivateKeyWrapSym: set at pre-compile  # Callback function to be called if service has finished. If the parameter is set, requests will be processed asynchronously and then callback function called. If the parameter is not set, or set with the value 'NULL' or 'NULL_PTR', requests will be processed synchronously.
        boolean CsmAsymPrivateKeyWrapSymUsePort: origin=AUTRON, default-value=false  # Need to use RTE interfaces? | True: Need to use RTE interfaces False: No need to use RTE interfaces
        boolean CsmAsymPrivateKeyWrapSymUseExternalTask: origin=AUTRON, default-value=false  # Whether to use a external task. | True: Use external task False: Use internal task of Csm module
    container CsmAsymPublicKeyExtract [0..1]: category=NOT_SUPPORTED  # Container for incorporation of AsymPublicKeyExtract primitives.
      integer CsmAsymPublicKeyExtractMaxKeySize: 1..4294967295, set at pre-compile, default-value=1  # The maximum, in bytes, of all key length used in all CRY primitives which implement an asymmetrical public key extraction.
      container CsmAsymPublicKeyExtractConfig [0..32]  # Container for configuration of service AsymPublicKeyExtract.The container name serves as a symbolic name for the identifier of a service configuration.
        string CsmAsymPublicKeyExtractInitConfiguration: set at pre-compile  # Name of a C symbol which contains the configuration of the underlying cryptographic primitive.
        string CsmAsymPublicKeyExtractPrimitiveName: set at pre-compile  # Name of the cryptographic primitive to use.
        function name CsmCallbackAsymPublicKeyExtract: set at pre-compile  # Callback function to be called if service has finished. If the parameter is set, requests will be processed asynchronously and then callback function called. If the parameter is not set, or set with the value 'NULL' or 'NULL_PTR', requests will be processed synchronously.
        boolean CsmAsymPublicKeyExtractUsePort: origin=AUTRON, default-value=false  # Need to use RTE interfaces? | True: Need to use RTE interfaces False: No need to use RTE interfaces
        boolean CsmAsymPublicKeyExtractUseExternalTask: origin=AUTRON, default-value=false  # Whether to use a external task. | True: Use external task False: Use internal task of Csm module
    container CsmChecksum [0..1]: category=NOT_SUPPORTED  # Container for incorporation of Checksum primitives.
      integer CsmChecksumMaxDataBufferSize: 1..4294967295, set at pre-compile, origin=AUTRON, default-value=1
      integer CsmChecksumMaxResultBufferSize: 1..4294967295, set at pre-compile, origin=AUTRON, default-value=1
      container CsmChecksumConfig [0..32]  # Container for configuration of service Checksum. The container name serves as a symbolic name for the identifier of a service configuration.
        function name CsmCallbackChecksum: set at pre-compile  # Callback function to be called if service has finished. If the parameter is set, requests will be processed asynchronously and then callback function called. If the parameter is not set, or set with the value 'NULL' or 'NULL_PTR', requests will be processed synchronously.
        string CsmChecksumInitConfiguration: set at pre-compile  # Name of a C symbol which contains the configuration of the underlying cryptographic primitive.
        string CsmChecksumPrimitiveName: set at pre-compile  # Name of the cryptographic primitive to use.
        boolean CsmChecksumUsePort: origin=AUTRON, default-value=false  # Need to use RTE interfaces? | True: Need to use RTE interfaces False: No need to use RTE interfaces
        boolean CsmChecksumUseExternalTask: origin=AUTRON, default-value=false  # Whether to use a external task. | True: Use external task False: Use internal task of Csm module
    container CsmDemEventParameterRefs [0..1]  # Container for the references to DemEventParameter elements which shall be invoked using the API Dem_ReportErrorStatus API in case the corresponding error occurs. The EventId is taken from the referenced DemEventParameter's DemEventId value. The standardized errors are provided in the container and can be extended by vendor specific error references.
      symbolic name reference CSM_E_INIT_FAILED [0..1]: set at pre-compile, destination=DemEventParameter  # Reference to the DemEventParameter which shall be issued when the error "Initialization of CSM module failed" has occured.
    container CsmGeneral  # Container for common configuration options.
      boolean CsmDevErrorDetect: set at pre-compile, default-value=true  # Pre-processor switch to enable and disable development error detection. | true: Development error detection enabled. false: Development error detection disabled
      string CsmMaxAlignScalarType: set at pre-compile  # The scalar type which has the maximum alignment restrictions on the given platform. | This type can be e.g. uint8, uint16 or uint32.
      integer CsmMaximumBlockingTime: 1..4294967295, category=NOT_SUPPORTED, set at pre-compile  # If interruption is turned on with the configuration option CsmUseInterruption, this option configures the maximum time in microseconds the main function shall be allowed to run before it must interrupt itself. The lowest allowed value for the option is implementation dependent.
      boolean CsmUseInterruption: category=NOT_SUPPORTED, set at pre-compile  # Pre-processor switch to enable and disable interruption of job processing. | true: Interruption of job processing enabled false: Interruption of job processing disabled
      boolean CsmUseSyncJobProcessing: category=NOT_SUPPORTED, set at pre-compile  # Pre-processor switch to enable and disable synchronous job processing. | true: synchronous job processing enabled false: synchronous job processing disabled
      boolean CsmVersionInfoApi: set at pre-compile, default-value=false  # Pre-processor switch to enable and disable availability of the API Csm_GetVersionInfo(). | true: Enables and disables the version info API. false: Disable the version info API.
      float CsmMainFunctionPeriod: 0.001..65.535, set at pre-compile, default-value=0.01  # Csm_MainFunction period.
      boolean CsmUseCommonFblCryptoLib: origin=AUTRON, default-value=true  # Pre-processor switch to enable and disable using the common crypto library in FBL. | true: Enables using the common crypto library in FBL. false: Disables using the common crypto library in FBL.
      string CsmSeedRefAddr: set at pre-compile, origin=AUTRON  # The reference address for feeding AutRandom Seed | This type should be 0xXXXXXXXX
    container CsmHash [0..1]  # Container for incorporation of Hash primitives.
      integer CsmHashMaxResultBufferSize: 1..4294967295, set at pre-compile, origin=AUTRON, default-value=1
      integer CsmHashMaxDataBufferSize: 1..4294967295, set at pre-compile, origin=AUTRON, default-value=1
      container CsmHashConfig [0..32]  # Configurations for the Hash service. The container name serves as a symbolic name for the identifier of a service configuration.
        function name CsmCallbackHash: set at pre-compile  # Callback function to be called if service has finished. If the parameter is set, requests will be processed asynchronously and then callback function called. If the parameter is not set, or set with the value 'NULL' or 'NULL_PTR', requests will be processed synchronously.
        string CsmHashInitConfiguration: set at pre-compile  # Name of a C symbol which contains the configuration of the underlying cryptographic primitive.
        string CsmHashPrimitiveName: set at pre-compile  # Name of the cryptographic primitive to use.
        boolean CsmHashUsePort: origin=AUTRON, default-value=false  # Need to use RTE interfaces? | True: Need to use RTE interfaces False: No need to use RTE interfaces
        boolean CsmHashUseExternalTask: origin=AUTRON, default-value=false  # Whether to use a external task. | True: Use external task False: Use internal task of Csm module
    container CsmKeyDerive [0..1]  # Container for incorporation of KeyDerive primitives.
      integer CsmKeyDeriveMaxKeySize: 1..4294967295, set at pre-compile, default-value=1  # The maximum, in bytes, of all key length used in all CRY primitives which implement a key derivation.
      integer CsmKeyDeriveMaxPasswordBufferSize: 1..4294967295, set at pre-compile, origin=AUTRON, default-value=1
      integer CsmKeyDeriveMaxSaltBufferSize: 1..4294967295, set at pre-compile, origin=AUTRON, default-value=1
      container CsmKeyDeriveConfig [0..32]  # Container for configuration of service KeyDerive. The container name serves as a symbolic name for the identifier of a service configuration.
        function name CsmCallbackKeyDerive: set at pre-compile  # Callback function to be called if service has finished. If the parameter is set, requests will be processed asynchronously and then callback function called. If the parameter is not set, or set with the value 'NULL' or 'NULL_PTR', requests will be processed synchronously.
        string CsmKeyDeriveInitConfiguration: set at pre-compile  # Name of a C symbol which contains the configuration of the underlying cryptographic primitive.
        string CsmKeyDerivePrimitiveName: set at pre-compile  # Name of the cryptographic primitive to use.
        boolean CsmKeyDeriveUsePort: origin=AUTRON, default-value=false  # Need to use RTE interfaces? | True: Need to use RTE interfaces False: No need to use RTE interfaces
        boolean CsmKeyDeriveUseExternalTask: origin=AUTRON, default-value=false  # Whether to use a external task. | True: Use external task False: Use internal task of Csm module
    container CsmKeyDeriveSymKey [0..1]: category=NOT_SUPPORTED  # Container for incorporation of CsmKeyDeriveSymKey primitives.
      integer CsmKeyDeriveSymKeyMaxSymKeySize: 1..4294967295, set at pre-compile  # The maximum, in bytes, of all key length used in all CRY primitives which implement a key derivation.
      container CsmKeyDeriveSymKeyConfig [0..32]  # Container for configuration of service CsmKeyDeriveSymKey. The container name serves as a symbolic name for the identifier of a service configuration.
        function name CsmCallbackKeyDeriveSymKey: set at pre-compile  # Callback function to be called if service has finished. If the parameter is set, requests will be processed asynchronously and then callback function called. If the parameter is not set, or set with the value 'NULL' or 'NULL_PTR', requests will be processed synchronously.
        string CsmKeyDeriveSymKeyInitConfiguration: set at pre-compile  # Name of a C symbol which contains the configuration of the underlying cryptographic primitive.
        string CsmKeyDeriveSymKeyPrimitiveName: set at pre-compile  # Name of the cryptographic primitive to use.
        boolean CsmKeyDeriveSymKeyUsePort: origin=AUTRON, default-value=false  # Need to use RTE interfaces? | True: Need to use RTE interfaces False: No need to use RTE interfaces
        boolean CsmKeyDeriveSymKeyUseExternalTask: origin=AUTRON, default-value=false  # Whether to use a external task. | True: Use external task False: Use internal task of Csm module
    container CsmKeyExchangeCalcPubVal [0..1]: category=NOT_SUPPORTED  # Container for incorporation of KeyExchangeCalcPubVal primitives.
      integer CsmKeyExchangeCalcPubValMaxBaseSize: 1..4294967295, set at pre-compile  # The maximum length, in bytes, of all base types used in all CRY primitives which implement a public value calculation.
      integer CsmKeyExchangeCalcPubValMaxPrivateSize: 1..4294967295, set at pre-compile  # The maximum length, in bytes, of all private information types used in all CRY primitives which implement a public value calculation.
      integer CsmKeyExchangeCalcPubValMaxOwnPublicValueBufferSize: 1..4294967295, set at pre-compile  # The maximum length, in bytes, of all own public value information types used in all CRY primitives which implement a public value calculation.
      container CsmKeyExchangeCalcPubValConfig [0..32]  # Container for configuration of service KeyExchangeCalcPubVal. The container name serves as a symbolic name for the identifier of a service configuration.
        function name CsmCallbackKeyExchangeCalcPubVal: set at pre-compile  # Callback function to be called if service has finished. If the parameter is set, requests will be processed asynchronously and then callback function called. If the parameter is not set, or set with the value 'NULL' or 'NULL_PTR', requests will be processed synchronously.
        string CsmKeyExchangeCalcPubValInitConfiguration: set at pre-compile  # Name of a C symbol which contains the configuration of the underlying cryptographic primitive.
        string CsmKeyExchangeCalcPubValPrimitiveName: set at pre-compile  # Name of the cryptographic primitive to use.
        boolean CsmKeyExchangeCalcPubValUsePort: origin=AUTRON, default-value=false  # Need to use RTE interfaces? | True: Need to use RTE interfaces False: No need to use RTE interfaces
        boolean CsmKeyExchangeCalcPubValUseExternalTask: origin=AUTRON, default-value=false  # Whether to use a external task. | True: Use external task False: Use internal task of Csm module
    container CsmKeyExchangeCalcSecret [0..1]  # Container for incorporation of KeyExchangeCalcSecret primitives.
      integer CsmKeyExchangeCalcSecretMaxBaseSize: 1..4294967295, set at pre-compile  # The maximum length, in bytes, of all base types used in all CRY primitives which implement a shared secret calculation.
      integer CsmKeyExchangeCalcSecretMaxPrivateSize: 1..4294967295, set at pre-compile  # The maximum length, in bytes, of all private information types used in all CRY primitives which implement a shared secret calculation.
      integer CsmKeyExchangeCalcSecretMaxPartnerPublicValueBufferSize: 1..4294967295, set at pre-compile  # The maximum length, in bytes, of all partner public information types used in all CRY primitives which implement a shared secret calculation.
      integer CsmKeyExchangeCalcSecretMaxSharedSecretBufferSize: 1..4294967295, set at pre-compile  # The maximum length, in bytes, of all shared secret information types used in all CRY primitives which implement a shared secret calculation.
      container CsmKeyExchangeCalcSecretConfig [0..32]  # Container for configuration of service KeyExchangeCalcSecret. The container name serves as a symbolic name for the identifier of a service configuration.
        function name CsmCallbackKeyExchangeCalcSecret: set at pre-compile  # Callback function to be called if service has finished. If the parameter is set, requests will be processed asynchronously and then callback function called. If the parameter is not set, or set with the value 'NULL' or 'NULL_PTR', requests will be processed synchronously.
        string CsmKeyExchangeCalcSecretInitConfiguration: set at pre-compile  # Name of a C symbol which contains the configuration of the underlying cryptographic primitive.
        string CsmKeyExchangeCalcSecretPrimitiveName: set at pre-compile  # Name of the cryptographic primitive to use.
        boolean CsmKeyExchangeCalcSecretUsePort: origin=AUTRON, default-value=false  # Need to use RTE interfaces? | True: Need to use RTE interfaces False: No need to use RTE interfaces
        boolean CsmKeyExchangeCalcSecretUseExternalTask: origin=AUTRON, default-value=false  # Whether to use a external task. | True: Use external task False: Use internal task of Csm module
    container CsmKeyExchangeCalcSymKey [0..1]: category=NOT_SUPPORTED  # Container for incorporation of KeyExchangeCalcSymKey primitives.
      integer CsmKeyExchangeCalcSymKeyMaxBaseSize: 1..4294967295, set at pre-compile  # The maximum length, in bytes, of all base types used in all CRY primitives which implement a symmetrical key calculation.
      integer CsmKeyExchangeCalcSymKeyMaxPrivateSize: 1..4294967295, set at pre-compile  # The maximum length, in bytes, of all private information types used in all CRY primitives which implement a symmetrical key calculation.
      integer CsmKeyExchangeCalcSymKeyMaxPartnerPublicValueBufferSize: 1..4294967295, set at pre-compile  # The maximum length, in bytes, of all partner public information types used in all CRY primitives which implement a symmetrical key calculation.
      integer CsmKeyExchangeCalcSymKeyMaxSymKeySize: 1..4294967295, set at pre-compile  # The maximum, in bytes, of all key length used in all CRY primitives which implement a symmetrical key calculation.
      container CsmKeyExchangeCalcSymKeyConfig [0..32]  # Container for configuration of service KeyExchangeCalcSymKey. The container name serves as a symbolic name for the identifier of a service configuration.
        function name CsmCallbackKeyExchangeCalcSymKey: set at pre-compile  # Callback function to be called if service has finished. If the parameter is set, requests will be processed asynchronously and then callback function called. If the parameter is not set, or set with the value 'NULL' or 'NULL_PTR', requests will be processed synchronously.
        string CsmKeyExchangeCalcSymKeyInitConfiguration: set at pre-compile  # Name of a C symbol which contains the configuration of the underlying cryptographic primitive.
        string CsmKeyExchangeCalcSymKeyPrimitiveName: set at pre-compile  # Name of the cryptographic primitive to use.
        boolean CsmKeyExchangeCalcSymKeyUsePort: origin=AUTRON, default-value=false  # Need to use RTE interfaces? | True: Need to use RTE interfaces False: No need to use RTE interfaces
        boolean CsmKeyExchangeCalcSymKeyUseExternalTask: origin=AUTRON, default-value=false  # Whether to use a external task. | True: Use external task False: Use internal task of Csm module
    container CsmMacGenerate [0..1]  # Container for incorporation of MacGenerate primitives.
      integer CsmMacGenerateMaxKeySize: 1..4294967295, set at pre-compile, default-value=1  # The maximum, in bytes, of all key length used in all CRY primitives which implement a MAC generation.
      integer CsmMacGenerateMaxDataBufferSize: 1..4294967295, set at pre-compile, origin=AUTRON, default-value=1
      integer CsmMacGenerateMaxResultBufferSize: 1..4294967295, set at pre-compile, origin=AUTRON, default-value=1
      container CsmMacGenerateConfig [0..32]  # Configurations for the MacGenerate service. The container name serves as a symbolic name for the identifier of a service configuration.
        function name CsmCallbackMacGenerate: set at pre-compile  # Callback function to be called if service has finished. If the parameter is set, requests will be processed asynchronously and then callback function called. If the parameter is not set, or set with the value 'NULL' or 'NULL_PTR', requests will be processed synchronously.
        string CsmMacGenerateInitConfiguration: set at pre-compile  # Name of a C symbol which contains the configuration of the underlying cryptographic primitive.
        string CsmMacGeneratePrimitiveName: set at pre-compile  # Name of the cryptographic primitive to use.
        boolean CsmMacGenerateUsePort: origin=AUTRON, default-value=false  # Need to use RTE interfaces? | True: Need to use RTE interfaces False: No need to use RTE interfaces
        boolean CsmMacGenerateUseExternalTask: origin=AUTRON, default-value=false  # Whether to use a external task. | True: Use external task False: Use internal task of Csm module
    container CsmMacVerify [0..1]  # Container for incorporation of MacVerify primitives.
      integer CsmMacVerifyMaxKeySize: 1..4294967295, set at pre-compile, default-value=1  # The maximum, in bytes, of all key length used in all CRY primitives which implement a MAC verification.
      integer CsmMacVerifyMaxDataBufferSize: 1..4294967295, set at pre-compile, origin=AUTRON, default-value=1
      integer CsmMacVerifyMaxCompareBufferSize: 1..4294967295, set at pre-compile, origin=AUTRON, default-value=1
      container CsmMacVerifyConfig [0..32]  # Container for configuration of service MacVerify. The container name serves as a symbolic name for the identifier of a service configuration.
        function name CsmCallbackMacVerify: set at pre-compile  # Callback function to be called if service has finished. If the parameter is set, requests will be processed asynchronously and then callback function called. If the parameter is not set, or set with the value 'NULL' or 'NULL_PTR', requests will be processed synchronously.
        string CsmMacVerifyInitConfiguration: set at pre-compile  # Name of a C symbol which contains the configuration of the underlying cryptographic primitive.
        string CsmMacVerifyPrimitiveName: set at pre-compile  # Name of the cryptographic primitive to use.
        boolean CsmMacVerifyUsePort: origin=AUTRON, default-value=false  # Need to use RTE interfaces? | True: Need to use RTE interfaces False: No need to use RTE interfaces
        boolean CsmMacVerifyUseExternalTask: origin=AUTRON, default-value=false  # Whether to use a external task. | True: Use external task False: Use internal task of Csm module
    container CsmRandomGenerate [0..1]  # Container for incorporation of RandomGenerate primitives.
      integer CsmRandomGenerateMaxResultBufferSize: 1..4294967295, set at pre-compile, origin=AUTRON, default-value=1
      container CsmRandomGenerateConfig [0..32]  # Container for configuration of service RandomGenerate. The container name serves as a symbolic name for the identifier of a service configuration.
        function name CsmCallbackRandomGenerate: set at pre-compile  # Callback function to be called if service has finished. If the parameter is set, requests will be processed asynchronously and then callback function called. If the parameter is not set, or set with the value 'NULL' or 'NULL_PTR', requests will be processed synchronously.
        string CsmRandomGenerateInitConfiguration: set at pre-compile  # Name of a C symbol which contains the configuration of the underlying cryptographic primitive.
        string CsmRandomGeneratePrimitiveName: set at pre-compile  # Name of the cryptographic primitive to use.
        boolean CsmRandomGenerateUsePort: origin=AUTRON, default-value=false  # Need to use RTE interfaces? | True: Need to use RTE interfaces False: No need to use RTE interfaces
        boolean CsmRandomGenerateUseExternalTask: origin=AUTRON, default-value=false  # Whether to use a external task. | True: Use external task False: Use internal task of Csm module
    container CsmRandomSeed [0..1]  # Container for incorporation of RandomSeed primitives.
      integer CsmRandomSeedMaxDataBufferSize: 1..4294967295, set at pre-compile, origin=AUTRON, default-value=1
      container CsmRandomSeedConfig [0..32]  # Container for configuration of service RandomSeed. The container name serves as a symbolic name for the identifier of a service configuration.
        function name CsmCallbackRandomSeed: set at pre-compile  # Callback function to be called if service has finished. If the parameter is set, requests will be processed asynchronously and then callback function called. If the parameter is not set, or set with the value 'NULL' or 'NULL_PTR', requests will be processed synchronously.
        string CsmRandomSeedInitConfiguration: set at pre-compile  # Name of a C symbol which contains the configuration of the underlying cryptographic primitive.
        string CsmRandomSeedPrimitiveName: set at pre-compile  # Name of the cryptographic primitive to use.
        boolean CsmRandomSeedUsePort: origin=AUTRON, default-value=false  # Need to use RTE interfaces? | True: Need to use RTE interfaces False: No need to use RTE interfaces
        boolean CsmRandomSeedUseExternalTask: origin=AUTRON, default-value=false  # Whether to use a external task. | True: Use external task False: Use internal task of Csm module
    container CsmSignatureGenerate [0..1]  # Container for incorporation of SignatureGenerate primitives
      integer CsmSignatureGenerateMaxKeySize: 1..4294967295, set at pre-compile, default-value=1  # The maximum, in bytes, of all key length used in all CRY primitives which implement a signature generation.
      integer CsmSignatureGenerateMaxDataBufferSize: 1..4294967295, set at pre-compile, origin=AUTRON, default-value=1
      integer CsmSignatureGenerateMaxResultBufferSize: 1..4294967295, set at pre-compile, origin=AUTRON, default-value=1
      container CsmSignatureGenerateConfig [0..32]  # Container for configuration of service SignatureGenerate. The container name serves as a symbolic name for the identifier of a service configuration.
        function name CsmCallbackSignatureGenerate: set at pre-compile  # Callback function to be called if service has finished. If the parameter is set, requests will be processed asynchronously and then callback function called. If the parameter is not set, or set with the value 'NULL' or 'NULL_PTR', requests will be processed synchronously.
        string CsmSignatureGenerateInitConfiguration: set at pre-compile  # Name of a C symbol which contains the configuration of the underlying cryptographic primitive.
        string CsmSignatureGeneratePrimitiveName: set at pre-compile  # Name of the cryptographic primitive to use.
        boolean CsmSignatureGenerateUsePort: origin=AUTRON, default-value=false  # Need to use RTE interfaces? | True: Need to use RTE interfaces False: No need to use RTE interfaces
        boolean CsmSignatureGenerateUseExternalTask: origin=AUTRON, default-value=false  # Whether to use a external task. | True: Use external task False: Use internal task of Csm module
    container CsmSignatureVerify [0..1]  # Container for incorporation of SignatureVerify primitives.
      integer CsmSignatureVerifyMaxKeySize: 1..4294967295, set at pre-compile, default-value=1  # The maximum, in bytes, of all key length used in all CRY primitives which implement a signature verification.
      integer CsmSignatureVerifyMaxDataBufferSize: 1..4294967295, set at pre-compile, origin=AUTRON, default-value=1
      integer CsmSignatureVerifyMaxCompareSignatureBufferSize: 1..4294967295, set at pre-compile, origin=AUTRON, default-value=1
      container CsmSignatureVerifyConfig [0..32]  # Container for configuration of service SignatureVerify. The container name serves as a symbolic name for the identifier of a service configuration.
        function name CsmCallbackSignatureVerify: set at pre-compile  # Callback function to be called if service has finished. If the parameter is set, requests will be processed asynchronously and then callback function called. If the parameter is not set, or set with the value 'NULL' or 'NULL_PTR', requests will be processed synchronously.
        string CsmSignatureVerifyInitConfiguration: set at pre-compile  # Name of a C symbol which contains the configuration of the underlying cryptographic primitive.
        string CsmSignatureVerifyPrimitiveName: set at pre-compile  # Name of the cryptographic primitive to use.
        boolean CsmSignatureVerifyUsePort: origin=AUTRON, default-value=false  # Need to use RTE interfaces? | True: Need to use RTE interfaces False: No need to use RTE interfaces
        boolean CsmSignatureVerifyUseExternalTask: origin=AUTRON, default-value=false  # Whether to use a external task. | True: Use external task False: Use internal task of Csm module
    container CsmSymBlockDecrypt [0..1]  # Container for incorporation of SymBlockDecrypt primitives.
      integer CsmSymBlockDecryptMaxKeySize: 1..4294967295, set at pre-compile, default-value=1  # The maximum, in bytes, of all key length used in all CRY primitives which implement a symmetrical block decryption.
      integer CsmSymBlockDecryptMaxDataBufferSize: 1..4294967295, set at pre-compile, origin=AUTRON, default-value=1
      integer CsmSymBlockDecryptMaxResultBufferSize: 1..4294967295, set at pre-compile, origin=AUTRON, default-value=1
      container CsmSymBlockDecryptConfig [0..32]  # Container for configuration of service SymBlockDecrypt. The container name serves as a symbolic name for the identifier of a service configuration.
        function name CsmCallbackSymBlockDecrypt: set at pre-compile  # Callback function to be called if service has finished. If the parameter is set, requests will be processed asynchronously and then callback function called. If the parameter is not set, or set with the value 'NULL' or 'NULL_PTR', requests will be processed synchronously.
        string CsmSymBlockDecryptInitConfiguration: set at pre-compile  # Name of a C symbol which contains the configuration of the underlying cryptographic primitive.
        string CsmSymBlockDecryptPrimitiveName: set at pre-compile  # Name of the cryptographic primitive to use.
        boolean CsmSymBlockDecryptUsePort: origin=AUTRON, default-value=false  # Need to use RTE interfaces? | True: Need to use RTE interfaces False: No need to use RTE interfaces
        boolean CsmSymBlockDecryptUseExternalTask: origin=AUTRON, default-value=false  # Whether to use a external task. | True: Use external task False: Use internal task of Csm module
    container CsmSymBlockEncrypt [0..1]  # Container for incorporation of SymBlockEncrypt primitives.
      integer CsmSymBlockEncryptMaxKeySize: 1..4294967295, set at pre-compile, default-value=1  # The maximum, in bytes, of all key length used in all CRY primitives which implement a symmetrical block encryption.
      integer CsmSymBlockEncryptMaxDataBufferSize: 1..4294967295, set at pre-compile, origin=AUTRON, default-value=1
      integer CsmSymBlockEncryptMaxResultBufferSize: 1..4294967295, set at pre-compile, origin=AUTRON, default-value=1
      container CsmSymBlockEncryptConfig [0..32]  # Container for configuration of service SymBlockEncrypt. The container name serves as a symbolic name for the identifier of a service configuration.
        function name CsmCallbackSymBlockEncrypt: set at pre-compile  # Callback function to be called if service has finished. If the parameter is set, requests will be processed asynchronously and then callback function called. If the parameter is not set, or set with the value 'NULL' or 'NULL_PTR', requests will be processed synchronously.
        string CsmSymBlockEncryptInitConfiguration: set at pre-compile  # Name of a C symbol which contains the configuration of the underlying cryptographic primitive.
        string CsmSymBlockEncryptPrimitiveName: set at pre-compile  # Name of the cryptographic primitive to use.
        boolean CsmSymBlockEncryptUsePort: origin=AUTRON, default-value=false  # Need to use RTE interfaces? | True: Need to use RTE interfaces False: No need to use RTE interfaces
        boolean CsmSymBlockEncryptUseExternalTask: origin=AUTRON, default-value=false  # Whether to use a external task. | True: Use external task False: Use internal task of Csm module
    container CsmSymDecrypt [0..1]  # Container for incorporation of SymDecrypt primitives
      integer CsmSymDecryptMaxKeySize: 1..4294967295, set at pre-compile, default-value=1  # The maximum, in bytes, of all key length used in all CRY primitives which implement a symmetrical decryption.
      integer CsmSymDecryptMaxInitVectorBufferSize: 1..4294967295, set at pre-compile, origin=AUTRON, default-value=1
      integer CsmSymDecryptMaxDataBufferSize: 1..4294967295, set at pre-compile, origin=AUTRON, default-value=1
      integer CsmSymDecryptMaxResultBufferSize: 1..4294967295, set at pre-compile, origin=AUTRON, default-value=1
      container CsmSymDecryptConfig [0..32]  # Container for configuration of service SymDecrypt.The container name serves as a symbolic name for the identifier of a service configuration.
        function name CsmCallbackSymDecrypt: set at pre-compile  # Callback function to be called if service has finished. If the parameter is set, requests will be processed asynchronously and then callback function called. If the parameter is not set, or set with the value 'NULL' or 'NULL_PTR', requests will be processed synchronously.
        string CsmSymDecryptInitConfiguration: set at pre-compile  # Name of a C symbol which contains the configuration of the underlying cryptographic primitive.
        string CsmSymDecryptPrimitiveName: set at pre-compile  # Name of the cryptographic primitive to use.
        boolean CsmSymDecryptUsePort: origin=AUTRON, default-value=false  # Need to use RTE interfaces? | True: Need to use RTE interfaces False: No need to use RTE interfaces
        boolean CsmSymDecryptUseExternalTask: origin=AUTRON, default-value=false  # Whether to use a external task. | True: Use external task False: Use internal task of Csm module
    container CsmSymEncrypt [0..1]  # Container for incorporation of SymEncrypt primitives.
      integer CsmSymEncryptMaxKeySize: 1..4294967295, set at pre-compile, default-value=1  # The maximum, in bytes, of all key length used in all CRY primitives which implement a symmetrical encryption.
      integer CsmSymEncryptMaxInitVectorBufferSize: 1..4294967295, set at pre-compile, origin=AUTRON, default-value=1
      integer CsmSymEncryptMaxDataBufferSize: 1..4294967295, set at pre-compile, origin=AUTRON, default-value=1
      integer CsmSymEncryptMaxResultBufferSize: 1..4294967295, set at pre-compile, origin=AUTRON, default-value=1
      container CsmSymEncryptConfig [0..32]  # Container for configuration of service SymEncrypt. The container name serves as a symbolic name for the identifier of a service configuration.
        function name CsmCallbackSymEncrypt: set at pre-compile  # Callback function to be called if service has finished. If the parameter is set, requests will be processed asynchronously and then callback function called. If the parameter is not set, or set with the value 'NULL' or 'NULL_PTR', requests will be processed synchronously.
        string CsmSymEncryptInitConfiguration: set at pre-compile  # Name of a C symbol which contains the configuration of the underlying cryptographic primitive.
        string CsmSymEncryptPrimitiveName: set at pre-compile  # Name of the cryptographic primitive to use.
        boolean CsmSymEncryptUsePort: origin=AUTRON, default-value=false  # Need to use RTE interfaces? | True: Need to use RTE interfaces False: No need to use RTE interfaces
        boolean CsmSymEncryptUseExternalTask: origin=AUTRON, default-value=false  # Whether to use a external task. | True: Use external task False: Use internal task of Csm module
    container CsmSymKeyExtract [0..1]: category=NOT_SUPPORTED  # Container for incorporation of SymKeyExtract primitives.
      integer CsmSymKeyExtractMaxKeySize: 1..4294967295, set at pre-compile, default-value=1  # The maximum, in bytes, of all key length used in all CRY primitives which implement a symmetrical key extraction.
      integer CsmSymKeyExtractMaxDataBufferSize: 1..4294967295, set at pre-compile, origin=AUTRON, default-value=1
      container CsmSymKeyExtractConfig [0..32]  # Container for configuration of service SymKeyExtract. The container name serves as a symbolic name for the identifier of a service configuration.
        function name CsmCallbackSymKeyExtract: set at pre-compile  # Callback function to be called if service has finished. If the parameter is set, requests will be processed asynchronously and then callback function called. If the parameter is not set, or set with the value 'NULL' or 'NULL_PTR', requests will be processed synchronously.
        string CsmSymKeyExtractInitConfiguration: set at pre-compile  # Name of a C symbol which contains the configuration of the underlying cryptographic primitive.
        string CsmSymKeyExtractPrimitiveName: set at pre-compile  # Name of the cryptographic primitive to use.
        boolean CsmSymKeyExtractUsePort: origin=AUTRON, default-value=false  # Need to use RTE interfaces? | True: Need to use RTE interfaces False: No need to use RTE interfaces
        boolean CsmSymKeyExtractUseExternalTask: origin=AUTRON, default-value=false  # Whether to use a external task. | True: Use external task False: Use internal task of Csm module
    container CsmSymKeyWrapAsym [0..1]: category=NOT_SUPPORTED  # Container for incorporation of SymKeyWrapSym primitives.
      integer CsmSymKeyWrapAsymMaxPubKeySize: 1..4294967295, set at pre-compile  # The maximum length, in bytes, of all public key types used in all CRY primitives which implement an asymmetrical key wrapping.
      integer CsmSymKeyWrapAsymMaxSymKeySize: 1..4294967295, set at pre-compile  # The maximum, in bytes, of all key length used in all CRY primitives which implement an asymmetrical key wrapping.
      container CsmSymKeyWrapAsymConfig [0..32]  # Container for configuration of service SymKeyWrapAsym. The container name serves as a symbolic name for the identifier of a service configuration.
        function name CsmCallbackSymKeyWrapAsym: set at pre-compile  # Callback function to be called if service has finished. If the parameter is set, requests will be processed asynchronously and then callback function called. If the parameter is not set, or set with the value 'NULL' or 'NULL_PTR', requests will be processed synchronously.
        string CsmSymKeyWrapAsymInitConfiguration: set at pre-compile  # Name of a C symbol which contains the configuration of the underlying cryptographic primitive.
        string CsmSymKeyWrapAsymPrimitiveName: set at pre-compile  # Name of the cryptographic primitive to use.
        boolean CsmSymKeyWrapAsymUsePort: origin=AUTRON, default-value=false  # Need to use RTE interfaces? | True: Need to use RTE interfaces False: No need to use RTE interfaces
        boolean CsmSymKeyWrapAsymUseExternalTask: origin=AUTRON, default-value=false  # Whether to use a external task. | True: Use external task False: Use internal task of Csm module
    container CsmSymKeyWrapSym [0..1]: category=NOT_SUPPORTED  # Container for incorporation of SymKeyWrapSym primitives.
      integer CsmSymKeyWrapSymMaxSymKeySize: 1..4294967295, set at pre-compile  # The maximum, in bytes, of all key length used in all CRY primitives which implement an symmetrical key wrapping.
      integer CsmSymKeyWrapSymMaxDataBufferSize: 1..4294967295, set at pre-compile, origin=AUTRON, default-value=1
      container CsmSymKeyWrapSymConfig [0..32]  # Container for configuration of service SymKeyWrapSym. The container name serves as a symbolic name for the identifier of a service configuration.
        function name CsmCallbackSymKeyWrapSym: set at pre-compile  # Callback function to be called if service has finished. If the parameter is set, requests will be processed asynchronously and then callback function called. If the parameter is not set, or set with the value 'NULL' or 'NULL_PTR', requests will be processed synchronously.
        string CsmSymKeyWrapSymInitConfiguration: set at pre-compile  # Name of a C symbol which contains the configuration of the underlying cryptographic primitive.
        string CsmSymKeyWrapSymPrimitiveName: set at pre-compile  # Name of the cryptographic primitive to use.
        boolean CsmSymKeyWrapSymUsePort: origin=AUTRON, default-value=false  # Need to use RTE interfaces? | True: Need to use RTE interfaces False: No need to use RTE interfaces
        boolean CsmSymKeyWrapSymUseExternalTask: origin=AUTRON, default-value=false  # Whether to use a external task. | True: Use external task False: Use internal task of Csm module
  ecuc definition collection ParameterDefinition_Csm: module=Csm

AUTOSAR XML (schema 4-2-2)
package /TS_T40D13M1I0R0
  ecuc definition collection ADC_EcuParameterDefinition: module=Adc
  module definition Adc [0..1]: post-build-variant-support=true, refined-module-def=Adc, variants post-build  # Configuration of the Adc (Analog Digital Conversion) module.
    container AdcDemEventParameterRefs [0..1]: multiplicity set at pre-compile  # Container for the references to DemEventParameter elements which shall be invoked using the API Dem_ReportErrorStatus API in case the corresponding error occurs. The EventId is taken from the referenced DemEventParameter's DemEventId symbolic name. The standardized errors are provided in the container and can be extended by vendor specific error references.
      symbolic name reference ADC_E_HARDWARE_ERROR [0..1]: multiplicity set at pre-compile, origin=Cypress, set at pre-compile, destination=DemEventParameter  # Reference to configured DEM event to report "Hardware failure". If the reference is not configured the error shall not be reported.
    container AdcConfigSet  # This container contains the configuration parameters and sub containers of the AUTOSAR Adc module.
      boolean AdcSupplyMonitorEnabledA [0..1]: multiplicity set at post-build, origin=Cypress, post-build-variant-multiplicity=true, post-build-variant-value=true, set at post-build, default-value=false  # Supply monitor enable for AMUXBUS_A (amuxbus_a_mon). NOTE: This parameter can be used when one of AdcChannelId is set to AmuxbusA in the AdcConfigSet at least. Otherwise this parameter is disabled.
      enumeration AdcSupplyMonitorLevelA [0..1]: {ADC_SUPP_VREFL, ADC_SUPP_VREFH}, multiplicity set at post-build, origin=Cypress, post-build-variant-multiplicity=true, post-build-variant-value=true, set at post-build, default-value=ADC_SUPP_VREFL  # Supply monitor level select for AMUXBUS_A. NOTE: This parameter can be used when AdcSupplyMonitorEnabledA is set to true. Otherwise this parameter is disabled.
      boolean AdcSupplyMonitorEnabledB [0..1]: multiplicity set at post-build, origin=Cypress, post-build-variant-multiplicity=true, post-build-variant-value=true, set at post-build, default-value=false  # Supply monitor enable for AMUXBUS_B (amuxbus_b_mon). NOTE: This parameter can be used when one of AdcChannelId is set to AmuxbusB in the AdcConfigSet at least. Otherwise this parameter is disabled.
      enumeration AdcSupplyMonitorLevelB [0..1]: {ADC_SUPP_VREFL, ADC_SUPP_VREFH}, multiplicity set at post-build, origin=Cypress, post-build-variant-multiplicity=true, post-build-variant-value=true, set at post-build, default-value=ADC_SUPP_VREFL  # Supply monitor level select for AMUXBUS_B. NOTE: This parameter can be used when AdcSupplyMonitorEnabledB is set to true. Otherwise this parameter is disabled.
      container AdcHwUnit [1..*]: multiplicity set at post-build, post-build-variant-multiplicity=true  # This container contains the Driver configuration (parameters) depending on grouping of channels. This container could contain HW specific parameters which are not defined in the Standardized Module Definition. They must be added in the Vendor Specific Module Definition. | This container could contain HW specific parameters which are not defined in the Standardized Module Definition. They must be added in the Vendor Specific Module Definition.
        enumeration AdcClockSource [0..1]: {ADC_NOT_USED}, multiplicity set at post-build, post-build-variant-multiplicity=true, post-build-variant-value=true, set at post-build, default-value=ADC_NOT_USED  # The ADC module specific clock input for the conversion unit can statically be configured to select different clock sources if provided by hardware. Enumeration literals are defined vendor specific. Note: This parameter is not used by the ADC Driver and therefore not being evaluated. Because clock source inputted the ADC is fixed. | statically be configured to select different clock sources if provided by hardware. Enumeration literals are defined vendor specific.
        enumeration AdcHwUnitId: {ADC_SAR_0_0, ADC_SAR_0_1, ADC_SAR_0_2, ADC_SAR_0_3}, post-build-variant-value=true, set at post-build, symbolic-name-value=true, default-value=ADC_SAR_0_0  # Numeric ID of the HW Unit. This symbolic name allows accessing HW Unit data. Enumeration literals are defined vendor specific.
        integer AdcPrescale [0..1]: 0..65535, multiplicity set at post-build, post-build-variant-multiplicity=true, post-build-variant-value=true, set at post-build, default-value=1  # Optional ADC module specific clock prescale factor, if supported by hardware. ImplementationType: Adc_PrescaleType Note: This parameter is not used by the ADC Driver and therefore not being evaluated. Because hardware controlled by ADC module does not support it. | ImplementationType: Adc_PrescaleType
        boolean AdcDiagnoseEnable: origin=Cypress, post-build-variant-value=true, set at post-build, default-value=false  # Enables or disables diagnostic reference of the specified hardware unit.
        enumeration AdcDiagnosticReference [0..1]: {ADC_DIAG_VREFL, ADC_DIAG_VREFH_1DIV8, ADC_DIAG_VREFH_2DIV8, ADC_DIAG_VREFH_3DIV8, ADC_DIAG_VREFH_4DIV8, ADC_DIAG_VREFH_5DIV8, ADC_DIAG_VREFH_6DIV8, ADC_DIAG_VREFH_7DIV8, ADC_DIAG_VREFH, ADC_DIAG_VREFX, ADC_DIAG_VBG, ADC_DIAG_VIN1, ADC_DIAG_VIN2, ADC_DIAG_VIN3, ADC_DIAG_I_SOURCE, ADC_DIAG_I_SINK}, multiplicity set at post-build, origin=Cypress, post-build-variant-multiplicity=true, post-build-variant-value=true, set at post-build, default-value=ADC_DIAG_VREFL  # Selects diagnostic reference output of the specified hardware unit.
        integer AdcPreconditionCycle: 1..15, origin=Cypress, post-build-variant-value=true, set at post-build, default-value=1  # The parameter is used to set number of precondition cycles for hardware unit.
        boolean AdcSarMux1ConnectToAdc0 [0..1]: multiplicity set at post-build, origin=Cypress, post-build-variant-multiplicity=true, post-build-variant-value=true, set at post-build, default-value=false  # Determines, if SARMUX1 (SARMUX of hardware unit of ADC_SAR_0_1) is connected to hardware unit of ADC_SAR_0_0. True: SARMUX1 is connected. False: SARMUX1 is not connected.
        boolean AdcSarMux1DiagnoseEnable [0..1]: multiplicity set at post-build, origin=Cypress, post-build-variant-multiplicity=true, post-build-variant-value=true, set at post-build, default-value=false  # Enables or disables diagnostic reference for SARMUX1.
        enumeration AdcSarMux1DiagnosticReference [0..1]: {ADC_DIAG_VREFL, ADC_DIAG_VREFH_1DIV8, ADC_DIAG_VREFH_2DIV8, ADC_DIAG_VREFH_3DIV8, ADC_DIAG_VREFH_4DIV8, ADC_DIAG_VREFH_5DIV8, ADC_DIAG_VREFH_6DIV8, ADC_DIAG_VREFH_7DIV8, ADC_DIAG_VREFH, ADC_DIAG_VREFX, ADC_DIAG_VBG, ADC_DIAG_VIN1, ADC_DIAG_VIN2, ADC_DIAG_VIN3, ADC_DIAG_I_SOURCE, ADC_DIAG_I_SINK}, multiplicity set at post-build, origin=Cypress, post-build-variant-multiplicity=true, post-build-variant-value=true, set at post-build, default-value=ADC_DIAG_VREFL  # Selects diagnostic reference output for SARMUX1.
        boolean AdcSarMux2ConnectToAdc0 [0..1]: multiplicity set at post-build, origin=Cypress, post-build-variant-multiplicity=true, post-build-variant-value=true, set at post-build, default-value=false  # Determines, if SARMUX2 (SARMUX of hardware unit of ADC_SAR_0_2) is connected to hardware unit of ADC_SAR_0_0. True: SARMUX2 is connected. False: SARMUX2 is not connected.
        boolean AdcSarMux2DiagnoseEnable [0..1]: multiplicity set at post-build, origin=Cypress, post-build-variant-multiplicity=true, post-build-variant-value=true, set at post-build, default-value=false  # Enables or disables diagnostic reference for SARMUX2.
        enumeration AdcSarMux2DiagnosticReference [0..1]: {ADC_DIAG_VREFL, ADC_DIAG_VREFH_1DIV8, ADC_DIAG_VREFH_2DIV8, ADC_DIAG_VREFH_3DIV8, ADC_DIAG_VREFH_4DIV8, ADC_DIAG_VREFH_5DIV8, ADC_DIAG_VREFH_6DIV8, ADC_DIAG_VREFH_7DIV8, ADC_DIAG_VREFH, ADC_DIAG_VREFX, ADC_DIAG_VBG, ADC_DIAG_VIN1, ADC_DIAG_VIN2, ADC_DIAG_VIN3, ADC_DIAG_I_SOURCE, ADC_DIAG_I_SINK}, multiplicity set at post-build, origin=Cypress, post-build-variant-multiplicity=true, post-build-variant-value=true, set at post-build, default-value=ADC_DIAG_VREFL  # Selects diagnostic reference output for SARMUX2.
        boolean AdcSarMux3ConnectToAdc0 [0..1]: multiplicity set at post-build, origin=Cypress, post-build-variant-multiplicity=true, post-build-variant-value=true, set at post-build, default-value=false  # Determines, if SARMUX3 (SARMUX of hardware unit of ADC_SAR_0_3) is connected to hardware unit of ADC_SAR_0_0. True: SARMUX3 is connected. False: SARMUX3 is not connected.
        boolean AdcSarMux3DiagnoseEnable [0..1]: multiplicity set at post-build, origin=Cypress, post-build-variant-multiplicity=true, post-build-variant-value=true, set at post-build, default-value=false  # Enables or disables diagnostic reference for SARMUX3.
        enumeration AdcSarMux3DiagnosticReference [0..1]: {ADC_DIAG_VREFL, ADC_DIAG_VREFH_1DIV8, ADC_DIAG_VREFH_2DIV8, ADC_DIAG_VREFH_3DIV8, ADC_DIAG_VREFH_4DIV8, ADC_DIAG_VREFH_5DIV8, ADC_DIAG_VREFH_6DIV8, ADC_DIAG_VREFH_7DIV8, ADC_DIAG_VREFH, ADC_DIAG_VREFX, ADC_DIAG_VBG, ADC_DIAG_VIN1, ADC_DIAG_VIN2, ADC_DIAG_VIN3, ADC_DIAG_I_SOURCE, ADC_DIAG_I_SINK}, multiplicity set at post-build, origin=Cypress, post-build-variant-multiplicity=true, post-build-variant-value=true, set at post-build, default-value=ADC_DIAG_VREFL  # Selects diagnostic reference output for SARMUX3.
        container AdcChannel [1..*]: multiplicity set at post-build, post-build-variant-multiplicity=true  # This container contains the channel configuration (parameters) depending on the hardware capability. The organization of this data structure could contain dependencies to the microcontroller so this is left up to the implementer and its location is left up to the configuration. Note: Since an AdcChannel can be part of several AdcGroups, this container is not realized as a subcontainer of AdcGroup but instead as a subcontainer of AdcHwUnit. | The organization of this data structure could contain dependencies to the microcontroller so this is left up to the implementer and its location is left up to the configuration. Note: Since an AdcChannel can be part of several AdcGroups, this container is not realized as a subcontainer of AdcGroup but instead as a subcontainer of AdcHwUnit.
          integer AdcChannelConvTime [0..1]: 14..14, multiplicity set at post-build, post-build-variant-multiplicity=true, post-build-variant-value=true, set at post-build, default-value=14  # Configuration of conversion time, i.e. the time during which the analogue value is converted into digital representation, (in clock cycles) for each channel, if supported by hardware. ImplementationType: Adc_ConversionTimeType Note: Valid range is only 14. | ImplementationType: Adc_ConversionTimeType
          integer AdcChannelHighLimit [0..1]: 0..65535, multiplicity set at pre-compile, set at pre-compile, default-value=65535  # High limit - used for limit checking.
          integer AdcChannelId: 0..1024, post-build-variant-value=true, set at post-build, symbolic-name-value=true, default-value=0  # This parameter defines the assignment of the channel to the physical ADC hardware channel. HwUnit:0 (SARMUX0) analog pin:0 - 31 / Vmotor:32 / Vaut:33 / AmuxbusA:34 / AmuxbusB:35 / Vccd:36 / Vdda:37 / Vdb:38 / Vtemp:39 / VrefL:62 / VrefH:63 HwUnit:1 (SARMUX1) analog pin:64 - 95 / Vmotor:96 / Vaut:97 / AmuxbusA:98 / AmuxbusB:99 / Vccd:100 / Vdda:101 / Vdb:102 / Vtemp:103 / VrefL:126 / VrefH:127 HwUnit:2 (SARMUX2) analog pin:128 - 159 / Vmotor:160 / Vaut:161 / AmuxbusA:162 / AmuxbusB:163 / Vccd:164 / Vdda:165 / Vdb:166 / Vtemp:167 / VrefL:190 / VrefH:191 HwUnit:3 (SARMUX3) ... ImplementationType: Adc_ChannelType | ImplementationType: Adc_ChannelType
          boolean AdcChannelLimitCheck [0..1]: multiplicity set at pre-compile, set at pre-compile, default-value=false  # Enables or disables limit checking for an ADC channel.
          integer AdcChannelLowLimit [0..1]: 0..65535, multiplicity set at pre-compile, set at pre-compile, default-value=0  # Low limit - used for limit checking.
          enumeration AdcChannelRangeSelect [0..1]: {ADC_RANGE_ALWAYS, ADC_RANGE_BETWEEN, ADC_RANGE_NOT_BETWEEN, ADC_RANGE_NOT_OVER_HIGH, ADC_RANGE_NOT_UNDER_LOW, ADC_RANGE_OVER_HIGH, ADC_RANGE_UNDER_LOW}, multiplicity set at pre-compile, set at pre-compile, default-value=ADC_RANGE_ALWAYS  # In case of active limit checking: defines which conversion values are taken into account related to the borders defined with AdcChannelLowLimit and AdcChannelHighLimit. Implementation Type: Adc_ChannelRangeSelectType | Implementation Type: Adc_ChannelRangeSelectType
          enumeration AdcChannelRefVoltsrcHigh [0..1]: {ADC_NOT_USED}, multiplicity set at post-build, post-build-variant-multiplicity=true, post-build-variant-value=true, set at post-build, default-value=ADC_NOT_USED  # Upper reference voltage source for each channel. Enumeration literals are defined vendor specific. NOTE: This parameter is not used by the ADC Driver and therefore not being evaluated. | Enumeration literals are defined vendor specific.
          enumeration AdcChannelRefVoltsrcLow [0..1]: {ADC_NOT_USED}, multiplicity set at post-build, post-build-variant-multiplicity=true, post-build-variant-value=true, set at post-build, default-value=ADC_NOT_USED  # Lower reference voltage source for each channel. Enumeration literals are defined vendor specific. NOTE: This parameter is not used by the ADC Driver and therefore not being evaluated. | Enumeration literals are defined vendor specific.
          integer AdcChannelResolution [0..1]: 12..12, multiplicity set at post-build, post-build-variant-multiplicity=true, post-build-variant-value=true, set at post-build, default-value=12  # Channel resolution in bits. ImplementationType: Adc_ResolutionType Note: Only 12-bit resolution is available. | ImplementationType: Adc_ResolutionType
          integer AdcChannelSampTime [0..1]: 1..4095, multiplicity set at post-build, post-build-variant-multiplicity=true, post-build-variant-value=true, set at post-build, default-value=1  # Configuration of sampling time, i.e. the time during which the value is sampled, (in clock cycles) for each channel, if supported by hardware. ImplementationType: Adc_SamplingTimeType | ImplementationType: Adc_SamplingTimeType
          boolean AdcChannelResultSigned: origin=Cypress, post-build-variant-value=true, set at post-build, default-value=false  # Determine the conversion result data is singed or unsinged.
        container AdcGroup [1..*]: multiplicity set at post-build, post-build-variant-multiplicity=true  # This container contains the Group configuration (parameters).
          enumeration AdcGroupAccessMode: {ADC_ACCESS_MODE_SINGLE, ADC_ACCESS_MODE_STREAMING}, post-build-variant-value=true, set at post-build, default-value=ADC_ACCESS_MODE_STREAMING  # Type of access mode to group conversion results. ImplementationType: Adc_GroupAccessModeType | ImplementationType: Adc_GroupAccessModeType
          enumeration AdcGroupConversionMode: {ADC_CONV_MODE_CONTINUOUS, ADC_CONV_MODE_ONESHOT}, post-build-variant-value=true, set at post-build, default-value=ADC_CONV_MODE_CONTINUOUS  # Type of conversion mode supported by the driver. ImplementationType: Adc_GroupConvModeType | ImplementationType: Adc_GroupConvModeType
          integer AdcGroupId: 0..1023, set at pre-compile, symbolic-name-value=true, default-value=0  # Numeric ID of the group. This parameter is the symbolic name to be used on the API. This symbolic name allows accessing Channel Group data. This value will be assigned to the symbolic name derived of the AdcGroup container short name. ImplementationType: Adc_GroupType | ImplementationType: Adc_GroupType
          integer AdcGroupPriority [0..1]: 0..7, multiplicity set at post-build, post-build-variant-multiplicity=true, post-build-variant-value=true, set at post-build, default-value=0  # Priority level of the AdcGroup. ImplementationType: Adc_GroupPriorityType | ImplementationType: Adc_GroupPriorityType
          enumeration AdcGroupReplacement [0..1]: {ADC_GROUP_REPL_ABORT_RESTART, ADC_GROUP_REPL_SUSPEND_RESUME, ADC_GROUP_REPL_ABORT_RESUME}, multiplicity set at post-build, post-build-variant-multiplicity=true, post-build-variant-value=true, set at post-build, default-value=ADC_GROUP_REPL_SUSPEND_RESUME  # Replacement mechanism, which is used on ADC group level, if a group conversion is interrupted by a group which has a higher priority. ImplementationType: Adc_GroupReplacementType | ImplementationType: Adc_GroupReplacementType
          enumeration AdcGroupTriggSrc: {ADC_TRIGG_SRC_HW, ADC_TRIGG_SRC_SW}, post-build-variant-value=true, set at post-build, default-value=ADC_TRIGG_SRC_SW  # Type of source event that starts a group conversion. ImplementationType: Adc_TriggerSourceType | ImplementationType: Adc_TriggerSourceType
          enumeration AdcGroupHwTriggSrc [0..1]: {ADC_HWTRIGG_SRC_TCPWM, ADC_HWTRIGG_SRC_GENERIC0, ADC_HWTRIGG_SRC_GENERIC1, ADC_HWTRIGG_SRC_GENERIC2, ADC_HWTRIGG_SRC_GENERIC3, ADC_HWTRIGG_SRC_GENERIC4}, multiplicity set at post-build, origin=Cypress, post-build-variant-multiplicity=true, post-build-variant-value=true, set at post-build, default-value=ADC_HWTRIGG_SRC_TCPWM  # Determine hardware trigger event of the group. ImplementationType: Adc_GroupHwTriggSrcType
          integer AdcGenericTriggerSelect [0..1]: 0..15, multiplicity set at post-build, origin=Cypress, post-build-variant-multiplicity=true, post-build-variant-value=true, set at post-build, default-value=0  # Select generic trigger for SAR generic trigger input.
          enumeration AdcHwTrigSignal [0..1]: {ADC_HW_TRIG_BOTH_EDGES, ADC_HW_TRIG_FALLING_EDGE, ADC_HW_TRIG_RISING_EDGE}, multiplicity set at post-build, post-build-variant-multiplicity=true, post-build-variant-value=true, set at post-build, default-value=ADC_HW_TRIG_BOTH_EDGES  # Configures on which edge of the hardware trigger signal the driver should react, i.e. start the conversion (only if supported by the ADC hardware). ImplementationType: Adc_HwTriggerSignalType NOTE: This parameter is not used by the ADC Driver and therefore not being evaluated. Because the hardware controlled by ADC module does not have this feature. A similar feature is supported by other module (e.g. PORT driver). | ImplementationType: Adc_HwTriggerSignalType
          integer AdcHwTrigTimer [0..1]: 0..9223372036854775807, multiplicity set at post-build, post-build-variant-multiplicity=true, post-build-variant-value=true, set at post-build, default-value=0  # Reload value of the ADC module embedded timer (only if supported by ADC hardware). ImplementationType: Adc_HwTriggerTimerType NOTE: This parameter is not used by the ADC Driver and therefore not being evaluated. Because the hardware controlled by ADC module does not have this feature. A similar feature is supported by other module (e.g. PWM driver). | ImplementationType: Adc_HwTriggerTimerType
          function name AdcNotification [0..1]: multiplicity set at post-build, post-build-variant-multiplicity=true, post-build-variant-value=true, set at post-build, default-value=NotifyFunc  # Callback function for each group.
          enumeration AdcStreamingBufferMode: {ADC_STREAM_BUFFER_CIRCULAR, ADC_STREAM_BUFFER_LINEAR}, post-build-variant-value=true, set at post-build, default-value=ADC_STREAM_BUFFER_LINEAR  # Configure streaming buffer as "linear buffer" (i.e. the ADC Driver stops the conversion as soon as the stream buffer is full) or as "ring buffer" (wraps around if the end of the stream buffer is reached). ImplementationType: Adc_StreamBufferModeType | ImplementationType: Adc_StreamBufferModeType
          integer AdcStreamingNumSamples: 1..255, post-build-variant-value=true, set at post-build, default-value=1  # Number of ADC values to be acquired per channel in streaming access mode. Note: in single access mode this parameter assumes value 1, since only one sample per channel is processed. ImplementationType: Adc_StreamNumSampleType | Note: in single access mode this parameter assumes value 1, since only one sample per channel is processed. ImplementationType: Adc_StreamNumSampleType
          integer AdcFirstLogicalChannel: 0..31, origin=Cypress, post-build-variant-value=true, set at post-build, default-value=0  # First logical channel of the group, i.e. which logical channel should be configured in the HW for the first channel in AdcGroupDefinition. This logical channel may be triggered by a configured HW trigger.
          boolean AdcInterruptMode: origin=Cypress, post-build-variant-value=true, set at post-build, default-value=true  # Enable or disable Interrupt mode for each group. True: interrupt is enabled (interrupt mode) False: interrupt is disabled (polling mode)
          boolean AdcUseDma: origin=Cypress, post-build-variant-value=true, set at post-build, default-value=false  # Enable or disable the DMA for each group. True: DMA is enabled False: DMA is disabled
          boolean AdcUseAlternateCalibration [0..1]: multiplicity set at post-build, origin=Cypress, post-build-variant-multiplicity=true, post-build-variant-value=true, set at post-build, default-value=false  # Determines whether to use alternate calibration values for each group. True: Alternate calibration values are available. False: Alternate calibration values are not available.
          enumeration AdcDmaOutputTriggerSelect [0..1]: {ADC_CHANNEL_DONE_TRIGGER, ADC_GENERIC_TRIGGER}, multiplicity set at post-build, origin=Cypress, post-build-variant-multiplicity=true, post-build-variant-value=true, set at post-build, default-value=ADC_CHANNEL_DONE_TRIGGER  # Selects output trigger type used to trigger DMA if group is active limit checking and using DMA.
          enumeration AdcUseDmaChannel [0..1]: {CPUSS_DW0_TR_IN_0, CPUSS_DW0_TR_IN_1, CPUSS_DW0_TR_IN_2, CPUSS_DW0_TR_IN_3, CPUSS_DW0_TR_IN_4, CPUSS_DW0_TR_IN_5, CPUSS_DW0_TR_IN_6, CPUSS_DW0_TR_IN_7, CPUSS_DW0_TR_IN_8, CPUSS_DW0_TR_IN_9, CPUSS_DW0_TR_IN_10, CPUSS_DW0_TR_IN_11, CPUSS_DW0_TR_IN_12, CPUSS_DW0_TR_IN_13, CPUSS_DW0_TR_IN_14, CPUSS_DW0_TR_IN_15, CPUSS_DW0_TR_IN_16, CPUSS_DW0_TR_IN_17, CPUSS_DW0_TR_IN_18, CPUSS_DW0_TR_IN_19, CPUSS_DW0_TR_IN_20, CPUSS_DW0_TR_IN_21, CPUSS_DW0_TR_IN_22, CPUSS_DW0_TR_IN_23, CPUSS_DW0_TR_IN_24, CPUSS_DW0_TR_IN_25, CPUSS_DW0_TR_IN_26, CPUSS_DW0_TR_IN_27, CPUSS_DW0_TR_IN_28, CPUSS_DW0_TR_IN_29, CPUSS_DW0_TR_IN_30, CPUSS_DW0_TR_IN_31, CPUSS_DW0_TR_IN_32, CPUSS_DW0_TR_IN_33, CPUSS_DW0_TR_IN_34, CPUSS_DW0_TR_IN_35, CPUSS_DW0_TR_IN_36, CPUSS_DW0_TR_IN_37, CPUSS_DW0_TR_IN_38, CPUSS_DW0_TR_IN_39, CPUSS_DW0_TR_IN_40, CPUSS_DW0_TR_IN_41, CPUSS_DW0_TR_IN_42, CPUSS_DW0_TR_IN_43, CPUSS_DW0_TR_IN_44, CPUSS_DW0_TR_IN_45, CPUSS_DW0_TR_IN_46, CPUSS_DW0_TR_IN_47, CPUSS_DW0_TR_IN_48, CPUSS_DW0_TR_IN_49, CPUSS_DW0_TR_IN_50, CPUSS_DW0_TR_IN_51, CPUSS_DW0_TR_IN_52, CPUSS_DW0_TR_IN_53, CPUSS_DW0_TR_IN_54, CPUSS_DW0_TR_IN_55, CPUSS_DW0_TR_IN_56, CPUSS_DW0_TR_IN_57, CPUSS_DW0_TR_IN_58, CPUSS_DW0_TR_IN_59, CPUSS_DW0_TR_IN_60, CPUSS_DW0_TR_IN_61, CPUSS_DW0_TR_IN_62, CPUSS_DW0_TR_IN_63, CPUSS_DW0_TR_IN_64, CPUSS_DW0_TR_IN_65, CPUSS_DW0_TR_IN_66, CPUSS_DW0_TR_IN_67, CPUSS_DW0_TR_IN_68, CPUSS_DW0_TR_IN_69, CPUSS_DW0_TR_IN_70, CPUSS_DW0_TR_IN_71, CPUSS_DW0_TR_IN_72, CPUSS_DW0_TR_IN_73, CPUSS_DW0_TR_IN_74, CPUSS_DW0_TR_IN_75, CPUSS_DW0_TR_IN_76, CPUSS_DW0_TR_IN_77, CPUSS_DW0_TR_IN_78, CPUSS_DW0_TR_IN_79, CPUSS_DW0_TR_IN_80, CPUSS_DW0_TR_IN_81, CPUSS_DW0_TR_IN_82, CPUSS_DW0_TR_IN_83, CPUSS_DW0_TR_IN_84, CPUSS_DW0_TR_IN_85, CPUSS_DW0_TR_IN_86, CPUSS_DW0_TR_IN_87, CPUSS_DW0_TR_IN_88, CPUSS_DW0_TR_IN_89, CPUSS_DW0_TR_IN_90, CPUSS_DW0_TR_IN_91, CPUSS_DW0_TR_IN_92, CPUSS_DW0_TR_IN_93, CPUSS_DW0_TR_IN_94, CPUSS_DW0_TR_IN_95, CPUSS_DW0_TR_IN_96, CPUSS_DW0_TR_IN_97, CPUSS_DW0_TR_IN_98, CPUSS_DW0_TR_IN_99, CPUSS_DW0_TR_IN_100, CPUSS_DW0_TR_IN_101, CPUSS_DW0_TR_IN_102, CPUSS_DW0_TR_IN_103, CPUSS_DW0_TR_IN_104, CPUSS_DW0_TR_IN_105, CPUSS_DW0_TR_IN_106, CPUSS_DW0_TR_IN_107, CPUSS_DW0_TR_IN_108, CPUSS_DW0_TR_IN_109, CPUSS_DW0_TR_IN_110, CPUSS_DW0_TR_IN_111, CPUSS_DW0_TR_IN_112, CPUSS_DW0_TR_IN_113, CPUSS_DW0_TR_IN_114, CPUSS_DW0_TR_IN_115, CPUSS_DW0_TR_IN_116, CPUSS_DW0_TR_IN_117, CPUSS_DW0_TR_IN_118, CPUSS_DW0_TR_IN_119, CPUSS_DW0_TR_IN_120, CPUSS_DW0_TR_IN_121, CPUSS_DW0_TR_IN_122, CPUSS_DW0_TR_IN_123, CPUSS_DW0_TR_IN_124, CPUSS_DW0_TR_IN_125, CPUSS_DW0_TR_IN_126, CPUSS_DW0_TR_IN_127, CPUSS_DW0_TR_IN_128, CPUSS_DW0_TR_IN_129, CPUSS_DW0_TR_IN_130, CPUSS_DW0_TR_IN_131, CPUSS_DW0_TR_IN_132, CPUSS_DW0_TR_IN_133, CPUSS_DW0_TR_IN_134, CPUSS_DW0_TR_IN_135, CPUSS_DW0_TR_IN_136, CPUSS_DW0_TR_IN_137, CPUSS_DW0_TR_IN_138, CPUSS_DW0_TR_IN_139, CPUSS_DW0_TR_IN_140, CPUSS_DW0_TR_IN_141, CPUSS_DW0_TR_IN_142, CPUSS_DW0_TR_IN_143, CPUSS_DW0_TR_IN_144, CPUSS_DW0_TR_IN_145, CPUSS_DW0_TR_IN_146, CPUSS_DW0_TR_IN_147, CPUSS_DW0_TR_IN_148, CPUSS_DW0_TR_IN_149, CPUSS_DW0_TR_IN_150, CPUSS_DW0_TR_IN_151, CPUSS_DW0_TR_IN_152, CPUSS_DW0_TR_IN_153, CPUSS_DW0_TR_IN_154, CPUSS_DW0_TR_IN_155, CPUSS_DW0_TR_IN_156, CPUSS_DW0_TR_IN_157, CPUSS_DW0_TR_IN_158, CPUSS_DW0_TR_IN_159, CPUSS_DW0_TR_IN_160, CPUSS_DW0_TR_IN_161, CPUSS_DW0_TR_IN_162, CPUSS_DW0_TR_IN_163, CPUSS_DW0_TR_IN_164, CPUSS_DW0_TR_IN_165, CPUSS_DW0_TR_IN_166, CPUSS_DW0_TR_IN_167, CPUSS_DW0_TR_IN_168, CPUSS_DW0_TR_IN_169, CPUSS_DW0_TR_IN_170, CPUSS_DW0_TR_IN_171, CPUSS_DW0_TR_IN_172, CPUSS_DW0_TR_IN_173, CPUSS_DW0_TR_IN_174, CPUSS_DW0_TR_IN_175, CPUSS_DW0_TR_IN_176, CPUSS_DW0_TR_IN_177, CPUSS_DW0_TR_IN_178, CPUSS_DW0_TR_IN_179, CPUSS_DW0_TR_IN_180, CPUSS_DW0_TR_IN_181, CPUSS_DW0_TR_IN_182, CPUSS_DW0_TR_IN_183, CPUSS_DW0_TR_IN_184, CPUSS_DW0_TR_IN_185, CPUSS_DW0_TR_IN_186, CPUSS_DW0_TR_IN_187, CPUSS_DW0_TR_IN_188, CPUSS_DW0_TR_IN_189, CPUSS_DW0_TR_IN_190, CPUSS_DW0_TR_IN_191, CPUSS_DW0_TR_IN_192, CPUSS_DW0_TR_IN_193, CPUSS_DW0_TR_IN_194, CPUSS_DW0_TR_IN_195, CPUSS_DW0_TR_IN_196, CPUSS_DW0_TR_IN_197, CPUSS_DW0_TR_IN_198, CPUSS_DW0_TR_IN_199, CPUSS_DW0_TR_IN_200, CPUSS_DW0_TR_IN_201, CPUSS_DW0_TR_IN_202, CPUSS_DW0_TR_IN_203, CPUSS_DW0_TR_IN_204, CPUSS_DW0_TR_IN_205, CPUSS_DW0_TR_IN_206, CPUSS_DW0_TR_IN_207, CPUSS_DW0_TR_IN_208, CPUSS_DW0_TR_IN_209, CPUSS_DW0_TR_IN_210, CPUSS_DW0_TR_IN_211, CPUSS_DW0_TR_IN_212, CPUSS_DW0_TR_IN_213, CPUSS_DW0_TR_IN_214, CPUSS_DW0_TR_IN_215, CPUSS_DW0_TR_IN_216, CPUSS_DW0_TR_IN_217, CPUSS_DW0_TR_IN_218, CPUSS_DW0_TR_IN_219, CPUSS_DW0_TR_IN_220, CPUSS_DW0_TR_IN_221, CPUSS_DW0_TR_IN_222, CPUSS_DW0_TR_IN_223, CPUSS_DW0_TR_IN_224, CPUSS_DW0_TR_IN_225, CPUSS_DW0_TR_IN_226, CPUSS_DW0_TR_IN_227, CPUSS_DW0_TR_IN_228, CPUSS_DW0_TR_IN_229, CPUSS_DW0_TR_IN_230, CPUSS_DW0_TR_IN_231, CPUSS_DW0_TR_IN_232, CPUSS_DW0_TR_IN_233, CPUSS_DW0_TR_IN_234, CPUSS_DW0_TR_IN_235, CPUSS_DW0_TR_IN_236, CPUSS_DW0_TR_IN_237, CPUSS_DW0_TR_IN_238, CPUSS_DW0_TR_IN_239, CPUSS_DW0_TR_IN_240, CPUSS_DW0_TR_IN_241, CPUSS_DW0_TR_IN_242, CPUSS_DW0_TR_IN_243, CPUSS_DW0_TR_IN_244, CPUSS_DW0_TR_IN_245, CPUSS_DW0_TR_IN_246, CPUSS_DW0_TR_IN_247, CPUSS_DW0_TR_IN_248, CPUSS_DW0_TR_IN_249, CPUSS_DW0_TR_IN_250, CPUSS_DW0_TR_IN_251, CPUSS_DW0_TR_IN_252, CPUSS_DW0_TR_IN_253, CPUSS_DW0_TR_IN_254, CPUSS_DW0_TR_IN_255, CPUSS_DW0_TR_IN_256, CPUSS_DW0_TR_IN_257, CPUSS_DW0_TR_IN_258, CPUSS_DW0_TR_IN_259, CPUSS_DW0_TR_IN_260, CPUSS_DW0_TR_IN_261, CPUSS_DW0_TR_IN_262, CPUSS_DW0_TR_IN_263, CPUSS_DW0_TR_IN_264, CPUSS_DW0_TR_IN_265, CPUSS_DW0_TR_IN_266, CPUSS_DW0_TR_IN_267, CPUSS_DW0_TR_IN_268, CPUSS_DW0_TR_IN_269, CPUSS_DW0_TR_IN_270, CPUSS_DW0_TR_IN_271, CPUSS_DW0_TR_IN_272, CPUSS_DW0_TR_IN_273, CPUSS_DW0_TR_IN_274, CPUSS_DW0_TR_IN_275, CPUSS_DW0_TR_IN_276, CPUSS_DW0_TR_IN_277, CPUSS_DW0_TR_IN_278, CPUSS_DW0_TR_IN_279, CPUSS_DW0_TR_IN_280, CPUSS_DW0_TR_IN_281, CPUSS_DW0_TR_IN_282, CPUSS_DW0_TR_IN_283, CPUSS_DW0_TR_IN_284, CPUSS_DW0_TR_IN_285, CPUSS_DW0_TR_IN_286, CPUSS_DW0_TR_IN_287, CPUSS_DW0_TR_IN_288, CPUSS_DW0_TR_IN_289, CPUSS_DW0_TR_IN_290, CPUSS_DW0_TR_IN_291, CPUSS_DW0_TR_IN_292, CPUSS_DW0_TR_IN_293, CPUSS_DW0_TR_IN_294, CPUSS_DW0_TR_IN_295, CPUSS_DW0_TR_IN_296, CPUSS_DW0_TR_IN_297, CPUSS_DW0_TR_IN_298, CPUSS_DW0_TR_IN_299, CPUSS_DW0_TR_IN_300, CPUSS_DW0_TR_IN_301, CPUSS_DW0_TR_IN_302, CPUSS_DW0_TR_IN_303, CPUSS_DW0_TR_IN_304, CPUSS_DW0_TR_IN_305, CPUSS_DW0_TR_IN_306, CPUSS_DW0_TR_IN_307, CPUSS_DW0_TR_IN_308, CPUSS_DW0_TR_IN_309, CPUSS_DW0_TR_IN_310, CPUSS_DW0_TR_IN_311, CPUSS_DW0_TR_IN_312, CPUSS_DW0_TR_IN_313, CPUSS_DW0_TR_IN_314, CPUSS_DW0_TR_IN_315, CPUSS_DW0_TR_IN_316, CPUSS_DW0_TR_IN_317, CPUSS_DW0_TR_IN_318, CPUSS_DW0_TR_IN_319, CPUSS_DW0_TR_IN_320, CPUSS_DW0_TR_IN_321, CPUSS_DW0_TR_IN_322, CPUSS_DW0_TR_IN_323, CPUSS_DW0_TR_IN_324, CPUSS_DW0_TR_IN_325, CPUSS_DW0_TR_IN_326, CPUSS_DW0_TR_IN_327, CPUSS_DW0_TR_IN_328, CPUSS_DW0_TR_IN_329, CPUSS_DW0_TR_IN_330, CPUSS_DW0_TR_IN_331, CPUSS_DW0_TR_IN_332, CPUSS_DW0_TR_IN_333, CPUSS_DW0_TR_IN_334, CPUSS_DW0_TR_IN_335, CPUSS_DW0_TR_IN_336, CPUSS_DW0_TR_IN_337, CPUSS_DW0_TR_IN_338, CPUSS_DW0_TR_IN_339, CPUSS_DW0_TR_IN_340, CPUSS_DW0_TR_IN_341, CPUSS_DW0_TR_IN_342, CPUSS_DW0_TR_IN_343, CPUSS_DW0_TR_IN_344, CPUSS_DW0_TR_IN_345, CPUSS_DW0_TR_IN_346, CPUSS_DW0_TR_IN_347, CPUSS_DW0_TR_IN_348, CPUSS_DW0_TR_IN_349, CPUSS_DW0_TR_IN_350, CPUSS_DW0_TR_IN_351, CPUSS_DW0_TR_IN_352, CPUSS_DW0_TR_IN_353, CPUSS_DW0_TR_IN_354, CPUSS_DW0_TR_IN_355, CPUSS_DW0_TR_IN_356, CPUSS_DW0_TR_IN_357, CPUSS_DW0_TR_IN_358, CPUSS_DW0_TR_IN_359, CPUSS_DW0_TR_IN_360, CPUSS_DW0_TR_IN_361, CPUSS_DW0_TR_IN_362, CPUSS_DW0_TR_IN_363, CPUSS_DW0_TR_IN_364, CPUSS_DW0_TR_IN_365, CPUSS_DW0_TR_IN_366, CPUSS_DW0_TR_IN_367, CPUSS_DW0_TR_IN_368, CPUSS_DW0_TR_IN_369, CPUSS_DW0_TR_IN_370, CPUSS_DW0_TR_IN_371, CPUSS_DW0_TR_IN_372, CPUSS_DW0_TR_IN_373, CPUSS_DW0_TR_IN_374, CPUSS_DW0_TR_IN_375, CPUSS_DW0_TR_IN_376, CPUSS_DW0_TR_IN_377, CPUSS_DW0_TR_IN_378, CPUSS_DW0_TR_IN_379, CPUSS_DW0_TR_IN_380, CPUSS_DW0_TR_IN_381, CPUSS_DW0_TR_IN_382, CPUSS_DW0_TR_IN_383, CPUSS_DW0_TR_IN_384, CPUSS_DW0_TR_IN_385, CPUSS_DW0_TR_IN_386, CPUSS_DW0_TR_IN_387, CPUSS_DW0_TR_IN_388, CPUSS_DW0_TR_IN_389, CPUSS_DW0_TR_IN_390, CPUSS_DW0_TR_IN_391, CPUSS_DW0_TR_IN_392, CPUSS_DW0_TR_IN_393, CPUSS_DW0_TR_IN_394, CPUSS_DW0_TR_IN_395, CPUSS_DW0_TR_IN_396, CPUSS_DW0_TR_IN_397, CPUSS_DW0_TR_IN_398, CPUSS_DW0_TR_IN_399, CPUSS_DW0_TR_IN_400, CPUSS_DW0_TR_IN_401, CPUSS_DW0_TR_IN_402, CPUSS_DW0_TR_IN_403, CPUSS_DW0_TR_IN_404, CPUSS_DW0_TR_IN_405, CPUSS_DW0_TR_IN_406, CPUSS_DW0_TR_IN_407, CPUSS_DW0_TR_IN_408, CPUSS_DW0_TR_IN_409, CPUSS_DW0_TR_IN_410, CPUSS_DW0_TR_IN_411, CPUSS_DW0_TR_IN_412, CPUSS_DW0_TR_IN_413, CPUSS_DW0_TR_IN_414, CPUSS_DW0_TR_IN_415, CPUSS_DW0_TR_IN_416, CPUSS_DW0_TR_IN_417, CPUSS_DW0_TR_IN_418, CPUSS_DW0_TR_IN_419, CPUSS_DW0_TR_IN_420, CPUSS_DW0_TR_IN_421, CPUSS_DW0_TR_IN_422, CPUSS_DW0_TR_IN_423, CPUSS_DW0_TR_IN_424, CPUSS_DW0_TR_IN_425, CPUSS_DW0_TR_IN_426, CPUSS_DW0_TR_IN_427, CPUSS_DW0_TR_IN_428, CPUSS_DW0_TR_IN_429, CPUSS_DW0_TR_IN_430, CPUSS_DW0_TR_IN_431, CPUSS_DW0_TR_IN_432, CPUSS_DW0_TR_IN_433, CPUSS_DW0_TR_IN_434, CPUSS_DW0_TR_IN_435, CPUSS_DW0_TR_IN_436, CPUSS_DW0_TR_IN_437, CPUSS_DW0_TR_IN_438, CPUSS_DW0_TR_IN_439, CPUSS_DW0_TR_IN_440, CPUSS_DW0_TR_IN_441, CPUSS_DW0_TR_IN_442, CPUSS_DW0_TR_IN_443, CPUSS_DW0_TR_IN_444, CPUSS_DW0_TR_IN_445, CPUSS_DW0_TR_IN_446, CPUSS_DW0_TR_IN_447, CPUSS_DW0_TR_IN_448, CPUSS_DW0_TR_IN_449, CPUSS_DW0_TR_IN_450, CPUSS_DW0_TR_IN_451, CPUSS_DW0_TR_IN_452, CPUSS_DW0_TR_IN_453, CPUSS_DW0_TR_IN_454, CPUSS_DW0_TR_IN_455, CPUSS_DW0_TR_IN_456, CPUSS_DW0_TR_IN_457, CPUSS_DW0_TR_IN_458, CPUSS_DW0_TR_IN_459, CPUSS_DW0_TR_IN_460, CPUSS_DW0_TR_IN_461, CPUSS_DW0_TR_IN_462, CPUSS_DW0_TR_IN_463, CPUSS_DW0_TR_IN_464, CPUSS_DW0_TR_IN_465, CPUSS_DW0_TR_IN_466, CPUSS_DW0_TR_IN_467, CPUSS_DW0_TR_IN_468, CPUSS_DW0_TR_IN_469, CPUSS_DW0_TR_IN_470, CPUSS_DW0_TR_IN_471, CPUSS_DW0_TR_IN_472, CPUSS_DW0_TR_IN_473, CPUSS_DW0_TR_IN_474, CPUSS_DW0_TR_IN_475, CPUSS_DW0_TR_IN_476, CPUSS_DW0_TR_IN_477, CPUSS_DW0_TR_IN_478, CPUSS_DW0_TR_IN_479, CPUSS_DW0_TR_IN_480, CPUSS_DW0_TR_IN_481, CPUSS_DW0_TR_IN_482, CPUSS_DW0_TR_IN_483, CPUSS_DW0_TR_IN_484, CPUSS_DW0_TR_IN_485, CPUSS_DW0_TR_IN_486, CPUSS_DW0_TR_IN_487, CPUSS_DW0_TR_IN_488, CPUSS_DW0_TR_IN_489, CPUSS_DW0_TR_IN_490, CPUSS_DW0_TR_IN_491, CPUSS_DW0_TR_IN_492, CPUSS_DW0_TR_IN_493, CPUSS_DW0_TR_IN_494, CPUSS_DW0_TR_IN_495, CPUSS_DW0_TR_IN_496, CPUSS_DW0_TR_IN_497, CPUSS_DW0_TR_IN_498, CPUSS_DW0_TR_IN_499, CPUSS_DW0_TR_IN_500, CPUSS_DW0_TR_IN_501, CPUSS_DW0_TR_IN_502, CPUSS_DW0_TR_IN_503, CPUSS_DW0_TR_IN_504, CPUSS_DW0_TR_IN_505, CPUSS_DW0_TR_IN_506, CPUSS_DW0_TR_IN_507, CPUSS_DW0_TR_IN_508, CPUSS_DW0_TR_IN_509, CPUSS_DW0_TR_IN_510, CPUSS_DW0_TR_IN_511, CPUSS_DW1_TR_IN_0, CPUSS_DW1_TR_IN_1, CPUSS_DW1_TR_IN_2, CPUSS_DW1_TR_IN_3, CPUSS_DW1_TR_IN_4, CPUSS_DW1_TR_IN_5, CPUSS_DW1_TR_IN_6, CPUSS_DW1_TR_IN_7, CPUSS_DW1_TR_IN_8, CPUSS_DW1_TR_IN_9, CPUSS_DW1_TR_IN_10, CPUSS_DW1_TR_IN_11, CPUSS_DW1_TR_IN_12, CPUSS_DW1_TR_IN_13, CPUSS_DW1_TR_IN_14, CPUSS_DW1_TR_IN_15, CPUSS_DW1_TR_IN_16, CPUSS_DW1_TR_IN_17, CPUSS_DW1_TR_IN_18, CPUSS_DW1_TR_IN_19, CPUSS_DW1_TR_IN_20, CPUSS_DW1_TR_IN_21, CPUSS_DW1_TR_IN_22, CPUSS_DW1_TR_IN_23, CPUSS_DW1_TR_IN_24, CPUSS_DW1_TR_IN_25, CPUSS_DW1_TR_IN_26, CPUSS_DW1_TR_IN_27, CPUSS_DW1_TR_IN_28, CPUSS_DW1_TR_IN_29, CPUSS_DW1_TR_IN_30, CPUSS_DW1_TR_IN_31, CPUSS_DW1_TR_IN_32, CPUSS_DW1_TR_IN_33, CPUSS_DW1_TR_IN_34, CPUSS_DW1_TR_IN_35, CPUSS_DW1_TR_IN_36, CPUSS_DW1_TR_IN_37, CPUSS_DW1_TR_IN_38, CPUSS_DW1_TR_IN_39, CPUSS_DW1_TR_IN_40, CPUSS_DW1_TR_IN_41, CPUSS_DW1_TR_IN_42, CPUSS_DW1_TR_IN_43, CPUSS_DW1_TR_IN_44, CPUSS_DW1_TR_IN_45, CPUSS_DW1_TR_IN_46, CPUSS_DW1_TR_IN_47, CPUSS_DW1_TR_IN_48, CPUSS_DW1_TR_IN_49, CPUSS_DW1_TR_IN_50, CPUSS_DW1_TR_IN_51, CPUSS_DW1_TR_IN_52, CPUSS_DW1_TR_IN_53, CPUSS_DW1_TR_IN_54, CPUSS_DW1_TR_IN_55, CPUSS_DW1_TR_IN_56, CPUSS_DW1_TR_IN_57, CPUSS_DW1_TR_IN_58, CPUSS_DW1_TR_IN_59, CPUSS_DW1_TR_IN_60, CPUSS_DW1_TR_IN_61, CPUSS_DW1_TR_IN_62, CPUSS_DW1_TR_IN_63, CPUSS_DW1_TR_IN_64, CPUSS_DW1_TR_IN_65, CPUSS_DW1_TR_IN_66, CPUSS_DW1_TR_IN_67, CPUSS_DW1_TR_IN_68, CPUSS_DW1_TR_IN_69, CPUSS_DW1_TR_IN_70, CPUSS_DW1_TR_IN_71, CPUSS_DW1_TR_IN_72, CPUSS_DW1_TR_IN_73, CPUSS_DW1_TR_IN_74, CPUSS_DW1_TR_IN_75, CPUSS_DW1_TR_IN_76, CPUSS_DW1_TR_IN_77, CPUSS_DW1_TR_IN_78, CPUSS_DW1_TR_IN_79, CPUSS_DW1_TR_IN_80, CPUSS_DW1_TR_IN_81, CPUSS_DW1_TR_IN_82, CPUSS_DW1_TR_IN_83, CPUSS_DW1_TR_IN_84, CPUSS_DW1_TR_IN_85, CPUSS_DW1_TR_IN_86, CPUSS_DW1_TR_IN_87, CPUSS_DW1_TR_IN_88, CPUSS_DW1_TR_IN_89, CPUSS_DW1_TR_IN_90, CPUSS_DW1_TR_IN_91, CPUSS_DW1_TR_IN_92, CPUSS_DW1_TR_IN_93, CPUSS_DW1_TR_IN_94, CPUSS_DW1_TR_IN_95, CPUSS_DW1_TR_IN_96, CPUSS_DW1_TR_IN_97, CPUSS_DW1_TR_IN_98, CPUSS_DW1_TR_IN_99, CPUSS_DW1_TR_IN_100, CPUSS_DW1_TR_IN_101, CPUSS_DW1_TR_IN_102, CPUSS_DW1_TR_IN_103, CPUSS_DW1_TR_IN_104, CPUSS_DW1_TR_IN_105, CPUSS_DW1_TR_IN_106, CPUSS_DW1_TR_IN_107, CPUSS_DW1_TR_IN_108, CPUSS_DW1_TR_IN_109, CPUSS_DW1_TR_IN_110, CPUSS_DW1_TR_IN_111, CPUSS_DW1_TR_IN_112, CPUSS_DW1_TR_IN_113, CPUSS_DW1_TR_IN_114, CPUSS_DW1_TR_IN_115, CPUSS_DW1_TR_IN_116, CPUSS_DW1_TR_IN_117, CPUSS_DW1_TR_IN_118, CPUSS_DW1_TR_IN_119, CPUSS_DW1_TR_IN_120, CPUSS_DW1_TR_IN_121, CPUSS_DW1_TR_IN_122, CPUSS_DW1_TR_IN_123, CPUSS_DW1_TR_IN_124, CPUSS_DW1_TR_IN_125, CPUSS_DW1_TR_IN_126, CPUSS_DW1_TR_IN_127, CPUSS_DW1_TR_IN_128, CPUSS_DW1_TR_IN_129, CPUSS_DW1_TR_IN_130, CPUSS_DW1_TR_IN_131, CPUSS_DW1_TR_IN_132, CPUSS_DW1_TR_IN_133, CPUSS_DW1_TR_IN_134, CPUSS_DW1_TR_IN_135, CPUSS_DW1_TR_IN_136, CPUSS_DW1_TR_IN_137, CPUSS_DW1_TR_IN_138, CPUSS_DW1_TR_IN_139, CPUSS_DW1_TR_IN_140, CPUSS_DW1_TR_IN_141, CPUSS_DW1_TR_IN_142, CPUSS_DW1_TR_IN_143, CPUSS_DW1_TR_IN_144, CPUSS_DW1_TR_IN_145, CPUSS_DW1_TR_IN_146, CPUSS_DW1_TR_IN_147, CPUSS_DW1_TR_IN_148, CPUSS_DW1_TR_IN_149, CPUSS_DW1_TR_IN_150, CPUSS_DW1_TR_IN_151, CPUSS_DW1_TR_IN_152, CPUSS_DW1_TR_IN_153, CPUSS_DW1_TR_IN_154, CPUSS_DW1_TR_IN_155, CPUSS_DW1_TR_IN_156, CPUSS_DW1_TR_IN_157, CPUSS_DW1_TR_IN_158, CPUSS_DW1_TR_IN_159, CPUSS_DW1_TR_IN_160, CPUSS_DW1_TR_IN_161, CPUSS_DW1_TR_IN_162, CPUSS_DW1_TR_IN_163, CPUSS_DW1_TR_IN_164, CPUSS_DW1_TR_IN_165, CPUSS_DW1_TR_IN_166, CPUSS_DW1_TR_IN_167, CPUSS_DW1_TR_IN_168, CPUSS_DW1_TR_IN_169, CPUSS_DW1_TR_IN_170, CPUSS_DW1_TR_IN_171, CPUSS_DW1_TR_IN_172, CPUSS_DW1_TR_IN_173, CPUSS_DW1_TR_IN_174, CPUSS_DW1_TR_IN_175, CPUSS_DW1_TR_IN_176, CPUSS_DW1_TR_IN_177, CPUSS_DW1_TR_IN_178, CPUSS_DW1_TR_IN_179, CPUSS_DW1_TR_IN_180, CPUSS_DW1_TR_IN_181, CPUSS_DW1_TR_IN_182, CPUSS_DW1_TR_IN_183, CPUSS_DW1_TR_IN_184, CPUSS_DW1_TR_IN_185, CPUSS_DW1_TR_IN_186, CPUSS_DW1_TR_IN_187, CPUSS_DW1_TR_IN_188, CPUSS_DW1_TR_IN_189, CPUSS_DW1_TR_IN_190, CPUSS_DW1_TR_IN_191, CPUSS_DW1_TR_IN_192, CPUSS_DW1_TR_IN_193, CPUSS_DW1_TR_IN_194, CPUSS_DW1_TR_IN_195, CPUSS_DW1_TR_IN_196, CPUSS_DW1_TR_IN_197, CPUSS_DW1_TR_IN_198, CPUSS_DW1_TR_IN_199, CPUSS_DW1_TR_IN_200, CPUSS_DW1_TR_IN_201, CPUSS_DW1_TR_IN_202, CPUSS_DW1_TR_IN_203, CPUSS_DW1_TR_IN_204, CPUSS_DW1_TR_IN_205, CPUSS_DW1_TR_IN_206, CPUSS_DW1_TR_IN_207, CPUSS_DW1_TR_IN_208, CPUSS_DW1_TR_IN_209, CPUSS_DW1_TR_IN_210, CPUSS_DW1_TR_IN_211, CPUSS_DW1_TR_IN_212, CPUSS_DW1_TR_IN_213, CPUSS_DW1_TR_IN_214, CPUSS_DW1_TR_IN_215, CPUSS_DW1_TR_IN_216, CPUSS_DW1_TR_IN_217, CPUSS_DW1_TR_IN_218, CPUSS_DW1_TR_IN_219, CPUSS_DW1_TR_IN_220, CPUSS_DW1_TR_IN_221, CPUSS_DW1_TR_IN_222, CPUSS_DW1_TR_IN_223, CPUSS_DW1_TR_IN_224, CPUSS_DW1_TR_IN_225, CPUSS_DW1_TR_IN_226, CPUSS_DW1_TR_IN_227, CPUSS_DW1_TR_IN_228, CPUSS_DW1_TR_IN_229, CPUSS_DW1_TR_IN_230, CPUSS_DW1_TR_IN_231, CPUSS_DW1_TR_IN_232, CPUSS_DW1_TR_IN_233, CPUSS_DW1_TR_IN_234, CPUSS_DW1_TR_IN_235, CPUSS_DW1_TR_IN_236, CPUSS_DW1_TR_IN_237, CPUSS_DW1_TR_IN_238, CPUSS_DW1_TR_IN_239, CPUSS_DW1_TR_IN_240, CPUSS_DW1_TR_IN_241, CPUSS_DW1_TR_IN_242, CPUSS_DW1_TR_IN_243, CPUSS_DW1_TR_IN_244, CPUSS_DW1_TR_IN_245, CPUSS_DW1_TR_IN_246, CPUSS_DW1_TR_IN_247, CPUSS_DW1_TR_IN_248, CPUSS_DW1_TR_IN_249, CPUSS_DW1_TR_IN_250, CPUSS_DW1_TR_IN_251, CPUSS_DW1_TR_IN_252, CPUSS_DW1_TR_IN_253, CPUSS_DW1_TR_IN_254, CPUSS_DW1_TR_IN_255, CPUSS_DW1_TR_IN_256, CPUSS_DW1_TR_IN_257, CPUSS_DW1_TR_IN_258, CPUSS_DW1_TR_IN_259, CPUSS_DW1_TR_IN_260, CPUSS_DW1_TR_IN_261, CPUSS_DW1_TR_IN_262, CPUSS_DW1_TR_IN_263, CPUSS_DW1_TR_IN_264, CPUSS_DW1_TR_IN_265, CPUSS_DW1_TR_IN_266, CPUSS_DW1_TR_IN_267, CPUSS_DW1_TR_IN_268, CPUSS_DW1_TR_IN_269, CPUSS_DW1_TR_IN_270, CPUSS_DW1_TR_IN_271, CPUSS_DW1_TR_IN_272, CPUSS_DW1_TR_IN_273, CPUSS_DW1_TR_IN_274, CPUSS_DW1_TR_IN_275, CPUSS_DW1_TR_IN_276, CPUSS_DW1_TR_IN_277, CPUSS_DW1_TR_IN_278, CPUSS_DW1_TR_IN_279, CPUSS_DW1_TR_IN_280, CPUSS_DW1_TR_IN_281, CPUSS_DW1_TR_IN_282, CPUSS_DW1_TR_IN_283, CPUSS_DW1_TR_IN_284, CPUSS_DW1_TR_IN_285, CPUSS_DW1_TR_IN_286, CPUSS_DW1_TR_IN_287, CPUSS_DW1_TR_IN_288, CPUSS_DW1_TR_IN_289, CPUSS_DW1_TR_IN_290, CPUSS_DW1_TR_IN_291, CPUSS_DW1_TR_IN_292, CPUSS_DW1_TR_IN_293, CPUSS_DW1_TR_IN_294, CPUSS_DW1_TR_IN_295, CPUSS_DW1_TR_IN_296, CPUSS_DW1_TR_IN_297, CPUSS_DW1_TR_IN_298, CPUSS_DW1_TR_IN_299, CPUSS_DW1_TR_IN_300, CPUSS_DW1_TR_IN_301, CPUSS_DW1_TR_IN_302, CPUSS_DW1_TR_IN_303, CPUSS_DW1_TR_IN_304, CPUSS_DW1_TR_IN_305, CPUSS_DW1_TR_IN_306, CPUSS_DW1_TR_IN_307, CPUSS_DW1_TR_IN_308, CPUSS_DW1_TR_IN_309, CPUSS_DW1_TR_IN_310, CPUSS_DW1_TR_IN_311, CPUSS_DW1_TR_IN_312, CPUSS_DW1_TR_IN_313, CPUSS_DW1_TR_IN_314, CPUSS_DW1_TR_IN_315, CPUSS_DW1_TR_IN_316, CPUSS_DW1_TR_IN_317, CPUSS_DW1_TR_IN_318, CPUSS_DW1_TR_IN_319, CPUSS_DW1_TR_IN_320, CPUSS_DW1_TR_IN_321, CPUSS_DW1_TR_IN_322, CPUSS_DW1_TR_IN_323, CPUSS_DW1_TR_IN_324, CPUSS_DW1_TR_IN_325, CPUSS_DW1_TR_IN_326, CPUSS_DW1_TR_IN_327, CPUSS_DW1_TR_IN_328, CPUSS_DW1_TR_IN_329, CPUSS_DW1_TR_IN_330, CPUSS_DW1_TR_IN_331, CPUSS_DW1_TR_IN_332, CPUSS_DW1_TR_IN_333, CPUSS_DW1_TR_IN_334, CPUSS_DW1_TR_IN_335, CPUSS_DW1_TR_IN_336, CPUSS_DW1_TR_IN_337, CPUSS_DW1_TR_IN_338, CPUSS_DW1_TR_IN_339, CPUSS_DW1_TR_IN_340, CPUSS_DW1_TR_IN_341, CPUSS_DW1_TR_IN_342, CPUSS_DW1_TR_IN_343, CPUSS_DW1_TR_IN_344, CPUSS_DW1_TR_IN_345, CPUSS_DW1_TR_IN_346, CPUSS_DW1_TR_IN_347, CPUSS_DW1_TR_IN_348, CPUSS_DW1_TR_IN_349, CPUSS_DW1_TR_IN_350, CPUSS_DW1_TR_IN_351, CPUSS_DW1_TR_IN_352, CPUSS_DW1_TR_IN_353, CPUSS_DW1_TR_IN_354, CPUSS_DW1_TR_IN_355, CPUSS_DW1_TR_IN_356, CPUSS_DW1_TR_IN_357, CPUSS_DW1_TR_IN_358, CPUSS_DW1_TR_IN_359, CPUSS_DW1_TR_IN_360, CPUSS_DW1_TR_IN_361, CPUSS_DW1_TR_IN_362, CPUSS_DW1_TR_IN_363, CPUSS_DW1_TR_IN_364, CPUSS_DW1_TR_IN_365, CPUSS_DW1_TR_IN_366, CPUSS_DW1_TR_IN_367, CPUSS_DW1_TR_IN_368, CPUSS_DW1_TR_IN_369, CPUSS_DW1_TR_IN_370, CPUSS_DW1_TR_IN_371, CPUSS_DW1_TR_IN_372, CPUSS_DW1_TR_IN_373, CPUSS_DW1_TR_IN_374, CPUSS_DW1_TR_IN_375, CPUSS_DW1_TR_IN_376, CPUSS_DW1_TR_IN_377, CPUSS_DW1_TR_IN_378, CPUSS_DW1_TR_IN_379, CPUSS_DW1_TR_IN_380, CPUSS_DW1_TR_IN_381, CPUSS_DW1_TR_IN_382, CPUSS_DW1_TR_IN_383, CPUSS_DW1_TR_IN_384, CPUSS_DW1_TR_IN_385, CPUSS_DW1_TR_IN_386, CPUSS_DW1_TR_IN_387, CPUSS_DW1_TR_IN_388, CPUSS_DW1_TR_IN_389, CPUSS_DW1_TR_IN_390, CPUSS_DW1_TR_IN_391, CPUSS_DW1_TR_IN_392, CPUSS_DW1_TR_IN_393, CPUSS_DW1_TR_IN_394, CPUSS_DW1_TR_IN_395, CPUSS_DW1_TR_IN_396, CPUSS_DW1_TR_IN_397, CPUSS_DW1_TR_IN_398, CPUSS_DW1_TR_IN_399, CPUSS_DW1_TR_IN_400, CPUSS_DW1_TR_IN_401, CPUSS_DW1_TR_IN_402, CPUSS_DW1_TR_IN_403, CPUSS_DW1_TR_IN_404, CPUSS_DW1_TR_IN_405, CPUSS_DW1_TR_IN_406, CPUSS_DW1_TR_IN_407, CPUSS_DW1_TR_IN_408, CPUSS_DW1_TR_IN_409, CPUSS_DW1_TR_IN_410, CPUSS_DW1_TR_IN_411, CPUSS_DW1_TR_IN_412, CPUSS_DW1_TR_IN_413, CPUSS_DW1_TR_IN_414, CPUSS_DW1_TR_IN_415, CPUSS_DW1_TR_IN_416, CPUSS_DW1_TR_IN_417, CPUSS_DW1_TR_IN_418, CPUSS_DW1_TR_IN_419, CPUSS_DW1_TR_IN_420, CPUSS_DW1_TR_IN_421, CPUSS_DW1_TR_IN_422, CPUSS_DW1_TR_IN_423, CPUSS_DW1_TR_IN_424, CPUSS_DW1_TR_IN_425, CPUSS_DW1_TR_IN_426, CPUSS_DW1_TR_IN_427, CPUSS_DW1_TR_IN_428, CPUSS_DW1_TR_IN_429, CPUSS_DW1_TR_IN_430, CPUSS_DW1_TR_IN_431, CPUSS_DW1_TR_IN_432, CPUSS_DW1_TR_IN_433, CPUSS_DW1_TR_IN_434, CPUSS_DW1_TR_IN_435, CPUSS_DW1_TR_IN_436, CPUSS_DW1_TR_IN_437, CPUSS_DW1_TR_IN_438, CPUSS_DW1_TR_IN_439, CPUSS_DW1_TR_IN_440, CPUSS_DW1_TR_IN_441, CPUSS_DW1_TR_IN_442, CPUSS_DW1_TR_IN_443, CPUSS_DW1_TR_IN_444, CPUSS_DW1_TR_IN_445, CPUSS_DW1_TR_IN_446, CPUSS_DW1_TR_IN_447, CPUSS_DW1_TR_IN_448, CPUSS_DW1_TR_IN_449, CPUSS_DW1_TR_IN_450, CPUSS_DW1_TR_IN_451, CPUSS_DW1_TR_IN_452, CPUSS_DW1_TR_IN_453, CPUSS_DW1_TR_IN_454, CPUSS_DW1_TR_IN_455, CPUSS_DW1_TR_IN_456, CPUSS_DW1_TR_IN_457, CPUSS_DW1_TR_IN_458, CPUSS_DW1_TR_IN_459, CPUSS_DW1_TR_IN_460, CPUSS_DW1_TR_IN_461, CPUSS_DW1_TR_IN_462, CPUSS_DW1_TR_IN_463, CPUSS_DW1_TR_IN_464, CPUSS_DW1_TR_IN_465, CPUSS_DW1_TR_IN_466, CPUSS_DW1_TR_IN_467, CPUSS_DW1_TR_IN_468, CPUSS_DW1_TR_IN_469, CPUSS_DW1_TR_IN_470, CPUSS_DW1_TR_IN_471, CPUSS_DW1_TR_IN_472, CPUSS_DW1_TR_IN_473, CPUSS_DW1_TR_IN_474, CPUSS_DW1_TR_IN_475, CPUSS_DW1_TR_IN_476, CPUSS_DW1_TR_IN_477, CPUSS_DW1_TR_IN_478, CPUSS_DW1_TR_IN_479, CPUSS_DW1_TR_IN_480, CPUSS_DW1_TR_IN_481, CPUSS_DW1_TR_IN_482, CPUSS_DW1_TR_IN_483, CPUSS_DW1_TR_IN_484, CPUSS_DW1_TR_IN_485, CPUSS_DW1_TR_IN_486, CPUSS_DW1_TR_IN_487, CPUSS_DW1_TR_IN_488, CPUSS_DW1_TR_IN_489, CPUSS_DW1_TR_IN_490, CPUSS_DW1_TR_IN_491, CPUSS_DW1_TR_IN_492, CPUSS_DW1_TR_IN_493, CPUSS_DW1_TR_IN_494, CPUSS_DW1_TR_IN_495, CPUSS_DW1_TR_IN_496, CPUSS_DW1_TR_IN_497, CPUSS_DW1_TR_IN_498, CPUSS_DW1_TR_IN_499, CPUSS_DW1_TR_IN_500, CPUSS_DW1_TR_IN_501, CPUSS_DW1_TR_IN_502, CPUSS_DW1_TR_IN_503, CPUSS_DW1_TR_IN_504, CPUSS_DW1_TR_IN_505, CPUSS_DW1_TR_IN_506, CPUSS_DW1_TR_IN_507, CPUSS_DW1_TR_IN_508, CPUSS_DW1_TR_IN_509, CPUSS_DW1_TR_IN_510, CPUSS_DW1_TR_IN_511}, multiplicity set at post-build, origin=Cypress, post-build-variant-multiplicity=true, post-build-variant-value=true, set at post-build, default-value=CPUSS_DW0_TR_IN_8  # Selects DMA channel if generic trigger is used as DMA trigger.
          enumeration AdcUseGenericTriggerOutput [0..1]: {ADC_OUT0_SEL, ADC_OUT1_SEL}, multiplicity set at post-build, origin=Cypress, post-build-variant-multiplicity=true, post-build-variant-value=true, set at post-build, default-value=ADC_OUT0_SEL  # Selects generic trigger output signal if generic trigger is used as DMA trigger.
          enumeration AdcSampleMode: {ADC_SAMPLE_NORMAL, ADC_SAMPLE_NORMAL_HALF, ADC_SAMPLE_NORMAL_FULL, ADC_SAMPLE_NORMAL_MUX, ADC_SAMPLE_VREFL, ADC_SAMPLE_VREFL_HALF, ADC_SAMPLE_VREFL_FULL, ADC_SAMPLE_VREFL_MUX, ADC_SAMPLE_VREFH, ADC_SAMPLE_VREFH_HALF, ADC_SAMPLE_VREFH_FULL, ADC_SAMPLE_VREFH_MUX, ADC_SAMPLE_DIAG, ADC_SAMPLE_DIAG_MUX}, origin=Cypress, post-build-variant-value=true, set at post-build, default-value=ADC_SAMPLE_NORMAL  # The parameter is used to select sampling mode for group.
          reference AdcGroupDefinition [1..*]: multiplicity set at post-build, post-build-variant-multiplicity=true, post-build-variant-value=true, set at post-build, destination=AdcChannel  # Assignment of AdcChannels to an AdcGroups. | ImplementationType: Adc_GroupDefType
    container AdcGeneral  # General configuration (parameters) of the ADC Driver software module.
      boolean AdcDeInitApi: set at pre-compile, default-value=true  # Adds / removes the service Adc_DeInit() from the code. True: Adc_DeInit() can be used. False: Adc_DeInit() can not be used. | true: Adc_DeInit() can be used. false: Adc_DeInit() can not be used.
      boolean AdcDevErrorDetect: set at pre-compile, default-value=true  # Switches the Default Error Tracer (Det) detection and notification ON or OFF. True: enabled (ON). False: disabled (OFF). | * true: enabled (ON). * false: disabled (OFF).
      boolean AdcEnableLimitCheck: set at pre-compile, default-value=false  # Enables or disables limit checking feature in the ADC driver.
      boolean AdcEnableQueuing: set at pre-compile, default-value=true  # Determines, if the queuing mechanism is active in case of priority mechanism disabled. Note: If priority mechanism is enabled, queuing mechanism is always active and the parameter ADC_ENABLE_QUEUING is not evaluated. True: Enabled. False: Disabled. Note: This parameter is not evaluated by the ADC driver because the prioritization mechanism ADC_PRIORITY_NONE is not supported. | Note: If priority mechanism is enabled, queuing mechanism is always active and the parameter ADC_ENABLE_QUEUING is not evaluated. true: Enabled. false: Disabled.
      boolean AdcEnableStartStopGroupApi: set at pre-compile, default-value=true  # Adds / removes the services Adc_StartGroupConversion() and Adc_StopGroupConversion() from the code. True: Adc_StartGroupConversion() and Adc_StopGroupConversion() can be used. False: Adc_StartGroupConversion() and Adc_StopGroupConversion() can not be used. | true: Adc_StartGroupConversion() and Adc_StopGroupConversion() can be used. false: Adc_StartGroupConversion() and Adc_StopGroupConversion() can not be used.
      boolean AdcGrpNotifCapability: set at pre-compile, default-value=true  # Determines, if the group notification mechanism (the functions to enable and disable the notifications) is available at runtime. True: Enabled. False: Disabled. | true: Enabled. false: Disabled.
      boolean AdcHwTriggerApi: set at pre-compile, default-value=true  # Adds / removes the services Adc_EnableHardwareTrigger() and Adc_DisableHardwareTrigger() from the code. True: Adc_EnableHardwareTrigger() and Adc_DisableHardwareTrigger() can be used. False: Adc_EnableHardwareTrigger() and Adc_DisableHardwareTrigger() can not be used. | true: Adc_EnableHardwareTrigger() and Adc_DisableHardwareTrigger() can be used. false: Adc_EnableHardwareTrigger() and Adc_DisableHardwareTrigger() can not be used.
      boolean AdcCalibrationApi: origin=Cypress, set at pre-compile, default-value=true  # Adds / removes the services Adc_ChangeCalibrationChannel(), Adc_SetCalibrationValue(), Adc_GetCalibrationAlternateValue() and Adc_GetCalibrationValue() from the code. True : Adc_ChangeCalibrationChannel(), Adc_SetCalibrationValue(), Adc_GetCalibrationAlternateValue() and Adc_GetCalibrationValue() can be used. False: Adc_ChangeCalibrationChannel(), Adc_SetCalibrationValue(), Adc_GetCalibrationAlternateValue() and Adc_GetCalibrationValue() can not be used. | true: Adc_ChangeCalibrationChannel(), Adc_SetCalibrationValue(), Adc_GetCalibrationAlternateValue() and Adc_GetCalibrationValue() can be used. false: Adc_ChangeCalibrationChannel(), Adc_SetCalibrationValue(), Adc_GetCalibrationAlternateValue() and Adc_GetCalibrationValue() can not be used.
      boolean AdcLowPowerStatesSupport [0..1]: multiplicity set at pre-compile, set at pre-compile, default-value=false  # Adds / removes all power state management related APIs (Adc_SetPowerState, Adc_GetCurrentPowerState, Adc_GetTargetPowerState, Adc_PreparePowerState, Adc_Main_PowerTransitionManager), indicating if the HW offers low power state management.
      boolean AdcPowerStateAsynchTransitionMode [0..1]: multiplicity set at pre-compile, set at pre-compile, default-value=false  # Enables / disables support of the ADCDriver to the asynchronous power state transition. Note: As there is no preparation period in the hardware feature, only synchronous power state transition mode is supported. Therefore, this parameter is not used by the ADC Driver and not being evaluated.
      enumeration AdcPriorityImplementation: {ADC_PRIORITY_HW, ADC_PRIORITY_HW_SW, ADC_PRIORITY_NONE}, set at pre-compile, default-value=ADC_PRIORITY_HW  # Determines whether a priority mechanism is available for prioritization of the conversion requests and if available, the type of prioritization mechanism. The selection applies for groups with trigger source software and trigger source hardware. Two types of prioritization mechanism can be selected. The hardware prioritization mechanism (AdcPriorityHw) uses the ADC hardware features for prioritization of the software conversion requests and hardware trigger signals for groups with trigger source hardware. The mixed hardware and software prioritization mechanism (AdcPriorityHwSw) uses the ADC hardware features for prioritization of ADC hardware trigger for groups with trigger source hardware and a software implemented prioritization mechanism for groups with trigger source software. The group priorities for software triggered groups are typically configured with lower priority levels than the group priorities for hardware triggered groups. NOTE: ADC Driver supports only HW priority. ImplementationType: Adc_PriorityImplementationType | types of prioritization mechanism can be selected. The hardware prioritization mechanism (AdcPriorityHw) uses the ADC hardware features for prioritization of the software conversion requests and hardware trigger signals for groups with trigger source hardware. The mixed hardware and software prioritization mechanism (AdcPriorityHwSw) uses the ADC hardware features for prioritization of ADC hardware trigger for groups with trigger source hardware and a software implemented prioritization mechanism for groups with trigger source software. The group priorities for software triggered groups are typically configured with lower priority levels than the group priorities for hardware triggered groups. ImplementationType: Adc_PriorityImplementationType
      boolean AdcReadGroupApi: set at pre-compile, default-value=true  # Adds / removes the service Adc_ReadGroup() from the code. True: Adc_ReadGroup() can be used. False: Adc_ReadGroup() can not be used. | true: Adc_ReadGroup() can be used. false: Adc_ReadGroup() can not be used.
      enumeration AdcResultAlignment: {ADC_ALIGN_LEFT, ADC_ALIGN_RIGHT}, set at pre-compile, default-value=ADC_ALIGN_RIGHT  # Alignment of ADC raw results in ADC result buffer (left/right alignment). Implementation Type: Adc_ResultAlignmentType. | Implementation Type: Adc_ResultAlignmentType
      boolean AdcVersionInfoApi: set at pre-compile, default-value=true  # Adds / removes the service Adc_GetVersionInfo() from the code. True: Adc_GetVersionInfo() can be used False: Adc_GetVersionInfo() can not be used. | true: Adc_GetVersionInfo() can be used. false: Adc_GetVersionInfor() can not be used.
      function name AdcErrorCalloutFunction: origin=Cypress, set at pre-compile, default-value=ErrorCalloutHandler  # This function is called every time an error is detected.
      string AdcIncludeFile [0..*]: multiplicity set at pre-compile, origin=Cypress, set at pre-compile, default-value=ErrorCalloutHandler.h  # Specifies include files (e.g. for declaration of the error callout function).
      container AdcPowerStateConfig [0..*]: multiplicity set at pre-compile  # Each instance of this parameter defines a power state and the callback to be called when this power state is reached.
        integer AdcPowerState: 0..1, set at pre-compile, symbolic-name-value=true, default-value=0  # Each instance of this parameter describes a different power state supported by the ADC HW. It should be defined by the HW supplier and used by the ADCDriver to reference specific HW configurations which set the ADC HW module in the referenced power state. 0:ADC_FULL_POWER 1:ADC_OFF_POWER At least the power mode corresponding to full power state shall be always configured. | At least the power mode corresponding to full power state shall be always configured.
        function name AdcPowerStateReadyCbkRef: set at pre-compile, default-value=NULL_PTR  # Each instance of this parameter contains a reference to a power mode callback defined in a CDD or IoHwAbs component. Note: As there is no preparation period in the hardware feature, only synchronous power state transition mode is supported. Therefore, this parameter is not used by the ADC Driver and not being evaluated.
    container AdcPublishedInformation  # Additional published parameters not covered by "Common" Published Information. Note that these parameters have "PUBLISHED-INFORMATION" configuration class setting, since they are published information.
      boolean AdcChannelValueSigned: set at published-information, default-value=true  # Information whether the result value of the ADC driver has sign information (true) or not (false). If the result shall be interpreted as signed value it shall apply to C-language rules. Note: This parameter is fixed to true.
      boolean AdcGroupFirstChannelFixed: set at published-information, default-value=false  # Information whether the first channel of an ADC Channel group can be configured (false) or is fixed (true) to a value determined by the ADC HW Unit. Note: This parameter is fixed to false.
      integer AdcMaxChannelResolution: 12..12, set at published-information, default-value=12  # Maximum Channel resolution in bits (does not specify accuracy). Note: This parameter is fixed to 12.

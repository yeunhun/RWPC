AUTOSAR XML (schema 4-2-2)
package /TS_T40D13M1I0R0
  ecuc definition collection DIO_EcuParameterDefinition: module=Dio
  module definition Dio [0..1]: post-build-variant-support=true, refined-module-def=Dio, variants pre-compile  # Configuration of the Dio (Digital IO) module.
    container DioConfig  # This container contains the configuration parameters and sub containers of the AUTOSAR DIO module. This container is a MultipleConfigurationContainer, i.e. this container and its sub-containers exist once per configuration set.
      container DioPort [1..*]: multiplicity set at pre-compile  # Configuration of individual DIO ports, consisting of channels and possible channel groups. | Note that this container definition does not explicitly define a symbolic name parameter. Instead, the container's short name will be used in the Ecu Configuration Description to specify the symbolic name of the port.
        integer DioPortId: 0..127, scope=ECU, set at pre-compile, symbolic-name-value=true, default-value=0  # Numeric identifier of the DIO port. Not all MCU ports may be used for DIO, thus there may be "gaps" in the list of all IDs. This value will be | assigned to the DIO port symbolic name (i.e. the SHORT-NAME of the DioPort container).
        container DioChannel [0..*]: multiplicity set at pre-compile  # Configuration of an individual DIO channel. Besides a HW specific channel name which is typically fixed for a specific micro controller, additional symbolic names can be defined per channel. Note that this container definition does not explicitly define a symbolic name parameter. Instead, the container's short name will be used in the Ecu Configuration Description to specify the symbolic name of the channel.
          integer DioChannelId: 0..4294967295, scope=ECU, set at pre-compile, symbolic-name-value=true, default-value=0  # Channel Id of the DIO channel. This value will be assigned to the symbolic names.
          enumeration DioChannelPin: {P000_0, P000_1, P000_2, P000_3, P000_4, P000_5, P000_6, P000_7, P001_0, P001_1, P001_2, P001_3, P001_4, P001_5, P001_6, P001_7, P002_0, P002_1, P002_2, P002_3, P002_4, P002_5, P002_6, P002_7, P003_0, P003_1, P003_2, P003_3, P003_4, P003_5, P003_6, P003_7, P004_0, P004_1, P004_2, P004_3, P004_4, P004_5, P004_6, P004_7, P005_0, P005_1, P005_2, P005_3, P005_4, P005_5, P005_6, P005_7, P006_0, P006_1, P006_2, P006_3, P006_4, P006_5, P006_6, P006_7, P007_0, P007_1, P007_2, P007_3, P007_4, P007_5, P007_6, P007_7, P008_0, P008_1, P008_2, P008_3, P008_4, P008_5, P008_6, P008_7, P009_0, P009_1, P009_2, P009_3, P009_4, P009_5, P009_6, P009_7, P010_0, P010_1, P010_2, P010_3, P010_4, P010_5, P010_6, P010_7, P011_0, P011_1, P011_2, P011_3, P011_4, P011_5, P011_6, P011_7, P012_0, P012_1, P012_2, P012_3, P012_4, P012_5, P012_6, P012_7, P013_0, P013_1, P013_2, P013_3, P013_4, P013_5, P013_6, P013_7, P014_0, P014_1, P014_2, P014_3, P014_4, P014_5, P014_6, P014_7, P015_0, P015_1, P015_2, P015_3, P015_4, P015_5, P015_6, P015_7, P016_0, P016_1, P016_2, P016_3, P016_4, P016_5, P016_6, P016_7, P017_0, P017_1, P017_2, P017_3, P017_4, P017_5, P017_6, P017_7, P018_0, P018_1, P018_2, P018_3, P018_4, P018_5, P018_6, P018_7, P019_0, P019_1, P019_2, P019_3, P019_4, P019_5, P019_6, P019_7, P020_0, P020_1, P020_2, P020_3, P020_4, P020_5, P020_6, P020_7, P021_0, P021_1, P021_2, P021_3, P021_4, P021_5, P021_6, P021_7, P022_0, P022_1, P022_2, P022_3, P022_4, P022_5, P022_6, P022_7, P023_0, P023_1, P023_2, P023_3, P023_4, P023_5, P023_6, P023_7, P024_0, P024_1, P024_2, P024_3, P024_4, P025_0, P025_1, P025_2, P025_3, P025_4, P025_5, P025_6, P025_7, P026_0, P026_1, P026_2, P026_3, P026_4, P026_5, P026_6, P026_7, P027_0, P027_1, P027_2, P027_3, P027_4, P027_5, P027_6, P027_7, P028_0, P028_1, P028_2, P028_3, P028_4, P028_5, P028_6, P028_7, P029_0, P029_1, P029_2, P029_3, P029_4, P029_5, P029_6, P029_7, P030_0, P030_1, P030_2, P030_3, P031_0, P031_1, P031_2, P032_0, P032_1, P032_2, P032_3, P032_4, P032_5, P032_6, P032_7, P033_0, P033_1, P033_2, P033_3, P033_4, P033_5, P033_6, P033_7, P034_0, P034_1, P034_2, P034_3, P034_4, P034_5, P034_6, P034_7}, origin=Cypress, set at pre-compile, default-value=P000_0  # HW-Pin Id of the hardware port pin. This value is not assigned to the symbolic name. ATTENTION! The PortPinId can not be used for an API call. Please use the symbolic name for API calls only.
        container DioChannelGroup [0..*]: multiplicity set at pre-compile  # Definition and configuration of DIO channel groups. A channel group represents several adjoining DIO channels represented by a logical group. | Note that this container definition does not explicitly define a symbolic name parameter. Instead, the container's short name will be used in the Ecu Configuration Description to specify the symbolic name of the channel group.
          string DioChannelGroupIdentification: scope=ECU, set at pre-compile, symbolic-name-value=true, default-value=&Dio_ChannelGroupCfg[0]  # The DIO channel group is identified in DIO API by a pointer to a data structure (of type Dio_ChannelGroupType). That data structure contains the channel group information. | This parameter contains the code fragment that has to be inserted in the API call of the calling module to get the address of the variable in memory which holds the channel group information. Default value is "&Dio_ChannelGroupCfg[0]".
          integer DioPortMask: 1..255, set at pre-compile, default-value=1  # This shall be the mask which defines the positions of the channel | group. The channels shall consist of adjoining bits in the same port. The data type depends on the port width.
          integer DioPortOffset: 0..7, set at pre-compile, default-value=0  # The position of the Channel Group on the port, counted | from the LSB. This value can be derived from DioPortMask. calculationFormula = Position of the first bit of DioPortMask which is set to '1' counted from LSB. This value will be calculated at generation time.
    container DioGeneral  # General DIO module configuration parameters.
      boolean DioDevErrorDetect: set at pre-compile, default-value=true  # Switches the Default Error Tracer (Det) detection and notification ON or OFF. | * true: enabled (ON). * false: disabled (OFF).
      boolean DioFlipChannelApi: set at pre-compile, default-value=true  # Adds / removes the service Dio_FlipChannel() from the code.
      boolean DioVersionInfoApi: set at pre-compile, default-value=true  # Adds / removes the service Dio_GetVersionInfo() from the code.
      boolean DioMaskedWritePortApi: origin=Cypress, set at pre-compile, default-value=true  # Adds / removes the service Dio_MaskedWritePort() from the code.
      function name DioErrorCalloutFunction: origin=Cypress, set at pre-compile, default-value=ErrorCalloutHandler  # A symbol name for a call-out function. Dio module calls the function whenever any error occurs. [Checking if the configuration is correct] 1) DioErrorCalloutFunction is an appropriate C language function name; if it is not satisfied, the following message shall be reported: Invalid name of the DioErrorCalloutFunction. Must be valid C function name.
      string DioIncludeFile [0..*]: multiplicity set at pre-compile, origin=Cypress, set at pre-compile, default-value=ErrorCalloutHandler.h  # The header file to which Dio module refers. The file is used to define the functional declaration about call-out by users. [Checking if the configuration is correct] 1) DioIncludeFile is an appropriate header file name; if it is not satisfied, the following message shall be reported: Invalid name of the DioIncludeFile. Must be a filename with extension .h. 2) All of DioIncludeFile have a different file name each other; if it is not satisfied, the following message shall be reported: DioIncludeFile must be unique.

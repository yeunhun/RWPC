AUTOSAR XML (schema 4-2-2)
package /TS_T40D13M1I0R0
  ecuc definition collection CAN_EcuParameterDefinition: module=Can
  module definition Can [1..*]: post-build-variant-support=true, refined-module-def=Can, variants post-build  # This container holds the configuration of a single CAN Driver.
    container CanConfigSet: multiplicity set at pre-compile  # This container contains the configuration parameters and sub containers of the AUTOSAR Can module.
      container CanController [1..*]: multiplicity set at pre-compile  # This container contains the configuration parameters of the CAN controller(s).
        enumeration CanBusoffProcessing: {INTERRUPT, POLLING}, set at pre-compile, default-value=INTERRUPT  # Enables / disables API Can_MainFunction_BusOff() for handling busoff events in polling mode.
        boolean CanControllerActivation: set at pre-compile, default-value=true  # Defines if a CAN controller is used in the configuration.
        integer CanControllerBaseAddress: 0..4294967295, set at pre-compile, default-value=0  # Specifies the CAN controller base address.
        integer CanControllerId: 0..255, scope=ECU, set at pre-compile, symbolic-name-value=true, default-value=0  # This parameter provides the controller ID which is unique in a given CAN Driver. The value for this parameter starts with 0 and continue without any gaps. In case of CanControllerActivation is set to false, this ID is not known and may result in a gap. Controller IDs of deactivated controllers must be greater than the controller IDs of the activated controllers.
        enumeration CanRxProcessing: {INTERRUPT, POLLING}, set at pre-compile, default-value=INTERRUPT  # Enables / disables API Can_MainFunction_Read() for handling PDU reception events in polling mode.
        enumeration CanTxProcessing: {INTERRUPT, POLLING}, set at pre-compile, default-value=INTERRUPT  # Enables / disables API Can_MainFunction_Write() for handling PDU transmission events in polling mode.
        boolean CanWakeupFunctionalityAPI: set at pre-compile, default-value=true  # Switches the Can_CheckWakeup() API ON or OFF. If ALL configured controllers have disabled this parameter, Can_CheckWakeup() API is really switched off.
        enumeration CanWakeupProcessing: {INTERRUPT, POLLING}, set at pre-compile, default-value=INTERRUPT  # Enables / disables API Can_MainFunction_Wakeup() for handling wakeup events in polling mode.
        boolean CanWakeupSupport: set at pre-compile, default-value=true  # CAN driver support for wakeup over CAN Bus.
        enumeration CanControllerInstance: {INSTANCE0, INSTANCE1}, origin=Cypress, set at pre-compile, default-value=INSTANCE0  # Selects the CAN controller instance on the target.
        enumeration CanControllerPhysicalChannel: {CANFD00, CANFD01, CANFD02, CANFD03, CANFD04, CANFD10, CANFD11, CANFD12, CANFD13, CANFD14}, origin=Cypress, set at pre-compile, default-value=CANFD00  # Selects the physical CAN controller on the target.
        integer CanMessageRamBaseAddress: 0..4294967295, origin=Cypress, set at pre-compile, default-value=0  # Base address (for CPU access) of the message RAM that is used by the CAN controller. The physical base address has to be used, independently of whether the full RAM is used by the controller or not.
        integer CanMessageRamSize: 0..4294967295, origin=Cypress, set at pre-compile, default-value=0  # The size in bytes of the message RAM that is reserved for this CAN controller beginning from CanMessageRamBaseAddress.
        reference CanControllerDefaultBaudrate: post-build-variant-value=true, set at post-build, destination=CanControllerBaudrateConfig  # Reference to baudrate configuration container configured for the Can Controller.
        reference CanCpuClockRef: set at pre-compile, destination=McuClockReferencePoint  # Reference to the CPU clock configuration, which is set in the MCU driver configuration
        symbolic name reference CanWakeupSourceRef [0..1]: multiplicity set at pre-compile, set at pre-compile, destination=EcuMWakeupSource  # This parameter contains a reference to the Wakeup Source for this controller as defined in the ECU State Manager.
        container CanControllerBaudrateConfig [1..255]: multiplicity set at pre-compile  # This container contains bit timing related configuration parameters of the CAN controller(s).
          integer CanControllerBaudRate: 1..2000, post-build-variant-value=true, set at post-build, default-value=100  # Specifies the baudrate of the controller in kbps.
          integer CanControllerBaudRateConfigID: 0..65535, scope=ECU, post-build-variant-value=true, set at post-build, default-value=0  # Uniquely identifies a specific baud rate configuration. This ID is used by SetBaudrate API.
          integer CanControllerPropSeg: 0..0, post-build-variant-value=true, set at post-build, default-value=0  # Specifies propagation delay in time quantas. The M_CAN hardware does not support a propagation time. Instead the time segment 1 has to be increased accordingly.
          integer CanControllerSeg1: 2..255, post-build-variant-value=true, set at post-build, default-value=8  # Specifies phase segment 1 in time quantas.
          integer CanControllerSeg2: 2..128, post-build-variant-value=true, set at post-build, default-value=4  # Specifies phase segment 2 in time quantas.
          integer CanControllerSyncJumpWidth: 1..128, post-build-variant-value=true, set at post-build, default-value=1  # Specifies the synchronization jump width for the controller in time quantas.
          container CanControllerFdBaudrateConfig [0..1]: multiplicity set at pre-compile  # This container contains flexible data rate bit timing related configuration parameters of the CAN controller(s).
            integer CanControllerFdBaudRate: 1..16000, post-build-variant-value=true, set at post-build, default-value=100  # Specifies the data segment baud rate of the controller in kbps.
            integer CanControllerPropSeg: 0..0, post-build-variant-value=true, set at post-build, default-value=0  # Specifies propagation delay in time quantas. of the data section. The M_CAN hardware does not support a propagation time. Instead the time segment 1 has to be increased accordingly.
            integer CanControllerSeg1: 1..32, post-build-variant-value=true, set at post-build, default-value=8  # Specifies phase segment 1 in time quantas. of the data section.
            integer CanControllerSeg2: 1..16, post-build-variant-value=true, set at post-build, default-value=4  # Specifies phase segment 2 in time quantas. of the data section.
            integer CanControllerSyncJumpWidth: 1..16, post-build-variant-value=true, set at post-build, default-value=1  # Specifies the synchronization jump width for the controller in time quantas. of the data section.
            integer CanControllerTrcvDelayCompensationOffset [0..1]: 0..400, multiplicity set at post-build, post-build-variant-multiplicity=true, post-build-variant-value=true, set at post-build, default-value=0  # Specifies the Transceiver Delay Compensation Offset in ns. If not specified Transceiver Delay Compensation is disabled. The delay time is rounded to a divided by frequency referred by CanCpuClockRef.
            boolean CanControllerTxBitRateSwitch: post-build-variant-value=true, set at post-build, default-value=true  # Specifies if the bit rate switching shall be used for transmissions. If FALSE: CAN FD frames shall be sent without bit rate switching.
        container CanTTController [0..1]: multiplicity set at pre-compile  # This container is only included and valid if TTCAN SWS is used and TTCAN is enabled.
          integer CanTTControllerApplWatchdogLimit: 0..255, scope=ECU, post-build-variant-value=true, set at post-build, default-value=127  # Defines the maximum time period (unit is 256 times NTU) after which the application has to serve the watchdog.
          integer CanTTControllerCycleCountMax: 0..63, scope=ECU, post-build-variant-value=true, set at post-build, default-value=31  # Defines the value for cycle_count_max.
          integer CanTTControllerExpectedTxTrigger: 0..255, post-build-variant-value=true, set at post-build, default-value=127  # Number of expected_tx_trigger.
          boolean CanTTControllerExternalClockSynchronisation: scope=ECU, post-build-variant-value=true, set at post-build, default-value=false  # Enables/disables the external clock synchronization.
          boolean CanTTControllerGlobalTimeFiltering: post-build-variant-value=true, set at post-build, default-value=false  # Enables/disables the global time filtering.
          integer CanTTControllerInitialRefOffset: 0..127, scope=ECU, post-build-variant-value=true, set at post-build, default-value=63  # Defines the initial value for ref trigger offset.
          integer CanTTControllerInterruptEnable: 0..1023, post-build-variant-value=true, set at post-build, default-value=511  # Enables/disables the respective interrupts.
          boolean CanTTControllerLevel2: post-build-variant-value=true, set at post-build, default-value=false  # Defines whether Level 2 or Level 1 is used.
          float CanTTControllerNTUConfig: 0.0..100.0, scope=ECU, post-build-variant-value=true, set at post-build, default-value=50  # Defines the config value for NTU (network time unit).
          enumeration CanTTControllerOperationMode: {CAN_TT_EVENT_SYNC_TIME_TRIGGERED, CAN_TT_EVENT_TRIGGERED, CAN_TT_TIME_TRIGGERED}, scope=ECU, post-build-variant-value=true, set at post-build, default-value=CAN_TT_EVENT_SYNC_TIME_TRIGGERED  # Defines the operation mode.
          float CanTTControllerSyncDeviation: 0.0..100.0, post-build-variant-value=true, set at post-build, default-value=50  # Defines the maximum synchronization deviation:
          boolean CanTTControllerTURRestore: post-build-variant-value=true, set at post-build, default-value=false  # Enables/disables the TUR restore.
          boolean CanTTControllerTimeMaster: scope=ECU, post-build-variant-value=true, set at post-build, default-value=false  # Defines whether the controller acts as a potential time master.
          integer CanTTControllerTimeMasterPriority: 0..7, scope=ECU, post-build-variant-value=true, set at post-build, default-value=3  # Defines the time master priority.
          integer CanTTControllerTxEnableWindowLength: 1..16, scope=ECU, post-build-variant-value=true, set at post-build, default-value=7  # Length of the tx enable window given in CAN bit times.
          integer CanTTControllerWatchTriggerGapTimeMark: 0..65535, post-build-variant-value=true, set at post-build, default-value=32767  # watch trigger time mark after a gap
          integer CanTTControllerWatchTriggerTimeMark: 0..65535, post-build-variant-value=true, set at post-build, default-value=32767  # watch trigger time mark
          enumeration CanTTIRQProcessing: {INTERRUPT, POLLING}, scope=ECU, post-build-variant-value=true, set at post-build, default-value=INTERRUPT  # Enables / disables API Can_MainFunction_BusOff() for handling busoff events in polling mode.
      container CanHardwareObject [1..*]: multiplicity set at pre-compile  # This container contains the configuration (parameters) of CAN Hardware Objects.
        integer CanFdPaddingValue [0..1]: 0..255, scope=ECU, multiplicity set at post-build, post-build-variant-multiplicity=true, post-build-variant-value=true, set at post-build, default-value=255  # Specifies the value which is used to pad unspecified data in CAN FD frames > 8 bytes for transmission. This is necessary due to the discrete possible values of the DLC if > 8 bytes. If the length of a PDU which was requested to be sent does not match the allowed DLC values, the remaining bytes up to the next possible value shall be padded with this value.
        enumeration CanHandleType: {BASIC, FULL}, scope=ECU, post-build-variant-value=true, set at post-build, default-value=BASIC  # Specifies the type (Full-CAN or Basic-CAN) of a hardware object.
        integer CanHwObjectCount: 1..64, scope=ECU, post-build-variant-value=true, set at post-build, default-value=1  # Number of hardware objects (FIFO items) used to implement one HOH. In case of a HRH this parameter defines the number of elements in the hardware FIFO, in case of a HTH it defines the number of hardware objects used for a hardware FIFO used by a Full CAN HTH. (This item is taken from ASR 4.1.2.)
        enumeration CanIdType: {EXTENDED, MIXED, STANDARD}, scope=ECU, post-build-variant-value=true, set at post-build, default-value=MIXED  # Specifies whether the IdValue is of type
        integer CanObjectId: 0..65535, scope=ECU, set at pre-compile, symbolic-name-value=true, default-value=0  # Holds the handle ID of HRH or HTH. The value of this parameter is unique in a given CAN Driver, and it should start with 0 and continue without any gaps. Furthermore the CanObjectIds of HRHs must be smaller then those of HTHs.
        integer CanIdValue [0..1]: 0..536870911, multiplicity set at post-build, origin=Cypress, set at post-build, default-value=0  # Specifies (together with the filter mask) the identifiers range that passes the hardware filter.
        enumeration CanObjectType: {RECEIVE, TRANSMIT}, scope=ECU, post-build-variant-value=true, set at post-build, default-value=RECEIVE  # Specifies if the HardwareObject is used as Transmit or as Receive object
        enumeration CanRxBufferSelection [0..1]: {CAN_RX_DEDICATED, CAN_RX_FIFO0, CAN_RX_FIFO1}, multiplicity set at pre-compile, origin=Cypress, post-build-variant-multiplicity=true, set at pre-compile, default-value=CAN_RX_DEDICATED  # Selects the allocation of the CanHwObject to a physical RX buffer type. Selection of CanHwObjects to TX buffers is done via configuration parameter CanHwObjectCount.
        boolean CanTriggerTransmitEnable: scope=ECU, set at pre-compile, default-value=false  # This parameter defines if or if not Can supports the trigger-transmit API for this handle.
        boolean CanIcomRxMessageDedicated: origin=Cypress, set at pre-compile, default-value=false  # This parameter defines whether this handle is dedicated to CanIcomRxMessage.
        reference CanControllerRef: post-build-variant-value=true, set at post-build, destination=CanController  # Reference to CAN Controller to which the HOH is associated to.
        reference CanMainFunctionRWPeriodRef [0..1]: multiplicity set at post-build, post-build-variant-multiplicity=true, post-build-variant-value=true, set at post-build, destination=CanMainFunctionRWPeriods  # Reference to CAN Controller to which the HOH is associated to.
        container CanHwFilter [0..*]: multiplicity set at pre-compile, post-build-variant-multiplicity=true  # This container is only valid for HRHs and contains the configuration (parameters) of one hardware filter.
          integer CanHwFilterCode: 0..536870911, post-build-variant-value=true, set at post-build, default-value=0  # Specifies (together with the filter mask) the identifiers range that passes the hardware filter.
          integer CanHwFilterMask: 0..536870911, post-build-variant-value=true, set at post-build, default-value=0  # Describes a mask for hardware-based filtering of CAN identifiers. Bits holding a 0 mean don't care, i.e. do not compare the message's identifier in the respective bit position. The mask shall be built by filling with leading 0. In case of CanIdType EXTENDED or MIXED a 29 bit mask shall be built. In case of CanIdType STANDARD a 11 bit mask shall be built.
        container CanTTHardwareObjectTrigger [0..0]  # This container is only included and valid if TTCAN SWS is used and TTCAN is enabled.
          integer CanTTHardwareObjectBaseCycle: 0..63, scope=ECU, post-build-variant-value=true, set at post-build, default-value=31  # Defines the cycle_offset.
          integer CanTTHardwareObjectCycleRepetition: 1..64, scope=ECU, post-build-variant-value=true, set at post-build, default-value=31  # Defines the repeat_factor.
          integer CanTTHardwareObjectTimeMark: 0..65535, post-build-variant-value=true, set at post-build, default-value=31  # Defines the point in time, when the trigger will be activated.
          integer CanTTHardwareObjectTriggerId: 0..63, set at pre-compile, symbolic-name-value=true, default-value=31  # Sequential number which allows separation of different TTCAN triggers configured for one and the same hardware object.
          enumeration CanTTHardwareObjectTriggerType: {CAN_TT_RX_TRIGGER, CAN_TT_TX_REF_TRIGGER, CAN_TT_TX_REF_TRIGGER_GAP, CAN_TT_TX_TRIGGER_EXCLUSIVE, CAN_TT_TX_TRIGGER_MERGED, CAN_TT_TX_TRIGGER_SINGLE}, post-build-variant-value=true, set at post-build, default-value=CAN_TT_RX_TRIGGER  # Defines the type of the trigger associated with the hardware object. This parameter depends on plain CAN parameter CAN_OBJECT_TYPE.
      container CanIcom [0..1]: multiplicity set at pre-compile  # This container contains the parameters for configuring pretended networking
        container CanIcomConfig [1..*]: multiplicity set at pre-compile  # This container contains the configuration parameters of the ICOM Configuration.
          integer CanIcomConfigId: 1..255, scope=ECU, set at pre-compile, default-value=1  # This parameter identifies the ID of the ICOM configuration.
          boolean CanIcomWakeOnBusOff: scope=ECU, set at pre-compile, default-value=false  # This parameter defines that the MCU shall wake if the bus off is detected or not.
          container CanIcomWakeupCauses  # This container contains the configuration parameters of the wakeup causes to leave the power saving mode.
            container CanIcomRxMessage [1..*]: multiplicity set at pre-compile  # This container contains the configuration parameters for the wakeup causes for matching received messages. It has to be configured as often as received messages are defined as wakeup cause.
              integer CanIcomCounterValue [0..1]: 1..65535, scope=ECU, multiplicity set at pre-compile, set at pre-compile, default-value=1  # This parameter defines that the MCU shall wake if the message with the ID is received n times on the communication channel.
              integer CanIcomMessageId: 0..536870912, scope=ECU, set at pre-compile, default-value=0  # This parameter defines the message ID the wakeup causes of this CanIcomRxMessage are configured for. In addition a mask (CanIcomMessageIdMask) can be defined, in that case it is possible to define a range of rx messages, which can create a wakeup condition.
              integer CanIcomMessageIdMask [0..1]: 0..536870912, scope=ECU, multiplicity set at pre-compile, set at pre-compile, default-value=0  # Describes a mask for filtering of CAN identifiers. The CAN identifiers of incoming messages are masked with this CanIcomMessageIdMask. If the masked identifier matches the masked value of CanIcomMessageId, it can create a wakeup condition for this CanIcomRxMessage. Bits holding a 0 mean don't care, i.e. do not compare the message's identifier in the respective bit position. The mask shall be build by filling with leading 0.
              float CanIcomMissingMessageTimerValue [0..1]: 0.0..4.294967295E9, scope=ECU, multiplicity set at pre-compile, set at pre-compile, default-value=0  # This parameter defines that the MCU shall wake if the message with the ID is not received for a specific time in s on the
              boolean CanIcomPayloadLengthError: scope=ECU, set at pre-compile, default-value=false  # This parameter defines that the MCU shall wake if a payload error occurs
              reference CanHardwareObjectRef: origin=Cypress, set at pre-compile, destination=CanHardwareObject  # Reference to HOH to which the CanIcomRxMessage is associated to.
              container CanIcomRxMessageSignalConfig [0..*]: multiplicity set at pre-compile  # This container contains the configuration parameters for the wakeup causes for matching signals.
                integer CanIcomSignalMask: 0..4294967295, set at pre-compile, default-value=0  # This parameter shall be used to mask a signal in the payload of a CAN message.
                integer CanIcomSignalMaskH: 0..4294967295, origin=Cypress, set at pre-compile, default-value=0  # This parameter shall be used to mask a signal in the payload of a CAN message(Upper 32 bits).
                integer CanIcomSignalMaskL: 0..4294967295, origin=Cypress, set at pre-compile, default-value=0  # This parameter shall be used to mask a signal in the payload of a CAN message(Lower 32 bits).
                enumeration CanIcomSignalOperation: {AND, EQUAL, GREATER, SMALLER, XOR}, scope=ECU, set at pre-compile, default-value=AND  # This parameter defines the operation, which shall be used to verify the signal value creates a wakeup condition.
                integer CanIcomSignalValue: 0..4294967295, set at pre-compile, default-value=0  # This parameter shall be used to define a signal value which shall be compared (CanIcomSignalOperation) with the masked CanIcomSignalMask value of the received signal (CanIcomSignalRef).
                integer CanIcomSignalValueH: 0..4294967295, origin=Cypress, set at pre-compile, default-value=0  # This parameter shall be used to define a signal value which shall be compared (CanIcomSignalOperation) with the masked CanIcomSignalMask value of the received signal(Upper 32 bits) (CanIcomSignalRef).
                integer CanIcomSignalValueL: 0..4294967295, origin=Cypress, set at pre-compile, default-value=0  # This parameter shall be used to define a signal value which shall be compared (CanIcomSignalOperation) with the masked CanIcomSignalMask value of the received signal(Lower 32 bits) (CanIcomSignalRef).
                reference CanIcomSignalRef [0..1]: scope=ECU, multiplicity set at pre-compile, set at pre-compile, destination=ComSignal  # This parameter defines a reference to the signal which shall be checked additional to the message id (CanIcomMessageId).
    container CanGeneral  # This container contains the parameters related each CAN Driver Unit.
      boolean CanChangeBaudrateApi: origin=Cypress, set at pre-compile, default-value=true  # The support of the Can_ChangeBaudrate API is optional.
      boolean CanDevErrorDetection: set at pre-compile, default-value=true  # Switches the Default Error Tracer (Det) detection and notification ON or OFF.
      boolean CanHardwareCancellation: origin=Cypress, set at pre-compile, default-value=false  # Specifies if hardware cancellation shall be supported.ON or OFF
      boolean CanIdenticalIdCancellation: origin=Cypress, set at pre-compile, default-value=false  # Enables/disables cancellation of pending PDUs with identical ID.
      integer CanIndex: 0..0, set at pre-compile, default-value=0  # Specifies the InstanceId of this module instance. If only one instance is present it shall have the Id 0.
      function name CanLPduReceiveCalloutFunction [0..1]: multiplicity set at pre-compile, set at pre-compile, default-value=LPDU_CalloutName  # This parameter defines the existence and the name of a callout function that is called after a successful reception of the message
      float CanMainFunctionBusoffPeriod [0..1]: 0.001..65.535, multiplicity set at pre-compile, set at pre-compile, default-value=1.0  # This parameter describes the period for cyclic call to Can_MainFunction_Busoff. Unit is seconds.
      float CanMainFunctionModePeriod: 0.001..65.535, set at pre-compile, default-value=1.0  # This parameter describes the period for cyclic call to Can_MainFunction_Mode. Unit is seconds.
      float CanMainFunctionWakeupPeriod [0..1]: 0.001..65.535, multiplicity set at pre-compile, set at pre-compile, default-value=1.0  # This parameter describes the period for cyclic call to Can_MainFunction_Wakeup. Unit is seconds.
      boolean CanMultiplexedTransmission: scope=ECU, set at pre-compile, default-value=true  # Specifies if multiplexed transmission shall be supported.ON or OFF
      boolean CanPublicIcomSupport: scope=ECU, set at pre-compile, default-value=false  # Selects support of Pretended Network features in Can driver.
      enumeration CanRxIndicationCompatibility: {CAN_ASR_403_COMPATIBILITY, CAN_ASR_422_COMPATIBILITY}, origin=Cypress, set at pre-compile, default-value=CAN_ASR_422_COMPATIBILITY  # Switches the interface of CanIf_RxIndication according to ASR release.
      boolean CanSetBaudrateApi [0..1]: scope=ECU, multiplicity set at pre-compile, set at pre-compile, default-value=false  # The support of the Can_SetBaudrate API is optional.
      float CanTimeoutDuration: 1.0E-6..65.535, set at pre-compile, default-value=2  # Specifies the maximum time for blocking function until a timeout is detected. Unit is seconds.
      boolean CanVersionInfoApi: set at pre-compile, default-value=true  # Switches the Can_GetVersionInfo() API ON or OFF.
      function name CanErrorCalloutFunction: origin=Cypress, set at pre-compile, default-value=ErrorCalloutHandler  # Error callout function. Syntax void ErrorCalloutHandler (uint16 ModuleId, uint8 InstanceId, uint8 ApiId, uint8 ErrorId) The error callout function is called on every error. The ASIL level of this function limits the ASIL level of the CAN driver.
      string CanIncludeFile [0..*]: multiplicity set at pre-compile, origin=Cypress, set at pre-compile, default-value=ErrorCalloutHandler.h  # A file that shall be included by Can_ExternalInclude.h. Any application specific symbol that is used by the Can configuration (e.g. Error callout function) should be included by configuring this parameter.
      boolean CanGetStatusApi: origin=Cypress, set at pre-compile, default-value=true  # The support of the Can_GetStatus API is optional.
      boolean CanDeInitApi: origin=Cypress, set at pre-compile, default-value=false  # The support of the Can_DeInit API is optional.
      boolean CanSetBaudrateInChangedClockApi: origin=Cypress, set at pre-compile, default-value=false  # The support of the Can_SetBaudrateInChangedClock API is optional.
      reference CanOsCounterRef: set at pre-compile, destination=OsCounter  # This parameter contains a reference to the OsCounter, which is used by the CAN driver.
      reference CanSupportTTCANRef: scope=ECU, set at pre-compile, destination=CanIfPrivateCfg  # The parameter refers to CanIfSupportTTCAN parameter in the CAN Interface Module configuration. The TT Can is not supported by this CPU. CanSupportTTCANRef is not usable.
      container CanIcomGeneral [0..1]: multiplicity set at pre-compile  # This container contains the general configuration parameters of the ICOM Configuration.
        enumeration CanIcomLevel [0..1]: {CAN_ICOM_LEVEL_ONE, CAN_ICOM_LEVEL_TWO}, scope=ECU, multiplicity set at pre-compile, set at pre-compile, default-value=CAN_ICOM_LEVEL_ONE  # Defines the level of Pretended Networking.
        enumeration CanIcomVariant: {CAN_ICOM_VARIANT_HW, CAN_ICOM_VARIANT_NONE, CAN_ICOM_VARIANT_SW}, scope=ECU, set at pre-compile, default-value=CAN_ICOM_VARIANT_NONE  # Defines the variant, which is supported by this CanController
      container CanMainFunctionRWPeriods  # This container contains periods for read and write main functions.
        float CanMainFunctionPeriod: 0.001..65.535, multiplicity set at pre-compile, set at pre-compile, default-value=0.01  # Cyclic period of the write main function.
        float CanMainFunctionReadPeriod [0..1]: 0.001..65.535, multiplicity set at pre-compile, origin=Cypress, set at pre-compile, default-value=0.01  # Cyclic period of the read main function.
        float CanMainFunctionWritePeriod [0..1]: 0.001..65.535, multiplicity set at pre-compile, origin=Cypress, set at pre-compile, default-value=0.01  # Cyclic period of the write main function.
      container CanDemEventParameterRefs [0..1]: multiplicity set at pre-compile  # Container for the references to DemEventParameter elements which shall be invoked using the API Dem_ReportErrorStatus API in case the corresponding error occurs. The EventId is taken from the referenced DemEventParameter's DemEventId value. The standardized errors are provided in the container and can be extended by vendor specific error references.
        symbolic name reference CAN_E_HARDWARE_ERROR [0..1]: multiplicity set at pre-compile, origin=Cypress, set at pre-compile, destination=DemEventParameter  # Reference to configured DEM event to report "Hardware failure". If the reference is not configured the error shall not be reported.

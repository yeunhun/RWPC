AUTOSAR XML (schema 4-2-2)
package /TS_T40D13M1I0R0
  ecuc definition collection WDG_EcuParameterDefinition: module=Wdg
  module definition Wdg [0..*]: post-build-variant-support=true, refined-module-def=Wdg, variants post-build  # Configuration of the Wdg (Watchdog driver) module.
    container WdgDemEventParameterRefs [0..1]: multiplicity set at pre-compile  # Container for the references to DemEventParameter elements which shall be invoked using the API Dem_ReportErrorStatus in case the corresponding error occurs. The EventId is taken from the referenced DemEventParameter's DemEventId value. | The standardized errors are provided in the container and can be extended by vendor-specific error references.
      symbolic name reference WDG_E_DISABLE_REJECTED [0..1]: multiplicity set at pre-compile, set at pre-compile, destination=DemEventParameter  # Reference to the DemEventParameter which shall be issued when the error "Initialization or mode switch failed because it would disable the watchdog" has occurred.
      symbolic name reference WDG_E_MODE_FAILED [0..1]: multiplicity set at pre-compile, set at pre-compile, destination=DemEventParameter  # Reference to the DemEventParameter which shall be issued when the error "Setting a watchdog mode failed (during initialization or mode switch)" has occurred.
      symbolic name reference WDG_E_HW_TIMEOUT [0..1]: multiplicity set at pre-compile, origin=Cypress, set at pre-compile, destination=DemEventParameter  # Reference to the DemEventParameter which shall be issued when the error "Watchdog hardware status change wait timeout (during initialization, change trigger period or mode switch)" has occurred.
      symbolic name reference WDG_E_WDG_STOPPED [0..1]: multiplicity set at pre-compile, origin=Cypress, set at pre-compile, destination=DemEventParameter  # Reference to the DemEventParameter which shall be issued when the error "Wdg_SetTriggerCondition is called during OFF_MODE" has occurred.
    container WdgGeneral  # All general parameters of the watchdog driver are collected here.
      boolean WdgDevErrorDetect: set at pre-compile, default-value=true  # Switches the Default Error Tracer (Det) detection and notification ON or OFF. | * true: enabled (ON). * false: disabled (OFF).
      boolean WdgDisableAllowed: set at pre-compile, default-value=false  # Compile switch to allow / forbid disabling the watchdog driver during runtime. | True: Disabling the watchdog driver at runtime is allowed. False: Disabling the watchdog driver at runtime is not allowed.
      integer WdgIndex: 0..255, set at pre-compile, symbolic-name-value=true, default-value=0  # Represents the watchdog driver's ID so that it can be referenced by the watchdog interface.
      float WdgInitialTimeout: 0.0..65.535, set at pre-compile, default-value=2.0  # The initial timeout (sec) for the trigger condition to be initialized during Init function. It shall be not larger than WdgMaxTimeout.
      float WdgMaxTimeout: 0.0..65.535, set at pre-compile, default-value=10.0  # The maximum timeout (sec) to which the watchdog trigger condition can be initialized.
      enumeration WdgRunArea: {RAM, ROM}, set at pre-compile, default-value=ROM  # Represents the watchdog driver execution area is either from ROM(Flash) or RAM as required with the particular microcontroller.
      function name WdgTriggerLocation: set at pre-compile, default-value=Wdg_66_IA_ActivateTrigger  # Location (memory address) of the watchdog trigger routine.
      integer WdgTriggerAddress: 0..4294967295, origin=Cypress, set at pre-compile, default-value=0  # Location (memory address) of the watchdog trigger routine. (Actual address)
      boolean WdgVersionInfoApi: set at pre-compile, default-value=true  # Compile switch to enable / disable the version information API | * True: API enabled * False: API disabled
      boolean WdgDemEventModeFailed: origin=Cypress, set at pre-compile, default-value=true  # Compile switch to enable / disable the DEM ModeFailed Event Checks and Message: True: DEM Event Checks are performed and message is generated. False: DEM Event Checks are not performed and message not generated.
      boolean WdgDemEventDisableRejected: origin=Cypress, set at pre-compile, default-value=true  # Compile switch to enable / disable the DEM Rejected Event Checks and Message: True: DEM Event Checks are performed and message is generated. False: DEM Event Checks are not performed and message not generated.
      boolean WdgDemEventHwTimeout: origin=Cypress, set at pre-compile, default-value=true  # Compile switch to enable / disable the DEM HwTimeout Event Checks and Message: True: DEM Event Checks are performed and message is generated. False: DEM Event Checks are not performed and message not generated.
      boolean WdgDemEventWdgStopped: origin=Cypress, set at pre-compile, default-value=true  # Compile switch to enable / disable the DEM WdgStopped Event Checks and Message: True: DEM Event Checks are performed and message is generated. False: DEM Event Checks are not performed and message not generated.
      function name WdgErrorCalloutFunction: origin=Cypress, set at pre-compile, default-value=ErrorCalloutHandler  # Error callout function. Syntax: void ErrorCalloutHandler (uint16 ModuleId, uint8 InstanceId, uint8 ApiId, uint8 ErrorId) The error callout function is called on every error. The ASIL level of this function limits the ASIL level of the Wdg driver.
      string WdgIncludeFile [0..*]: multiplicity set at pre-compile, origin=Cypress, set at pre-compile, default-value=ErrorCalloutHandler.h  # A file that shall be included by Wdg_66_IA_IncludeFiles.h. Any application specific symbol that is used by the Wdg configuration (e.g. Error callout function) should be included by configuring this parameter.
    container WdgPublishedInformation  # Container holding all Wdg specific published information parameters
      enumeration WdgTriggerMode: {WDG_BOTH, WDG_TOGGLE, WDG_WINDOW}, set at published-information, default-value=WDG_BOTH  # Watchdog trigger mode (toggle/window/both)
    container WdgSettingsConfig  # Configuration items for the different watchdog settings, including those for external watchdog hardware. | Note: All postbuild parameters are handled via this container.
      enumeration WdgDefaultMode: {WDGIF_OFF_MODE, WDGIF_SLOW_MODE, WDGIF_FAST_MODE}, post-build-variant-value=true, set at post-build, default-value=WDGIF_FAST_MODE  # Default mode for watchdog driver initialization. | ImplementationType: WdgIf_ModeType
      container WdgTimerConfigList [1..2]: multiplicity set at post-build  # Configuration items for watchdog timer.
        integer WdgCPUSelect: 0..3, origin=Cypress, post-build-variant-value=true, set at post-build, default-value=0  # The number of CPU core where the WDG driver is assigned to.
        enumeration WdgTimerSelection: {WDG_TIMER_MCWDT0, WDG_TIMER_MCWDT1, WDG_TIMER_MCWDT2, WDG_TIMER_MCWDT3, WDG_TIMER_WDT}, origin=Cypress, post-build-variant-value=true, set at post-build, default-value=WDG_TIMER_MCWDT0  # Selects the watchdog timer .
        boolean WdgStopWDT [0..1]: multiplicity set at post-build, origin=Cypress, post-build-variant-value=true, set at post-build, default-value=false  # Stops WDT if it is never used in the system.
        boolean WdgEnableWarningIrq: origin=Cypress, post-build-variant-value=true, set at post-build, default-value=false  # Use a warning interrupt to notify the application before watchdog reset happens. NOTE: If this interrupt is enabled, an interruption is triggered when the watchdog counter is reached to warn limit value.
        function name WdgWarningNotification [0..1]: multiplicity set at post-build, origin=Cypress, post-build-variant-multiplicity=true, post-build-variant-value=true, set at post-build, default-value=Wdg_66_IA_WarningNotification  # Notification function called from the warning interrupt.
        enumeration WdgDebugModeConfig: {WDG_DEBUGMODE_FREEZE, WDG_DEBUGMODE_RUN}, origin=Cypress, post-build-variant-value=true, set at post-build, default-value=WDG_DEBUGMODE_RUN  # Compile switch to freeze / run during the debugging mode: WDG_DEBUGMODE_FREEZE: The watchdog is configured to freeze during debugging mode. WDG_DEBUGMODE_RUN: The watchdog is configured to run during debugging mode.
        enumeration WdgDeepsleepConfig [0..1]: {WDG_DEEPSLEEP_FREEZE, WDG_DEEPSLEEP_RUN}, multiplicity set at post-build, origin=Cypress, post-build-variant-value=true, set at post-build, default-value=WDG_DEEPSLEEP_RUN  # Compile switch to freeze / run the wdg mode services in DEEPSLEEP mode: WDG_DEEPSLEEP_FREEZE: The watchdog is configured to freeze during DEEPSLEEP mode. WDG_DEEPSLEEP_RUN: The watchdog is configured to run during DEEPSLEEP mode.
        enumeration WdgHibernateConfig [0..1]: {WDG_HIBERNATE_FREEZE, WDG_HIBERNATE_RUN}, multiplicity set at post-build, origin=Cypress, post-build-variant-value=true, set at post-build, default-value=WDG_HIBERNATE_RUN  # Compile switch to freeze / run the wdg mode services in HIBERNATE mode: WDG_HIBERNATE_FREEZE: The watchdog is configured to freeze during HIBERNATE mode. WDG_HIBERNATE_RUN: The watchdog is configured to run during HIBERNATE mode.
        enumeration WdgLowerActionConfig: {WDG_ACTION_RESET, WDG_ACTION_FAULT, WDG_ACTION_FAULT_RESET}, origin=Cypress, post-build-variant-value=true, set at post-build, default-value=WDG_ACTION_FAULT_RESET  # The following action taken if this watchdog is serviced before LOWER_LIMIT is reached: WDG_ACTION_RESET: The lower action is configured to cause a reset when watchdog timer is configured as WDT. WDG_ACTION_FAULT: The lower action is configured to generate a fault when watchdog timer is configured as MCWDT. WDG_ACTION_FAULT_RESET: The lower action is configured to generate a fault and then cause a reset when watchdog timer is configured as MCWDT.
        enumeration WdgUpperActionConfig: {WDG_ACTION_RESET, WDG_ACTION_FAULT, WDG_ACTION_FAULT_RESET}, origin=Cypress, post-build-variant-value=true, set at post-build, default-value=WDG_ACTION_FAULT_RESET  # The following action taken if this watchdog is not serviced before UPPER_LIMIT is reached: WDG_ACTION_RESET: The upper action is configured to cause a reset when watchdog timer is configured as WDT. WDG_ACTION_FAULT: The upper action is configured to generate a fault when watchdog timer is configured as MCWDT. WDG_ACTION_FAULT_RESET: The upper action is configured to generate a fault and then cause a reset when watchdog timer is configured as MCWDT.
        reference WdgTimerClockRef: origin=Cypress, post-build-variant-value=true, set at post-build, destination=McuClockReferencePoint  # Reference to the source clock of the specified watchdog timer.
      container WdgExternalConfiguration [0..1]: multiplicity set at pre-compile  # Configuration items for an external watchdog hardware
        choice reference WdgExternalContainerRef [0..1]: multiplicity set at post-build, post-build-variant-multiplicity=true, post-build-variant-value=true, set at post-build, destination=[SpiSequence, DioChannelGroup]  # Reference to either | - a DioChannelGroup container in case the hardware watchdog is connected via DIO pins - an SpiSequenceConfiguration container in case the watchdog hardware is accessed via SPI
      container WdgSettingsFast  # Hardware dependent settings for the watchdog driver's "fast" mode.
        container WdgSettingsFastList  # Hardware dependent settings list for the watchdog driver's "fast" mode.
          integer WdgFastTimeoutValue: 1..65535, origin=Cypress, post-build-variant-value=true, set at post-build, default-value=5  # Trigger timeout value in "fast" mode (msec).
          integer WdgFastWarnLimitPercent: 1..99, origin=Cypress, post-build-variant-value=true, set at post-build, default-value=80  # Percentage of warn limit compared to trigger timeout value in "fast" mode.
          integer WdgFastLowerLimitPercent: 0..98, origin=Cypress, post-build-variant-value=true, set at post-build, default-value=10  # Percentage of lower limit compared to trigger timeout value in "fast" mode.
          integer WdgFastMaxWaitTime: 1..65535, origin=Cypress, post-build-variant-value=true, set at post-build, default-value=250  # The value to wait watchdog hardware status change in "fast" mode (usec).
          reference WdgFastTimerConfigRef: origin=Cypress, post-build-variant-value=true, set at post-build, destination=WdgTimerConfigList  # Reference to the timer hardware that is being configured by the other values in this container.
          reference WdgFastMcuClockRef: origin=Cypress, post-build-variant-value=true, set at post-build, destination=McuClockReferencePoint  # Reference to the CPU clock configuration, which is used to calculate loop count of 1usec.
      container WdgSettingsSlow  # Hardware dependent settings for the watchdog driver's "slow" mode.
        container WdgSettingsSlowList  # Hardware dependent settings list for the watchdog driver's "slow" mode.
          integer WdgSlowTimeoutValue: 1..65535, origin=Cypress, post-build-variant-value=true, set at post-build, default-value=20  # Trigger timeout value in "slow" mode (msec).
          integer WdgSlowWarnLimitPercent: 1..99, origin=Cypress, post-build-variant-value=true, set at post-build, default-value=80  # Percentage of warn limit compared to trigger timeout value in "slow" mode.
          integer WdgSlowLowerLimitPercent: 0..98, origin=Cypress, post-build-variant-value=true, set at post-build, default-value=10  # Percentage of lower limit compared to trigger timeout value in "slow" mode.
          integer WdgSlowMaxWaitTime: 1..65535, origin=Cypress, post-build-variant-value=true, set at post-build, default-value=250  # The value to wait watchdog hardware status change in "slow" mode (usec).
          reference WdgSlowTimerConfigRef: origin=Cypress, post-build-variant-value=true, set at post-build, destination=WdgTimerConfigList  # Reference to the timer hardware that is being configured by the other values in this container.
          reference WdgSlowMcuClockRef: origin=Cypress, post-build-variant-value=true, set at post-build, destination=McuClockReferencePoint  # Reference to the CPU clock configuration, which is used to calculate loop count of 1usec.
      container WdgSettingsOff  # Hardware dependent settings for the watchdog driver's "off" mode.
        container WdgSettingsOffList  # Hardware dependent settings list for the watchdog driver's "off" mode.
          integer WdgOffTimeoutValue [0..0]: 1..65535, origin=Cypress, set at pre-compile, default-value=5  # Trigger timeout value in "off" mode (msec). This property is not used.
          integer WdgOffWarnLimitPercent [0..0]: 1..99, origin=Cypress, set at pre-compile, default-value=80  # Percentage of warn limit compared to trigger timeout value in "off" mode. This property is not used.
          integer WdgOffLowerLimitPercent [0..0]: 0..98, origin=Cypress, set at pre-compile, default-value=10  # Percentage of lower limit compared to trigger timeout value in "off" mode. This property is not used.
          integer WdgOffMaxWaitTime: 1..65535, origin=Cypress, post-build-variant-value=true, set at post-build, default-value=250  # The value to wait watchdog hardware status change in "off" mode (usec).
          reference WdgOffTimerConfigRef: origin=Cypress, post-build-variant-value=true, set at post-build, destination=WdgTimerConfigList  # Reference to the timer hardware that is being configured by the other values in this container.
          reference WdgOffMcuClockRef: origin=Cypress, post-build-variant-value=true, set at post-build, destination=McuClockReferencePoint  # Reference to the CPU clock configuration, which is used to calculate loop count of 1usec.

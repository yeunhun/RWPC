AUTOSAR XML (schema 4-2-2)
package /TS_T40D13M1I0R0
  ecuc definition collection LIN_EcuParameterDefinition: module=Lin
  module definition Lin [0..*]: refined-module-def=Lin, variants pre-compile  # Configuration of the Lin (LIN driver) module.
    container LinDemEventParameterRefs [0..1]: multiplicity set at pre-compile  # Container for the references to DemEventParameter elements which shall be invoked using the API Dem_ReportErrorStatus API in case the corresponding error occurs. The EventId is taken from the referenced DemEventParameter's DemEventId value. The standardized errors are provided in the container and can be extended by vendor specific error references.
      symbolic name reference LIN_E_TIMEOUT [0..1]: multiplicity set at pre-compile, set at pre-compile, destination=DemEventParameter  # Reference to the DemEventParameter which shall be issued when the error "Timeout caused by hardware error" has occurred. If the reference is not configured the error shall be reported as DET error.
    container LinGeneral  # This container contains the parameters related to each LIN Driver Unit.
      boolean LinDevErrorDetect: set at pre-compile, default-value=true  # Switches the Default Error Tracer (Det) detection and notification ON or OFF.
      integer LinIndex: 0..255, set at pre-compile, default-value=0  # Specifies the InstanceId of this module instance. If only one instance is present it shall have the Id 0.
      integer LinTimeoutDuration: 0..65535, set at pre-compile, default-value=0  # Specifies the maximum number of loops for blocking function until a timeout is raised in short term wait loops
      boolean LinVersionInfoApi: set at pre-compile, default-value=true  # Switches the Lin_GetVersionInfo function ON or OFF.
      function name LinErrorCalloutFunction: origin=Cypress, set at pre-compile, default-value=ErrorCalloutHandler  # Error callout function. Syntax: void ErrorCalloutHandler (uint16 ModuleId, uint8 InstanceId, uint8 ApiId, uint8 ErrorId) The error callout function is called on every error. The ASIL level of this function limits the ASIL level of the LIN driver.
      string LinIncludeFile [0..*]: multiplicity set at pre-compile, origin=Cypress, set at pre-compile, default-value=ErrorCalloutHandler.h  # A file that shall be included by Lin_Defines.h. Any application specific symbol that is used by the Lin configuration (e.g. Error callout function) should be included by configuring this parameter.
      boolean LinDeInitApi: origin=Cypress, set at pre-compile, default-value=true  # Switches the Lin_DeInit function ON or OFF.
    container LinGlobalConfig  # This container contains the global configuration parameter of the Lin driver.
      container LinChannel [1..*]: multiplicity set at pre-compile  # This container contains the configuration (parameters) of the LIN Controller(s).
        integer LinChannelBaudRate: 1000..20000, set at pre-compile, default-value=19200  # Specifies the baud rate of the LIN channel
        integer LinChannelId: 0..255, set at pre-compile, symbolic-name-value=true, default-value=0  # Identifies the LIN channel. Replaces LIN_CHANNEL_INDEX_NAME from the LIN SWS.
        boolean LinChannelWakeupSupport: set at pre-compile, default-value=true  # Specifies if the LIN hardware channel supports wake up functionality
        integer LinInstance: 0..9, origin=Cypress, set at pre-compile, default-value=0  # Defines the Lin instance to be used for this LIN channel.
        string LinChannelHwUsed: origin=Cypress, set at pre-compile, default-value=LIN00  # Defines the physical channel to be used for this LIN channel.
        integer LinChannelBreakLength: 13..26, origin=Cypress, set at pre-compile, default-value=13  # Specifies the length (in bits) of the LIN BREAK.
        integer LinChannelBreakDelimiter: 1..4, origin=Cypress, set at pre-compile, default-value=2  # Specifies the length (in bits) of the Lin Break Delimiter.
        integer LinChannelWakeupLength: 1..31, origin=Cypress, set at pre-compile, default-value=3  # Specifies the length (in bits) of the reception LIN WAKEUP.
        boolean LinChannelRxNoiseFilter: origin=Cypress, set at pre-compile, default-value=false  # Switches the Receiver Noise Filter ON or OFF.
        reference LinClockRef: set at pre-compile, destination=McuClockReferencePoint  # Reference to the LIN clock source configuration, which is set in the MCU driver configuration.
        symbolic name reference LinChannelEcuMWakeupSource [0..1]: multiplicity set at pre-compile, set at pre-compile, destination=EcuMWakeupSource  # This parameter contains a reference to the Wakeup Source for this controller as defined in the ECU State Manager.

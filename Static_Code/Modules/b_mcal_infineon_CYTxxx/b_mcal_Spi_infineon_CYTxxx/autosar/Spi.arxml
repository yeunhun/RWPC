AUTOSAR XML (schema 4-2-2)
package /TS_T40D13M1I0R0
  ecuc definition collection SPI_EcuParameterDefinition: module=Spi
  module definition Spi: post-build-variant-support=true, refined-module-def=Spi, variants post-build/pre-compile  # Configuration of the Spi (Serial Peripheral Interface) module.
    container SpiDemEventParameterRefs [0..1]: multiplicity set at post-build in variant post-build / pre-compile in variant pre-compile  # Container for the references to DemEventParameter elements which shall be invoked using the API Dem_ReportErrorStatus API in case the corresponding error occurs. The EventId is taken from the referenced DemEventParameter's DemEventId value. The standardized errors are provided in the container and can be extended by vendor specific error references.
      symbolic name reference SPI_E_HARDWARE_ERROR [0..1]: multiplicity set at pre-compile, set at pre-compile, destination=DemEventParameter  # Reference to configured DEM event to report "Hardware failure". If the reference is not configured the error shall not be reported.
    container SpiDriver: multiplicity set at post-build in variant post-build / pre-compile in variant pre-compile  # This container contains the configuration parameters and sub containers of the AUTOSAR Spi module.
      integer SpiMaxChannel [0..1]: 0..255, multiplicity set at post-build in variant post-build / pre-compile in variant pre-compile, post-build-variant-multiplicity=true, post-build-variant-value=true, set at post-build in variant post-build / pre-compile in variant pre-compile, default-value=1  # This parameter contains the number of Channels configured. It will be gathered by tools during the configuration stage.
      integer SpiMaxJob [0..1]: 0..65535, multiplicity set at post-build in variant post-build / pre-compile in variant pre-compile, post-build-variant-multiplicity=true, post-build-variant-value=true, set at post-build in variant post-build / pre-compile in variant pre-compile, default-value=1  # Total number of Jobs configured.
      integer SpiMaxSequence [0..1]: 0..255, multiplicity set at post-build in variant post-build / pre-compile in variant pre-compile, post-build-variant-multiplicity=true, post-build-variant-value=true, set at post-build in variant post-build / pre-compile in variant pre-compile, default-value=1  # Total number of Sequences configured.
      container SpiChannel [1..255]: multiplicity set at post-build in variant post-build / pre-compile in variant pre-compile, post-build-variant-multiplicity=true  # All data needed to configure one SPI-channel
        integer SpiChannelId: 0..254, set at pre-compile, symbolic-name-value=true, default-value=0  # SPI Channel ID, used as parameter in SPI API functions.
        enumeration SpiChannelType: {EB, IB}, post-build-variant-value=true, set at post-build in variant post-build / pre-compile in variant pre-compile, default-value=IB  # Buffer usage with EB/IB channel.
        integer SpiDataWidth: 4..32, post-build-variant-value=true, set at post-build in variant post-build / pre-compile in variant pre-compile, default-value=8  # This parameter is the width of a transmitted data unit.
        integer SpiDefaultData [0..1]: 0..4294967295, multiplicity set at post-build in variant post-build / pre-compile in variant pre-compile, post-build-variant-multiplicity=true, post-build-variant-value=true, set at post-build in variant post-build / pre-compile in variant pre-compile, default-value=0  # The default data to be transmitted when (for internal buffer or external buffer) the pointer passed to Spi_WriteIB (for internal buffer) or to Spi_SetupEB (for external buffer) is NULL.
        integer SpiEbMaxLength: 1..65535, post-build-variant-value=true, set at post-build in variant post-build / pre-compile in variant pre-compile, default-value=1  # This parameter contains the maximum size (number of data elements) of data buffers in case of EB Channels and only.
        boolean SpiAlignedBuffer: origin=Cypress, post-build-variant-value=true, set at post-build in variant post-build / pre-compile in variant pre-compile, default-value=false  # If this parameter is checked, the driver expects buffer alignment for the assigned external buffer. The checking this flag is a precondition to transfer this channel with DMA support.
        integer SpiIbNBuffers: 1..65535, post-build-variant-value=true, set at post-build in variant post-build / pre-compile in variant pre-compile, default-value=1  # This parameter contains the maximum number of data buffers in case of IB Channels and only.
        enumeration SpiTransferStart: {LSB, MSB}, post-build-variant-value=true, set at post-build in variant post-build / pre-compile in variant pre-compile, default-value=LSB  # This parameter defines the first starting bit for transmission.
      container SpiExternalDevice [1..254]: multiplicity set at post-build in variant post-build / pre-compile in variant pre-compile, post-build-variant-multiplicity=true  # The communication settings of an external device. Closely linked to SpiJob.
        boolean SpiForceOverwrite: origin=Cypress, set at post-build in variant post-build / pre-compile in variant pre-compile, default-value=false  # This parameter enables or disables forced overwrite of control registers. When this parameter is enabled, control information in the control register is overwritten even if the transfer is to the same external device.
        float SpiBaudrate: 0.0..1.0E9, post-build-variant-value=true, set at post-build in variant post-build / pre-compile in variant pre-compile, default-value=10.0  # This parameter is the communication baudrate - A value obtained by dividing PCLK(Spi source clock) by 4 to 16 is permitted for the parameter.
        boolean SpiEnableCs: post-build-variant-value=true, set at post-build in variant post-build / pre-compile in variant pre-compile, default-value=false  # This parameter enables or not the Chip Select handling functions. If this parameter is enabled then parameter SpiCsSelection further details the type of chip selection.
        enumeration SpiCsSelection [0..1]: {CS_VIA_PERIPHERAL_ENGINE, CS_VIA_GPIO}, multiplicity set at post-build in variant post-build / pre-compile in variant pre-compile, post-build-variant-multiplicity=true, post-build-variant-value=true, set at post-build in variant post-build / pre-compile in variant pre-compile, default-value=CS_VIA_PERIPHERAL_ENGINE  # When the Chip Select handling is enabled (see SpiEnableCs), then this parameter specifies if the Chip Select is handled automatically by Peripheral HW engine or via general purpose IO by Spi driver.
        string SpiCsIdentifier: set at pre-compile, symbolic-name-value=true, default-value=SPI_SELECT0  # This parameter is the symbolic name to identify the Chip Select (CS) allocated to this Job. In case that SpiCsSelection = CS_VIA_GPIO: SpiCsIdentifier must be a valid name of a configured pin of the DIO module. The symbolic name of a Dio channel equals the name of the Dio channel as configured in Dio module. In case that SpiCsSelection = CS_VIA_PERIPHERAL_ENGINE: SpiCsIdentifier must be one of the HW specific CS channels.
        enumeration SpiHwUnit: {SCB0, SCB1, SCB2, SCB3, SCB4, SCB5, SCB6, SCB7, SCB8, SCB9, SCB10, SCB11}, post-build-variant-value=true, set at post-build in variant post-build / pre-compile in variant pre-compile, default-value=SCB0  # This parameter is the symbolic name to identify the HW SPI Hardware microcontroller peripheral allocated to this Job. NOTE: The HW unit list deviates from the AUTOSAR standard in order to match the actually available HW units.
        enumeration SpiCsPolarity: {HIGH, LOW}, post-build-variant-value=true, set at post-build in variant post-build / pre-compile in variant pre-compile, default-value=LOW  # This parameter defines the active polarity of Chip Select.
        enumeration SpiDataShiftEdge: {LEADING, TRAILING}, post-build-variant-value=true, set at post-build in variant post-build / pre-compile in variant pre-compile, default-value=TRAILING  # This parameter defines the SPI data shift edge.
        enumeration SpiShiftClockIdleLevel: {HIGH, LOW}, post-build-variant-value=true, set at post-build in variant post-build / pre-compile in variant pre-compile, default-value=HIGH  # This parameter defines the SPI shift clock idle level.
        float SpiTimeClk2Cs: 0.0..0.0001, post-build-variant-value=true, set at post-build in variant post-build / pre-compile in variant pre-compile, default-value=0.0  # NOTE: Parameter is defined by AUTOSAR, but not used in the current implementation. The identifier appears in tresos, but its value (0.0) cannot be changed, shall be ignored. Timing between clock and Chip Select (in seconds) - This parameter allows to use a range of values from 0 up to 0.0001 seconds. The real configuration-value used in software BSW-SPI is calculated out of this by the generator-tools. This parameter does not used in Spi driver.
        float SpiSetupDelay: 0.0..1.75, origin=Cypress, set at post-build in variant post-build / pre-compile in variant pre-compile, default-value=0.0  # This parameter defines the time in Spi Clock cycle to start transmission after Chip Select is activated. It only takes effect if SpiCsSelection is set to CS_VIA_PERIPHERAL_ENGINE.
        float SpiHoldDelay: 0.0..1.75, origin=Cypress, set at post-build in variant post-build / pre-compile in variant pre-compile, default-value=0.0  # This parameter defines the time in Spi Clock cycle of Chip Select to become inactive after completed transmission. It only takes effect if SpiCsSelection is set to CS_VIA_PERIPHERAL_ENGINE.
        float SpiDeselect: 0.0..2.5, origin=Cypress, set at post-build in variant post-build / pre-compile in variant pre-compile, default-value=0.0  # This parameter defines the time of Chip Select to become active again after it is inactive. This parameter does not used in Spi driver.
        boolean SpiUseFifo: origin=Cypress, set at post-build in variant post-build / pre-compile in variant pre-compile, default-value=true  # Enable the use of a channel for communication using FIFO functionality.
        boolean SpiUseDma: origin=Cypress, set at post-build in variant post-build / pre-compile in variant pre-compile, default-value=false  # Enable the use of a DMA channel for communication using this SCB.
        integer SpiDmaChannelRx [0..1]: 0..255, multiplicity set at post-build in variant post-build / pre-compile in variant pre-compile, origin=Cypress, set at post-build in variant post-build / pre-compile in variant pre-compile, default-value=0  # The DMA channel to be used for receiving data. Value is required in case of DMA allowed!
        integer SpiDmaChannelTx [0..1]: 0..255, multiplicity set at post-build in variant post-build / pre-compile in variant pre-compile, origin=Cypress, set at post-build in variant post-build / pre-compile in variant pre-compile, default-value=0  # The DMA channel to be used for sending data. Value is required in case of DMA allowed!
        reference SpiClockRef: origin=Cypress, post-build-variant-value=true, set at post-build in variant post-build / pre-compile in variant pre-compile, destination=McuClockReferencePoint  # Reference to the Spi clock source configuration, which is set in the MCU driver configuration. Please check the Data Sheet of Derivate for the allowed clock reference points.
      container SpiJob [1..65535]: multiplicity set at post-build in variant post-build / pre-compile in variant pre-compile, post-build-variant-multiplicity=true  # All data needed to configure one SPI-Job, amongst others the connection between the internal SPI unit and the special settings for an external device is done.
        enumeration SpiHwUnitSynchronous [0..1]: {ASYNCHRONOUS, SYNCHRONOUS}, multiplicity set at post-build in variant post-build / pre-compile in variant pre-compile, post-build-variant-multiplicity=true, post-build-variant-value=true, set at post-build in variant post-build / pre-compile in variant pre-compile, default-value=ASYNCHRONOUS  # If SpiHwUnitSynchronous is set to "SYNCHRONOUS", the SpiJob uses its containing SpiDriver in a synchronous manner. If it is set to "ASYNCHRONOUS", it uses the driver in an asynchronous way. If the parameter is not set, the SpiChannel uses the driver also in an asynchronous way. Please check variable "SpiGeneral/SpiLevelDelivered" for allowed values.
        function name SpiJobEndNotification [0..1]: multiplicity set at post-build in variant post-build / pre-compile in variant pre-compile, post-build-variant-multiplicity=true, post-build-variant-value=true, set at post-build in variant post-build / pre-compile in variant pre-compile, default-value=Spi_JobEndNotification  # This parameter is a reference to a notification function.
        integer SpiJobId: 0..65534, set at pre-compile, symbolic-name-value=true, default-value=0  # SPI Job ID, used as parameter in SPI API functions.
        integer SpiJobPriority: 0..3, post-build-variant-value=true, set at post-build in variant post-build / pre-compile in variant pre-compile, default-value=0  # Priority set accordingly to SPI093: 0 (lowest) up to 3 (highest) priority.
        reference SpiDeviceAssignment: set at pre-compile, destination=SpiExternalDevice  # Reference to the external device used by this job
        container SpiChannelList [1..255]: multiplicity set at post-build in variant post-build / pre-compile in variant pre-compile, post-build-variant-multiplicity=true  # References to SPI channels and their order within the Job.
          integer SpiChannelIndex: 0..255, post-build-variant-value=true, set at post-build in variant post-build / pre-compile in variant pre-compile, default-value=0  # References to SPI channels and their order within the Job.
          reference SpiChannelAssignment: post-build-variant-value=true, set at post-build in variant post-build / pre-compile in variant pre-compile, destination=SpiChannel  # A job reference to a SPI channel.
      container SpiSequence [1..255]: multiplicity set at post-build in variant post-build / pre-compile in variant pre-compile, post-build-variant-multiplicity=true  # All data needed to configure one SPI sequence.
        boolean SpiInterruptibleSequence: post-build-variant-value=true, set at post-build in variant post-build / pre-compile in variant pre-compile, default-value=false  # This parameter allows or not this Sequence to be suspended by another one.
        function name SpiSeqEndNotification [0..1]: multiplicity set at post-build in variant post-build / pre-compile in variant pre-compile, post-build-variant-multiplicity=true, post-build-variant-value=true, set at post-build in variant post-build / pre-compile in variant pre-compile, default-value=Spi_SeqEndNotification  # This parameter is a reference to a notification function.
        integer SpiSequenceId: 0..254, scope=ECU, set at pre-compile, symbolic-name-value=true, default-value=0  # SPI Sequence ID, used as parameter in SPI API functions.
        reference SpiJobAssignment [1..*]: multiplicity set at post-build in variant post-build / pre-compile in variant pre-compile, post-build-variant-multiplicity=true, post-build-variant-value=true, set at post-build in variant post-build / pre-compile in variant pre-compile, destination=SpiJob  # A sequence references several jobs, which are executed during a communication sequence. Mixed Sequences (synchronous with asynchronous Jobs) are not allowed [SPI131]: an error will be reported at generation time.
    container SpiGeneral  # General configuration settings for SPI-Handler.
      boolean SpiCancelApi: set at pre-compile, default-value=true  # Switches the Spi_Cancel function ON or OFF.
      integer SpiChannelBuffersAllowed: 0..2, set at pre-compile, default-value=2  # Selects the SPI Handler/Driver Channel Buffers usage allowed and delivered. 0: only internal buffers allowed, 1: only external buffers allowed, 2: both external and internal buffers allowed.
      boolean SpiDevErrorDetect: set at pre-compile, default-value=true  # Switches the Development Error Detection and Notification ON or OFF.
      boolean SpiHwStatusApi: set at pre-compile, default-value=true  # Switches the Spi_GetHWUnitStatus function ON or OFF.
      boolean SpiInterruptibleSeqAllowed: set at pre-compile, default-value=false  # Switches the Interruptible Sequences handling functionality ON or OFF.
      integer SpiLevelDelivered: 0..2, set at pre-compile, default-value=2  # Selects the SPI Handler/Driver level of scalable functionality that is available and delivered. 0: simple synchronous SPI Handler/Driver 1: basic asynchronous SPI Handler/Driver 2: enhanced (synchronous/asynchronous) SPI Handler/Driver
      float SpiMainFunctionPeriod [0..1]: 1.0E-7..1.0, multiplicity set at pre-compile, set at pre-compile, default-value=0.01  # This parameter defines the cycle time of the function Spi_MainFunction_Handling in seconds. The parameter is not used by the driver it self, but it is used by upper layer.
      boolean SpiSupportConcurrentSyncTransmit: set at pre-compile, default-value=false  # Specifies whether concurrent Spi_SyncTransmit() calls for different sequences shall be configurable.
      string SpiUserCallbackHeaderFile [0..*]: multiplicity set at pre-compile, set at pre-compile, default-value=SpiUserCallbackHeader.h  # Header file name which will be included by the Spi. The value of this parameter shall be used as h-char-sequence or q-char-sequence according to ISO C90 section 6.10.2 "source file inclusion". The parameter value MUST NOT represent a path, since ISO C90 does not specify how such a path is treated (i.e., this is implementation defined (and additionally depends on the operating system and the underlying file system)).
      boolean SpiVersionInfoApi: set at pre-compile, default-value=true  # Switches the Spi_GetVersionInfo function ON or OFF.
      function name SpiErrorCalloutFunction: origin=Cypress, set at pre-compile, default-value=ErrorCalloutHandler  # Error callout function. Syntax: void ErrorCalloutHandler (uint16 ModuleId, uint8 InstanceId, uint8 ApiId, uint8 ErrorId) The error callout function is called on every error. The ASIL level of this function limits the ASIL level of the SPI driver.
      string SpiIncludeFile [0..*]: multiplicity set at pre-compile, origin=Cypress, set at pre-compile, default-value=ErrorCalloutHandler.h  # A file that shall be included by Spi_ExternalInclude.h. Any application specific symbol that is used by the Spi configuration (e.g. Error callout function) should be included by configuring this parameter.
    container SpiPublishedInformation  # Container holding all SPI specific published information parameters.
      integer SpiMaxHwUnit: 0..9223372036854775807, set at published-information, default-value=32  # Number of different SPI hardware microcontroller peripherals (units/busses) available and handled by this SPI Handler/Driver module. This value is a dummy. Refer to the hardware data sheet for the actual number of units.

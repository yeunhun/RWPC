AUTOSAR XML (schema 4-2-2)
package /TS_T40D13M1I0R0
  ecuc definition collection FLS_EcuParameterDefinition: module=Fls
  module definition Fls [0..*]: post-build-variant-support=true, refined-module-def=Fls, variants post-build/pre-compile  # Configuration of the Fls (internal or external flash driver) module. Its multiplicity describes the number of flash drivers present, so there will be one container for each flash driver in the ECUC template. When no flash driver is present then the multiplicity is 0.
    container FlsConfigSet  # Container for runtime configuration parameters of the flash driver. Implementation Type: Fls_ConfigType.
      integer FlsAcErase: 0..0, post-build-variant-value=true, set at post-build in variant post-build / pre-compile in variant pre-compile, default-value=0  # Address offset in RAM to which the erase flash access code shall be loaded. Used as function pointer to access the erase flash access code.
      integer FlsAcWrite: 0..0, post-build-variant-value=true, set at post-build in variant post-build / pre-compile in variant pre-compile, default-value=0  # Address offset in RAM to which the write flash access code shall be loaded. Used as function pointer to access the write flash access code.
      float FlsCallCycle: 0.0..1.0, post-build-variant-value=true, set at post-build in variant post-build / pre-compile in variant pre-compile, default-value=0.01  # Cycle time of calls of the flash driver's main function. This value is given in seconds.
      enumeration FlsDefaultMode: {MEMIF_MODE_FAST, MEMIF_MODE_SLOW}, post-build-variant-value=true, set at post-build in variant post-build / pre-compile in variant pre-compile, default-value=MEMIF_MODE_SLOW  # This parameter is the default FLS device mode after initialization. Implementation Type: MemIf_ModeType.
      function name FlsJobEndNotification [0..1]: multiplicity set at post-build in variant post-build / pre-compile in variant pre-compile, post-build-variant-multiplicity=true, post-build-variant-value=true, set at post-build in variant post-build / pre-compile in variant pre-compile, default-value=Fee_JobEndNotification  # Mapped to the job end notification routine provided by some upper layer module, typically the Fee module.
      function name FlsJobErrorNotification [0..1]: multiplicity set at post-build in variant post-build / pre-compile in variant pre-compile, post-build-variant-multiplicity=true, post-build-variant-value=true, set at post-build in variant post-build / pre-compile in variant pre-compile, default-value=Fee_JobErrorNotification  # Mapped to the job error notification routine provided by some upper layer module, typically the Fee module.
      integer FlsMaxReadFastMode: 4..4294967292, post-build-variant-value=true, set at post-build in variant post-build / pre-compile in variant pre-compile, default-value=1024  # The maximum number of bytes to read or compare in one cycle of the flash driver's job processing function in fast mode.
      integer FlsMaxReadNormalMode: 4..4294967292, post-build-variant-value=true, set at post-build in variant post-build / pre-compile in variant pre-compile, default-value=128  # The maximum number of bytes to read or compare in one cycle of the flash driver's job processing function in normal mode.
      integer FlsMaxWriteFastMode: 4..4294967292, post-build-variant-value=true, set at post-build in variant post-build / pre-compile in variant pre-compile, default-value=64  # The maximum number of bytes to write in one cycle of the flash driver's job processing function in fast mode.
      integer FlsMaxWriteNormalMode: 4..4294967292, post-build-variant-value=true, set at post-build in variant post-build / pre-compile in variant pre-compile, default-value=16  # The maximum number of bytes to write in one cycle of the flash driver's job processing function in normal mode.
      integer FlsProtection: 0..0, post-build-variant-value=true, set at post-build in variant post-build / pre-compile in variant pre-compile, default-value=0  # Erase/write protection settings. Only relevant if supported by hardware.
      integer FlsNumberOfDelayLoop: 0..4294967295, origin=Cypress, post-build-variant-value=true, set at post-build in variant post-build / pre-compile in variant pre-compile, default-value=2000  # Number of delay (wait) loop for writing a flash block
      function name FlsDedErrorNotification [0..1]: multiplicity set at post-build in variant post-build / pre-compile in variant pre-compile, origin=Cypress, post-build-variant-multiplicity=true, post-build-variant-value=true, set at post-build in variant post-build / pre-compile in variant pre-compile, default-value=Fee_DedErrorNotification  # Mapped to the DED error notification routine provided by some upper layer module, typically the Fee module.
      function name FlsSedErrorNotification [0..1]: multiplicity set at post-build in variant post-build / pre-compile in variant pre-compile, origin=Cypress, post-build-variant-multiplicity=true, post-build-variant-value=true, set at post-build in variant post-build / pre-compile in variant pre-compile, default-value=Fee_SedErrorNotification  # Mapped to the SED error notification routine provided by some upper layer module, typically the Fee module.
      container FlsDemEventParameterRefs [0..0]  # Container for the references to DemEventParameter elements which shall be invoked using the Dem_ReportErrorStatus API in case the corresponding error occurs. The EventId is taken from the referenced DemEventParameter's DemEventId value. The standardized errors are provided in the container and can be extended by vendor specific error references.
        symbolic name reference FLS_E_COMPARE_FAILED [0..0]: set at pre-compile, destination=DemEventParameter  # Reference to the DemEventParameter which shall be issued when the error "Flash compare failed (HW)" has occurred.
        symbolic name reference FLS_E_ERASE_FAILED [0..0]: set at pre-compile, destination=DemEventParameter  # Reference to the DemEventParameter which shall be issued when the error "Flash erase failed (HW)" has occurred.
        symbolic name reference FLS_E_READ_FAILED [0..0]: set at pre-compile, destination=DemEventParameter  # Reference to the DemEventParameter which shall be issued when the error "Flash read failed (HW)" has occurred.
        symbolic name reference FLS_E_WRITE_FAILED [0..0]: set at pre-compile, destination=DemEventParameter  # Reference to the DemEventParameter which shall be issued when the error "Flash write failed (HW)" has occurred.
        symbolic name reference FLS_E_UNEXPECTED_FLASH_ID [0..0]: set at pre-compile, destination=DemEventParameter  # Reference to the DemEventParameter which shall be issued when the error "Expected hardware ID not matched" has occurred.
      container FlsExternalDriver [0..0]  # This container is present for external Flash drivers only. Internal Flash drivers do not use the parameter listed in this container, hence its multiplicity is 0 for internal drivers.
        symbolic name reference FlsSpiReference: set at pre-compile, destination=SpiSequence  # Reference to SPI sequence (required for external Flash drivers).
      container FlsSectorList  # List of flashable sectors and pages.
        container FlsSector [1..*]: multiplicity set at post-build in variant post-build / pre-compile in variant pre-compile  # Configuration description of a flashable sector
          enumeration FlsSectorIdentifier: {WFLASH_LG_SBM_SECTOR_0, WFLASH_LG_SBM_SECTOR_1, WFLASH_LG_SBM_SECTOR_2, WFLASH_LG_SBM_SECTOR_3, WFLASH_LG_SBM_SECTOR_4, WFLASH_LG_SBM_SECTOR_5, WFLASH_LG_SBM_SECTOR_6, WFLASH_LG_SBM_SECTOR_7, WFLASH_LG_SBM_SECTOR_8, WFLASH_LG_SBM_SECTOR_9, WFLASH_LG_SBM_SECTOR_10, WFLASH_LG_SBM_SECTOR_11, WFLASH_LG_SBM_SECTOR_12, WFLASH_LG_SBM_SECTOR_13, WFLASH_LG_SBM_SECTOR_14, WFLASH_LG_SBM_SECTOR_15, WFLASH_LG_SBM_SECTOR_16, WFLASH_LG_SBM_SECTOR_17, WFLASH_LG_SBM_SECTOR_18, WFLASH_LG_SBM_SECTOR_19, WFLASH_LG_SBM_SECTOR_20, WFLASH_LG_SBM_SECTOR_21, WFLASH_LG_SBM_SECTOR_22, WFLASH_LG_SBM_SECTOR_23, WFLASH_LG_SBM_SECTOR_24, WFLASH_LG_SBM_SECTOR_25, WFLASH_LG_SBM_SECTOR_26, WFLASH_LG_SBM_SECTOR_27, WFLASH_LG_SBM_SECTOR_28, WFLASH_LG_SBM_SECTOR_29, WFLASH_LG_SBM_SECTOR_30, WFLASH_LG_SBM_SECTOR_31, WFLASH_LG_SBM_SECTOR_32, WFLASH_LG_SBM_SECTOR_33, WFLASH_LG_SBM_SECTOR_34, WFLASH_LG_SBM_SECTOR_35, WFLASH_LG_SBM_SECTOR_36, WFLASH_LG_SBM_SECTOR_37, WFLASH_LG_SBM_SECTOR_38, WFLASH_LG_SBM_SECTOR_39, WFLASH_LG_SBM_SECTOR_40, WFLASH_LG_SBM_SECTOR_41, WFLASH_LG_SBM_SECTOR_42, WFLASH_LG_SBM_SECTOR_43, WFLASH_LG_SBM_SECTOR_44, WFLASH_LG_SBM_SECTOR_45, WFLASH_LG_SBM_SECTOR_46, WFLASH_LG_SBM_SECTOR_47, WFLASH_LG_SBM_SECTOR_48, WFLASH_LG_SBM_SECTOR_49, WFLASH_LG_SBM_SECTOR_50, WFLASH_LG_SBM_SECTOR_51, WFLASH_LG_SBM_SECTOR_52, WFLASH_LG_SBM_SECTOR_53, WFLASH_LG_SBM_SECTOR_54, WFLASH_LG_SBM_SECTOR_55, WFLASH_LG_SBM_SECTOR_56, WFLASH_LG_SBM_SECTOR_57, WFLASH_LG_SBM_SECTOR_58, WFLASH_LG_SBM_SECTOR_59, WFLASH_LG_SBM_SECTOR_60, WFLASH_LG_SBM_SECTOR_61, WFLASH_LG_SBM_SECTOR_62, WFLASH_LG_SBM_SECTOR_63, WFLASH_LG_SBM_SECTOR_64, WFLASH_LG_SBM_SECTOR_65, WFLASH_LG_SBM_SECTOR_66, WFLASH_LG_SBM_SECTOR_67, WFLASH_LG_SBM_SECTOR_68, WFLASH_LG_SBM_SECTOR_69, WFLASH_LG_SBM_SECTOR_70, WFLASH_LG_SBM_SECTOR_71, WFLASH_LG_SBM_SECTOR_72, WFLASH_LG_SBM_SECTOR_73, WFLASH_LG_SBM_SECTOR_74, WFLASH_LG_SBM_SECTOR_75, WFLASH_LG_SBM_SECTOR_76, WFLASH_LG_SBM_SECTOR_77, WFLASH_LG_SBM_SECTOR_78, WFLASH_LG_SBM_SECTOR_79, WFLASH_LG_SBM_SECTOR_80, WFLASH_LG_SBM_SECTOR_81, WFLASH_LG_SBM_SECTOR_82, WFLASH_LG_SBM_SECTOR_83, WFLASH_LG_SBM_SECTOR_84, WFLASH_LG_SBM_SECTOR_85, WFLASH_LG_SBM_SECTOR_86, WFLASH_LG_SBM_SECTOR_87, WFLASH_LG_SBM_SECTOR_88, WFLASH_LG_SBM_SECTOR_89, WFLASH_LG_SBM_SECTOR_90, WFLASH_LG_SBM_SECTOR_91, WFLASH_LG_SBM_SECTOR_92, WFLASH_LG_SBM_SECTOR_93, WFLASH_LG_SBM_SECTOR_94, WFLASH_LG_SBM_SECTOR_95, WFLASH_LG_SBM_SECTOR_96, WFLASH_LG_SBM_SECTOR_97, WFLASH_LG_SBM_SECTOR_98, WFLASH_LG_SBM_SECTOR_99, WFLASH_LG_SBM_SECTOR_100, WFLASH_LG_SBM_SECTOR_101, WFLASH_LG_SBM_SECTOR_102, WFLASH_LG_SBM_SECTOR_103, WFLASH_LG_SBM_SECTOR_104, WFLASH_LG_SBM_SECTOR_105, WFLASH_LG_SBM_SECTOR_106, WFLASH_LG_SBM_SECTOR_107, WFLASH_LG_SBM_SECTOR_108, WFLASH_LG_SBM_SECTOR_109, WFLASH_LG_SBM_SECTOR_110, WFLASH_LG_SBM_SECTOR_111, WFLASH_LG_SBM_SECTOR_112, WFLASH_LG_SBM_SECTOR_113, WFLASH_LG_SBM_SECTOR_114, WFLASH_LG_SBM_SECTOR_115, WFLASH_LG_SBM_SECTOR_116, WFLASH_LG_SBM_SECTOR_117, WFLASH_LG_SBM_SECTOR_118, WFLASH_LG_SBM_SECTOR_119, WFLASH_LG_SBM_SECTOR_120, WFLASH_LG_SBM_SECTOR_121, WFLASH_LG_SBM_SECTOR_122, WFLASH_LG_SBM_SECTOR_123, WFLASH_LG_SBM_SECTOR_124, WFLASH_LG_SBM_SECTOR_125, WFLASH_LG_SBM_SECTOR_126, WFLASH_LG_SBM_SECTOR_127, WFLASH_LG_SBM_SECTOR_128, WFLASH_LG_SBM_SECTOR_129, WFLASH_LG_SBM_SECTOR_130, WFLASH_LG_SBM_SECTOR_131, WFLASH_LG_SBM_SECTOR_132, WFLASH_LG_SBM_SECTOR_133, WFLASH_LG_SBM_SECTOR_134, WFLASH_LG_SBM_SECTOR_135, WFLASH_LG_SBM_SECTOR_136, WFLASH_LG_SBM_SECTOR_137, WFLASH_LG_SBM_SECTOR_138, WFLASH_LG_SBM_SECTOR_139, WFLASH_LG_SBM_SECTOR_140, WFLASH_LG_SBM_SECTOR_141, WFLASH_LG_SBM_SECTOR_142, WFLASH_LG_SBM_SECTOR_143, WFLASH_LG_SBM_SECTOR_144, WFLASH_LG_SBM_SECTOR_145, WFLASH_LG_SBM_SECTOR_146, WFLASH_LG_SBM_SECTOR_147, WFLASH_LG_SBM_SECTOR_148, WFLASH_LG_SBM_SECTOR_149, WFLASH_LG_SBM_SECTOR_150, WFLASH_LG_SBM_SECTOR_151, WFLASH_LG_SBM_SECTOR_152, WFLASH_LG_SBM_SECTOR_153, WFLASH_LG_SBM_SECTOR_154, WFLASH_LG_SBM_SECTOR_155, WFLASH_LG_SBM_SECTOR_156, WFLASH_LG_SBM_SECTOR_157, WFLASH_LG_SBM_SECTOR_158, WFLASH_LG_SBM_SECTOR_159, WFLASH_LG_SBM_SECTOR_160, WFLASH_LG_SBM_SECTOR_161, WFLASH_LG_SBM_SECTOR_162, WFLASH_LG_SBM_SECTOR_163, WFLASH_LG_SBM_SECTOR_164, WFLASH_LG_SBM_SECTOR_165, WFLASH_LG_SBM_SECTOR_166, WFLASH_LG_SBM_SECTOR_167, WFLASH_LG_SBM_SECTOR_168, WFLASH_LG_SBM_SECTOR_169, WFLASH_LG_SBM_SECTOR_170, WFLASH_LG_SBM_SECTOR_171, WFLASH_LG_SBM_SECTOR_172, WFLASH_LG_SBM_SECTOR_173, WFLASH_LG_SBM_SECTOR_174, WFLASH_LG_SBM_SECTOR_175, WFLASH_LG_SBM_SECTOR_176, WFLASH_LG_SBM_SECTOR_177, WFLASH_LG_SBM_SECTOR_178, WFLASH_LG_SBM_SECTOR_179, WFLASH_LG_SBM_SECTOR_180, WFLASH_LG_SBM_SECTOR_181, WFLASH_LG_SBM_SECTOR_182, WFLASH_LG_SBM_SECTOR_183, WFLASH_LG_SBM_SECTOR_184, WFLASH_LG_SBM_SECTOR_185, WFLASH_LG_SBM_SECTOR_186, WFLASH_LG_SBM_SECTOR_187, WFLASH_LG_SBM_SECTOR_188, WFLASH_LG_SBM_SECTOR_189, WFLASH_LG_SBM_SECTOR_190, WFLASH_LG_SBM_SECTOR_191, WFLASH_SM_SBM_SECTOR_0, WFLASH_SM_SBM_SECTOR_1, WFLASH_SM_SBM_SECTOR_2, WFLASH_SM_SBM_SECTOR_3, WFLASH_SM_SBM_SECTOR_4, WFLASH_SM_SBM_SECTOR_5, WFLASH_SM_SBM_SECTOR_6, WFLASH_SM_SBM_SECTOR_7, WFLASH_SM_SBM_SECTOR_8, WFLASH_SM_SBM_SECTOR_9, WFLASH_SM_SBM_SECTOR_10, WFLASH_SM_SBM_SECTOR_11, WFLASH_SM_SBM_SECTOR_12, WFLASH_SM_SBM_SECTOR_13, WFLASH_SM_SBM_SECTOR_14, WFLASH_SM_SBM_SECTOR_15, WFLASH_SM_SBM_SECTOR_16, WFLASH_SM_SBM_SECTOR_17, WFLASH_SM_SBM_SECTOR_18, WFLASH_SM_SBM_SECTOR_19, WFLASH_SM_SBM_SECTOR_20, WFLASH_SM_SBM_SECTOR_21, WFLASH_SM_SBM_SECTOR_22, WFLASH_SM_SBM_SECTOR_23, WFLASH_SM_SBM_SECTOR_24, WFLASH_SM_SBM_SECTOR_25, WFLASH_SM_SBM_SECTOR_26, WFLASH_SM_SBM_SECTOR_27, WFLASH_SM_SBM_SECTOR_28, WFLASH_SM_SBM_SECTOR_29, WFLASH_SM_SBM_SECTOR_30, WFLASH_SM_SBM_SECTOR_31, WFLASH_SM_SBM_SECTOR_32, WFLASH_SM_SBM_SECTOR_33, WFLASH_SM_SBM_SECTOR_34, WFLASH_SM_SBM_SECTOR_35, WFLASH_SM_SBM_SECTOR_36, WFLASH_SM_SBM_SECTOR_37, WFLASH_SM_SBM_SECTOR_38, WFLASH_SM_SBM_SECTOR_39, WFLASH_SM_SBM_SECTOR_40, WFLASH_SM_SBM_SECTOR_41, WFLASH_SM_SBM_SECTOR_42, WFLASH_SM_SBM_SECTOR_43, WFLASH_SM_SBM_SECTOR_44, WFLASH_SM_SBM_SECTOR_45, WFLASH_SM_SBM_SECTOR_46, WFLASH_SM_SBM_SECTOR_47, WFLASH_SM_SBM_SECTOR_48, WFLASH_SM_SBM_SECTOR_49, WFLASH_SM_SBM_SECTOR_50, WFLASH_SM_SBM_SECTOR_51, WFLASH_SM_SBM_SECTOR_52, WFLASH_SM_SBM_SECTOR_53, WFLASH_SM_SBM_SECTOR_54, WFLASH_SM_SBM_SECTOR_55, WFLASH_SM_SBM_SECTOR_56, WFLASH_SM_SBM_SECTOR_57, WFLASH_SM_SBM_SECTOR_58, WFLASH_SM_SBM_SECTOR_59, WFLASH_SM_SBM_SECTOR_60, WFLASH_SM_SBM_SECTOR_61, WFLASH_SM_SBM_SECTOR_62, WFLASH_SM_SBM_SECTOR_63, WFLASH_SM_SBM_SECTOR_64, WFLASH_SM_SBM_SECTOR_65, WFLASH_SM_SBM_SECTOR_66, WFLASH_SM_SBM_SECTOR_67, WFLASH_SM_SBM_SECTOR_68, WFLASH_SM_SBM_SECTOR_69, WFLASH_SM_SBM_SECTOR_70, WFLASH_SM_SBM_SECTOR_71, WFLASH_SM_SBM_SECTOR_72, WFLASH_SM_SBM_SECTOR_73, WFLASH_SM_SBM_SECTOR_74, WFLASH_SM_SBM_SECTOR_75, WFLASH_SM_SBM_SECTOR_76, WFLASH_SM_SBM_SECTOR_77, WFLASH_SM_SBM_SECTOR_78, WFLASH_SM_SBM_SECTOR_79, WFLASH_SM_SBM_SECTOR_80, WFLASH_SM_SBM_SECTOR_81, WFLASH_SM_SBM_SECTOR_82, WFLASH_SM_SBM_SECTOR_83, WFLASH_SM_SBM_SECTOR_84, WFLASH_SM_SBM_SECTOR_85, WFLASH_SM_SBM_SECTOR_86, WFLASH_SM_SBM_SECTOR_87, WFLASH_SM_SBM_SECTOR_88, WFLASH_SM_SBM_SECTOR_89, WFLASH_SM_SBM_SECTOR_90, WFLASH_SM_SBM_SECTOR_91, WFLASH_SM_SBM_SECTOR_92, WFLASH_SM_SBM_SECTOR_93, WFLASH_SM_SBM_SECTOR_94, WFLASH_SM_SBM_SECTOR_95, WFLASH_SM_SBM_SECTOR_96, WFLASH_SM_SBM_SECTOR_97, WFLASH_SM_SBM_SECTOR_98, WFLASH_SM_SBM_SECTOR_99, WFLASH_SM_SBM_SECTOR_100, WFLASH_SM_SBM_SECTOR_101, WFLASH_SM_SBM_SECTOR_102, WFLASH_SM_SBM_SECTOR_103, WFLASH_SM_SBM_SECTOR_104, WFLASH_SM_SBM_SECTOR_105, WFLASH_SM_SBM_SECTOR_106, WFLASH_SM_SBM_SECTOR_107, WFLASH_SM_SBM_SECTOR_108, WFLASH_SM_SBM_SECTOR_109, WFLASH_SM_SBM_SECTOR_110, WFLASH_SM_SBM_SECTOR_111, WFLASH_SM_SBM_SECTOR_112, WFLASH_SM_SBM_SECTOR_113, WFLASH_SM_SBM_SECTOR_114, WFLASH_SM_SBM_SECTOR_115, WFLASH_SM_SBM_SECTOR_116, WFLASH_SM_SBM_SECTOR_117, WFLASH_SM_SBM_SECTOR_118, WFLASH_SM_SBM_SECTOR_119, WFLASH_SM_SBM_SECTOR_120, WFLASH_SM_SBM_SECTOR_121, WFLASH_SM_SBM_SECTOR_122, WFLASH_SM_SBM_SECTOR_123, WFLASH_SM_SBM_SECTOR_124, WFLASH_SM_SBM_SECTOR_125, WFLASH_SM_SBM_SECTOR_126, WFLASH_SM_SBM_SECTOR_127, WFLASH_SM_SBM_SECTOR_128, WFLASH_SM_SBM_SECTOR_129, WFLASH_SM_SBM_SECTOR_130, WFLASH_SM_SBM_SECTOR_131, WFLASH_SM_SBM_SECTOR_132, WFLASH_SM_SBM_SECTOR_133, WFLASH_SM_SBM_SECTOR_134, WFLASH_SM_SBM_SECTOR_135, WFLASH_SM_SBM_SECTOR_136, WFLASH_SM_SBM_SECTOR_137, WFLASH_SM_SBM_SECTOR_138, WFLASH_SM_SBM_SECTOR_139, WFLASH_SM_SBM_SECTOR_140, WFLASH_SM_SBM_SECTOR_141, WFLASH_SM_SBM_SECTOR_142, WFLASH_SM_SBM_SECTOR_143, WFLASH_SM_SBM_SECTOR_144, WFLASH_SM_SBM_SECTOR_145, WFLASH_SM_SBM_SECTOR_146, WFLASH_SM_SBM_SECTOR_147, WFLASH_SM_SBM_SECTOR_148, WFLASH_SM_SBM_SECTOR_149, WFLASH_SM_SBM_SECTOR_150, WFLASH_SM_SBM_SECTOR_151, WFLASH_SM_SBM_SECTOR_152, WFLASH_SM_SBM_SECTOR_153, WFLASH_SM_SBM_SECTOR_154, WFLASH_SM_SBM_SECTOR_155, WFLASH_SM_SBM_SECTOR_156, WFLASH_SM_SBM_SECTOR_157, WFLASH_SM_SBM_SECTOR_158, WFLASH_SM_SBM_SECTOR_159, WFLASH_SM_SBM_SECTOR_160, WFLASH_SM_SBM_SECTOR_161, WFLASH_SM_SBM_SECTOR_162, WFLASH_SM_SBM_SECTOR_163, WFLASH_SM_SBM_SECTOR_164, WFLASH_SM_SBM_SECTOR_165, WFLASH_SM_SBM_SECTOR_166, WFLASH_SM_SBM_SECTOR_167, WFLASH_SM_SBM_SECTOR_168, WFLASH_SM_SBM_SECTOR_169, WFLASH_SM_SBM_SECTOR_170, WFLASH_SM_SBM_SECTOR_171, WFLASH_SM_SBM_SECTOR_172, WFLASH_SM_SBM_SECTOR_173, WFLASH_SM_SBM_SECTOR_174, WFLASH_SM_SBM_SECTOR_175, WFLASH_SM_SBM_SECTOR_176, WFLASH_SM_SBM_SECTOR_177, WFLASH_SM_SBM_SECTOR_178, WFLASH_SM_SBM_SECTOR_179, WFLASH_SM_SBM_SECTOR_180, WFLASH_SM_SBM_SECTOR_181, WFLASH_SM_SBM_SECTOR_182, WFLASH_SM_SBM_SECTOR_183, WFLASH_SM_SBM_SECTOR_184, WFLASH_SM_SBM_SECTOR_185, WFLASH_SM_SBM_SECTOR_186, WFLASH_SM_SBM_SECTOR_187, WFLASH_SM_SBM_SECTOR_188, WFLASH_SM_SBM_SECTOR_189, WFLASH_SM_SBM_SECTOR_190, WFLASH_SM_SBM_SECTOR_191, WFLASH_SM_SBM_SECTOR_192, WFLASH_SM_SBM_SECTOR_193, WFLASH_SM_SBM_SECTOR_194, WFLASH_SM_SBM_SECTOR_195, WFLASH_SM_SBM_SECTOR_196, WFLASH_SM_SBM_SECTOR_197, WFLASH_SM_SBM_SECTOR_198, WFLASH_SM_SBM_SECTOR_199, WFLASH_SM_SBM_SECTOR_200, WFLASH_SM_SBM_SECTOR_201, WFLASH_SM_SBM_SECTOR_202, WFLASH_SM_SBM_SECTOR_203, WFLASH_SM_SBM_SECTOR_204, WFLASH_SM_SBM_SECTOR_205, WFLASH_SM_SBM_SECTOR_206, WFLASH_SM_SBM_SECTOR_207, WFLASH_SM_SBM_SECTOR_208, WFLASH_SM_SBM_SECTOR_209, WFLASH_SM_SBM_SECTOR_210, WFLASH_SM_SBM_SECTOR_211, WFLASH_SM_SBM_SECTOR_212, WFLASH_SM_SBM_SECTOR_213, WFLASH_SM_SBM_SECTOR_214, WFLASH_SM_SBM_SECTOR_215, WFLASH_SM_SBM_SECTOR_216, WFLASH_SM_SBM_SECTOR_217, WFLASH_SM_SBM_SECTOR_218, WFLASH_SM_SBM_SECTOR_219, WFLASH_SM_SBM_SECTOR_220, WFLASH_SM_SBM_SECTOR_221, WFLASH_SM_SBM_SECTOR_222, WFLASH_SM_SBM_SECTOR_223, WFLASH_SM_SBM_SECTOR_224, WFLASH_SM_SBM_SECTOR_225, WFLASH_SM_SBM_SECTOR_226, WFLASH_SM_SBM_SECTOR_227, WFLASH_SM_SBM_SECTOR_228, WFLASH_SM_SBM_SECTOR_229, WFLASH_SM_SBM_SECTOR_230, WFLASH_SM_SBM_SECTOR_231, WFLASH_SM_SBM_SECTOR_232, WFLASH_SM_SBM_SECTOR_233, WFLASH_SM_SBM_SECTOR_234, WFLASH_SM_SBM_SECTOR_235, WFLASH_SM_SBM_SECTOR_236, WFLASH_SM_SBM_SECTOR_237, WFLASH_SM_SBM_SECTOR_238, WFLASH_SM_SBM_SECTOR_239, WFLASH_SM_SBM_SECTOR_240, WFLASH_SM_SBM_SECTOR_241, WFLASH_SM_SBM_SECTOR_242, WFLASH_SM_SBM_SECTOR_243, WFLASH_SM_SBM_SECTOR_244, WFLASH_SM_SBM_SECTOR_245, WFLASH_SM_SBM_SECTOR_246, WFLASH_SM_SBM_SECTOR_247, WFLASH_SM_SBM_SECTOR_248, WFLASH_SM_SBM_SECTOR_249, WFLASH_SM_SBM_SECTOR_250, WFLASH_SM_SBM_SECTOR_251, WFLASH_SM_SBM_SECTOR_252, WFLASH_SM_SBM_SECTOR_253, WFLASH_SM_SBM_SECTOR_254, WFLASH_SM_SBM_SECTOR_255, WFLASH_SM_SBM_SECTOR_256, WFLASH_SM_SBM_SECTOR_257, WFLASH_SM_SBM_SECTOR_258, WFLASH_SM_SBM_SECTOR_259, WFLASH_SM_SBM_SECTOR_260, WFLASH_SM_SBM_SECTOR_261, WFLASH_SM_SBM_SECTOR_262, WFLASH_SM_SBM_SECTOR_263, WFLASH_SM_SBM_SECTOR_264, WFLASH_SM_SBM_SECTOR_265, WFLASH_SM_SBM_SECTOR_266, WFLASH_SM_SBM_SECTOR_267, WFLASH_SM_SBM_SECTOR_268, WFLASH_SM_SBM_SECTOR_269, WFLASH_SM_SBM_SECTOR_270, WFLASH_SM_SBM_SECTOR_271, WFLASH_SM_SBM_SECTOR_272, WFLASH_SM_SBM_SECTOR_273, WFLASH_SM_SBM_SECTOR_274, WFLASH_SM_SBM_SECTOR_275, WFLASH_SM_SBM_SECTOR_276, WFLASH_SM_SBM_SECTOR_277, WFLASH_SM_SBM_SECTOR_278, WFLASH_SM_SBM_SECTOR_279, WFLASH_SM_SBM_SECTOR_280, WFLASH_SM_SBM_SECTOR_281, WFLASH_SM_SBM_SECTOR_282, WFLASH_SM_SBM_SECTOR_283, WFLASH_SM_SBM_SECTOR_284, WFLASH_SM_SBM_SECTOR_285, WFLASH_SM_SBM_SECTOR_286, WFLASH_SM_SBM_SECTOR_287, WFLASH_SM_SBM_SECTOR_288, WFLASH_SM_SBM_SECTOR_289, WFLASH_SM_SBM_SECTOR_290, WFLASH_SM_SBM_SECTOR_291, WFLASH_SM_SBM_SECTOR_292, WFLASH_SM_SBM_SECTOR_293, WFLASH_SM_SBM_SECTOR_294, WFLASH_SM_SBM_SECTOR_295, WFLASH_SM_SBM_SECTOR_296, WFLASH_SM_SBM_SECTOR_297, WFLASH_SM_SBM_SECTOR_298, WFLASH_SM_SBM_SECTOR_299, WFLASH_SM_SBM_SECTOR_300, WFLASH_SM_SBM_SECTOR_301, WFLASH_SM_SBM_SECTOR_302, WFLASH_SM_SBM_SECTOR_303, WFLASH_SM_SBM_SECTOR_304, WFLASH_SM_SBM_SECTOR_305, WFLASH_SM_SBM_SECTOR_306, WFLASH_SM_SBM_SECTOR_307, WFLASH_SM_SBM_SECTOR_308, WFLASH_SM_SBM_SECTOR_309, WFLASH_SM_SBM_SECTOR_310, WFLASH_SM_SBM_SECTOR_311, WFLASH_SM_SBM_SECTOR_312, WFLASH_SM_SBM_SECTOR_313, WFLASH_SM_SBM_SECTOR_314, WFLASH_SM_SBM_SECTOR_315, WFLASH_SM_SBM_SECTOR_316, WFLASH_SM_SBM_SECTOR_317, WFLASH_SM_SBM_SECTOR_318, WFLASH_SM_SBM_SECTOR_319, WFLASH_SM_SBM_SECTOR_320, WFLASH_SM_SBM_SECTOR_321, WFLASH_SM_SBM_SECTOR_322, WFLASH_SM_SBM_SECTOR_323, WFLASH_SM_SBM_SECTOR_324, WFLASH_SM_SBM_SECTOR_325, WFLASH_SM_SBM_SECTOR_326, WFLASH_SM_SBM_SECTOR_327, WFLASH_SM_SBM_SECTOR_328, WFLASH_SM_SBM_SECTOR_329, WFLASH_SM_SBM_SECTOR_330, WFLASH_SM_SBM_SECTOR_331, WFLASH_SM_SBM_SECTOR_332, WFLASH_SM_SBM_SECTOR_333, WFLASH_SM_SBM_SECTOR_334, WFLASH_SM_SBM_SECTOR_335, WFLASH_SM_SBM_SECTOR_336, WFLASH_SM_SBM_SECTOR_337, WFLASH_SM_SBM_SECTOR_338, WFLASH_SM_SBM_SECTOR_339, WFLASH_SM_SBM_SECTOR_340, WFLASH_SM_SBM_SECTOR_341, WFLASH_SM_SBM_SECTOR_342, WFLASH_SM_SBM_SECTOR_343, WFLASH_SM_SBM_SECTOR_344, WFLASH_SM_SBM_SECTOR_345, WFLASH_SM_SBM_SECTOR_346, WFLASH_SM_SBM_SECTOR_347, WFLASH_SM_SBM_SECTOR_348, WFLASH_SM_SBM_SECTOR_349, WFLASH_SM_SBM_SECTOR_350, WFLASH_SM_SBM_SECTOR_351, WFLASH_SM_SBM_SECTOR_352, WFLASH_SM_SBM_SECTOR_353, WFLASH_SM_SBM_SECTOR_354, WFLASH_SM_SBM_SECTOR_355, WFLASH_SM_SBM_SECTOR_356, WFLASH_SM_SBM_SECTOR_357, WFLASH_SM_SBM_SECTOR_358, WFLASH_SM_SBM_SECTOR_359, WFLASH_SM_SBM_SECTOR_360, WFLASH_SM_SBM_SECTOR_361, WFLASH_SM_SBM_SECTOR_362, WFLASH_SM_SBM_SECTOR_363, WFLASH_SM_SBM_SECTOR_364, WFLASH_SM_SBM_SECTOR_365, WFLASH_SM_SBM_SECTOR_366, WFLASH_SM_SBM_SECTOR_367, WFLASH_SM_SBM_SECTOR_368, WFLASH_SM_SBM_SECTOR_369, WFLASH_SM_SBM_SECTOR_370, WFLASH_SM_SBM_SECTOR_371, WFLASH_SM_SBM_SECTOR_372, WFLASH_SM_SBM_SECTOR_373, WFLASH_SM_SBM_SECTOR_374, WFLASH_SM_SBM_SECTOR_375, WFLASH_SM_SBM_SECTOR_376, WFLASH_SM_SBM_SECTOR_377, WFLASH_SM_SBM_SECTOR_378, WFLASH_SM_SBM_SECTOR_379, WFLASH_SM_SBM_SECTOR_380, WFLASH_SM_SBM_SECTOR_381, WFLASH_SM_SBM_SECTOR_382, WFLASH_SM_SBM_SECTOR_383, WFLASH_SM_SBM_SECTOR_384, WFLASH_SM_SBM_SECTOR_385, WFLASH_SM_SBM_SECTOR_386, WFLASH_SM_SBM_SECTOR_387, WFLASH_SM_SBM_SECTOR_388, WFLASH_SM_SBM_SECTOR_389, WFLASH_SM_SBM_SECTOR_390, WFLASH_SM_SBM_SECTOR_391, WFLASH_SM_SBM_SECTOR_392, WFLASH_SM_SBM_SECTOR_393, WFLASH_SM_SBM_SECTOR_394, WFLASH_SM_SBM_SECTOR_395, WFLASH_SM_SBM_SECTOR_396, WFLASH_SM_SBM_SECTOR_397, WFLASH_SM_SBM_SECTOR_398, WFLASH_SM_SBM_SECTOR_399, WFLASH_SM_SBM_SECTOR_400, WFLASH_SM_SBM_SECTOR_401, WFLASH_SM_SBM_SECTOR_402, WFLASH_SM_SBM_SECTOR_403, WFLASH_SM_SBM_SECTOR_404, WFLASH_SM_SBM_SECTOR_405, WFLASH_SM_SBM_SECTOR_406, WFLASH_SM_SBM_SECTOR_407, WFLASH_SM_SBM_SECTOR_408, WFLASH_SM_SBM_SECTOR_409, WFLASH_SM_SBM_SECTOR_410, WFLASH_SM_SBM_SECTOR_411, WFLASH_SM_SBM_SECTOR_412, WFLASH_SM_SBM_SECTOR_413, WFLASH_SM_SBM_SECTOR_414, WFLASH_SM_SBM_SECTOR_415, WFLASH_SM_SBM_SECTOR_416, WFLASH_SM_SBM_SECTOR_417, WFLASH_SM_SBM_SECTOR_418, WFLASH_SM_SBM_SECTOR_419, WFLASH_SM_SBM_SECTOR_420, WFLASH_SM_SBM_SECTOR_421, WFLASH_SM_SBM_SECTOR_422, WFLASH_SM_SBM_SECTOR_423, WFLASH_SM_SBM_SECTOR_424, WFLASH_SM_SBM_SECTOR_425, WFLASH_SM_SBM_SECTOR_426, WFLASH_SM_SBM_SECTOR_427, WFLASH_SM_SBM_SECTOR_428, WFLASH_SM_SBM_SECTOR_429, WFLASH_SM_SBM_SECTOR_430, WFLASH_SM_SBM_SECTOR_431, WFLASH_SM_SBM_SECTOR_432, WFLASH_SM_SBM_SECTOR_433, WFLASH_SM_SBM_SECTOR_434, WFLASH_SM_SBM_SECTOR_435, WFLASH_SM_SBM_SECTOR_436, WFLASH_SM_SBM_SECTOR_437, WFLASH_SM_SBM_SECTOR_438, WFLASH_SM_SBM_SECTOR_439, WFLASH_SM_SBM_SECTOR_440, WFLASH_SM_SBM_SECTOR_441, WFLASH_SM_SBM_SECTOR_442, WFLASH_SM_SBM_SECTOR_443, WFLASH_SM_SBM_SECTOR_444, WFLASH_SM_SBM_SECTOR_445, WFLASH_SM_SBM_SECTOR_446, WFLASH_SM_SBM_SECTOR_447, WFLASH_SM_SBM_SECTOR_448, WFLASH_SM_SBM_SECTOR_449, WFLASH_SM_SBM_SECTOR_450, WFLASH_SM_SBM_SECTOR_451, WFLASH_SM_SBM_SECTOR_452, WFLASH_SM_SBM_SECTOR_453, WFLASH_SM_SBM_SECTOR_454, WFLASH_SM_SBM_SECTOR_455, WFLASH_SM_SBM_SECTOR_456, WFLASH_SM_SBM_SECTOR_457, WFLASH_SM_SBM_SECTOR_458, WFLASH_SM_SBM_SECTOR_459, WFLASH_SM_SBM_SECTOR_460, WFLASH_SM_SBM_SECTOR_461, WFLASH_SM_SBM_SECTOR_462, WFLASH_SM_SBM_SECTOR_463, WFLASH_SM_SBM_SECTOR_464, WFLASH_SM_SBM_SECTOR_465, WFLASH_SM_SBM_SECTOR_466, WFLASH_SM_SBM_SECTOR_467, WFLASH_SM_SBM_SECTOR_468, WFLASH_SM_SBM_SECTOR_469, WFLASH_SM_SBM_SECTOR_470, WFLASH_SM_SBM_SECTOR_471, WFLASH_SM_SBM_SECTOR_472, WFLASH_SM_SBM_SECTOR_473, WFLASH_SM_SBM_SECTOR_474, WFLASH_SM_SBM_SECTOR_475, WFLASH_SM_SBM_SECTOR_476, WFLASH_SM_SBM_SECTOR_477, WFLASH_SM_SBM_SECTOR_478, WFLASH_SM_SBM_SECTOR_479, WFLASH_SM_SBM_SECTOR_480, WFLASH_SM_SBM_SECTOR_481, WFLASH_SM_SBM_SECTOR_482, WFLASH_SM_SBM_SECTOR_483, WFLASH_SM_SBM_SECTOR_484, WFLASH_SM_SBM_SECTOR_485, WFLASH_SM_SBM_SECTOR_486, WFLASH_SM_SBM_SECTOR_487, WFLASH_SM_SBM_SECTOR_488, WFLASH_SM_SBM_SECTOR_489, WFLASH_SM_SBM_SECTOR_490, WFLASH_SM_SBM_SECTOR_491, WFLASH_SM_SBM_SECTOR_492, WFLASH_SM_SBM_SECTOR_493, WFLASH_SM_SBM_SECTOR_494, WFLASH_SM_SBM_SECTOR_495, WFLASH_SM_SBM_SECTOR_496, WFLASH_SM_SBM_SECTOR_497, WFLASH_SM_SBM_SECTOR_498, WFLASH_SM_SBM_SECTOR_499, WFLASH_SM_SBM_SECTOR_500, WFLASH_SM_SBM_SECTOR_501, WFLASH_SM_SBM_SECTOR_502, WFLASH_SM_SBM_SECTOR_503, WFLASH_SM_SBM_SECTOR_504, WFLASH_SM_SBM_SECTOR_505, WFLASH_SM_SBM_SECTOR_506, WFLASH_SM_SBM_SECTOR_507, WFLASH_SM_SBM_SECTOR_508, WFLASH_SM_SBM_SECTOR_509, WFLASH_SM_SBM_SECTOR_510, WFLASH_SM_SBM_SECTOR_511, WFLASH_SM_SBM_SECTOR_512, WFLASH_SM_SBM_SECTOR_513, WFLASH_SM_SBM_SECTOR_514, WFLASH_SM_SBM_SECTOR_515, WFLASH_SM_SBM_SECTOR_516, WFLASH_SM_SBM_SECTOR_517, WFLASH_SM_SBM_SECTOR_518, WFLASH_SM_SBM_SECTOR_519, WFLASH_SM_SBM_SECTOR_520, WFLASH_SM_SBM_SECTOR_521, WFLASH_SM_SBM_SECTOR_522, WFLASH_SM_SBM_SECTOR_523, WFLASH_SM_SBM_SECTOR_524, WFLASH_SM_SBM_SECTOR_525, WFLASH_SM_SBM_SECTOR_526, WFLASH_SM_SBM_SECTOR_527, WFLASH_SM_SBM_SECTOR_528, WFLASH_SM_SBM_SECTOR_529, WFLASH_SM_SBM_SECTOR_530, WFLASH_SM_SBM_SECTOR_531, WFLASH_SM_SBM_SECTOR_532, WFLASH_SM_SBM_SECTOR_533, WFLASH_SM_SBM_SECTOR_534, WFLASH_SM_SBM_SECTOR_535, WFLASH_SM_SBM_SECTOR_536, WFLASH_SM_SBM_SECTOR_537, WFLASH_SM_SBM_SECTOR_538, WFLASH_SM_SBM_SECTOR_539, WFLASH_SM_SBM_SECTOR_540, WFLASH_SM_SBM_SECTOR_541, WFLASH_SM_SBM_SECTOR_542, WFLASH_SM_SBM_SECTOR_543, WFLASH_SM_SBM_SECTOR_544, WFLASH_SM_SBM_SECTOR_545, WFLASH_SM_SBM_SECTOR_546, WFLASH_SM_SBM_SECTOR_547, WFLASH_SM_SBM_SECTOR_548, WFLASH_SM_SBM_SECTOR_549, WFLASH_SM_SBM_SECTOR_550, WFLASH_SM_SBM_SECTOR_551, WFLASH_SM_SBM_SECTOR_552, WFLASH_SM_SBM_SECTOR_553, WFLASH_SM_SBM_SECTOR_554, WFLASH_SM_SBM_SECTOR_555, WFLASH_SM_SBM_SECTOR_556, WFLASH_SM_SBM_SECTOR_557, WFLASH_SM_SBM_SECTOR_558, WFLASH_SM_SBM_SECTOR_559, WFLASH_SM_SBM_SECTOR_560, WFLASH_SM_SBM_SECTOR_561, WFLASH_SM_SBM_SECTOR_562, WFLASH_SM_SBM_SECTOR_563, WFLASH_SM_SBM_SECTOR_564, WFLASH_SM_SBM_SECTOR_565, WFLASH_SM_SBM_SECTOR_566, WFLASH_SM_SBM_SECTOR_567, WFLASH_SM_SBM_SECTOR_568, WFLASH_SM_SBM_SECTOR_569, WFLASH_SM_SBM_SECTOR_570, WFLASH_SM_SBM_SECTOR_571, WFLASH_SM_SBM_SECTOR_572, WFLASH_SM_SBM_SECTOR_573, WFLASH_SM_SBM_SECTOR_574, WFLASH_SM_SBM_SECTOR_575, WFLASH_SM_SBM_SECTOR_576, WFLASH_SM_SBM_SECTOR_577, WFLASH_SM_SBM_SECTOR_578, WFLASH_SM_SBM_SECTOR_579, WFLASH_SM_SBM_SECTOR_580, WFLASH_SM_SBM_SECTOR_581, WFLASH_SM_SBM_SECTOR_582, WFLASH_SM_SBM_SECTOR_583, WFLASH_SM_SBM_SECTOR_584, WFLASH_SM_SBM_SECTOR_585, WFLASH_SM_SBM_SECTOR_586, WFLASH_SM_SBM_SECTOR_587, WFLASH_SM_SBM_SECTOR_588, WFLASH_SM_SBM_SECTOR_589, WFLASH_SM_SBM_SECTOR_590, WFLASH_SM_SBM_SECTOR_591, WFLASH_SM_SBM_SECTOR_592, WFLASH_SM_SBM_SECTOR_593, WFLASH_SM_SBM_SECTOR_594, WFLASH_SM_SBM_SECTOR_595, WFLASH_SM_SBM_SECTOR_596, WFLASH_SM_SBM_SECTOR_597, WFLASH_SM_SBM_SECTOR_598, WFLASH_SM_SBM_SECTOR_599, WFLASH_SM_SBM_SECTOR_600, WFLASH_SM_SBM_SECTOR_601, WFLASH_SM_SBM_SECTOR_602, WFLASH_SM_SBM_SECTOR_603, WFLASH_SM_SBM_SECTOR_604, WFLASH_SM_SBM_SECTOR_605, WFLASH_SM_SBM_SECTOR_606, WFLASH_SM_SBM_SECTOR_607, WFLASH_SM_SBM_SECTOR_608, WFLASH_SM_SBM_SECTOR_609, WFLASH_SM_SBM_SECTOR_610, WFLASH_SM_SBM_SECTOR_611, WFLASH_SM_SBM_SECTOR_612, WFLASH_SM_SBM_SECTOR_613, WFLASH_SM_SBM_SECTOR_614, WFLASH_SM_SBM_SECTOR_615, WFLASH_SM_SBM_SECTOR_616, WFLASH_SM_SBM_SECTOR_617, WFLASH_SM_SBM_SECTOR_618, WFLASH_SM_SBM_SECTOR_619, WFLASH_SM_SBM_SECTOR_620, WFLASH_SM_SBM_SECTOR_621, WFLASH_SM_SBM_SECTOR_622, WFLASH_SM_SBM_SECTOR_623, WFLASH_SM_SBM_SECTOR_624, WFLASH_SM_SBM_SECTOR_625, WFLASH_SM_SBM_SECTOR_626, WFLASH_SM_SBM_SECTOR_627, WFLASH_SM_SBM_SECTOR_628, WFLASH_SM_SBM_SECTOR_629, WFLASH_SM_SBM_SECTOR_630, WFLASH_SM_SBM_SECTOR_631, WFLASH_SM_SBM_SECTOR_632, WFLASH_SM_SBM_SECTOR_633, WFLASH_SM_SBM_SECTOR_634, WFLASH_SM_SBM_SECTOR_635, WFLASH_SM_SBM_SECTOR_636, WFLASH_SM_SBM_SECTOR_637, WFLASH_SM_SBM_SECTOR_638, WFLASH_SM_SBM_SECTOR_639, WFLASH_SM_SBM_SECTOR_640, WFLASH_SM_SBM_SECTOR_641, WFLASH_SM_SBM_SECTOR_642, WFLASH_SM_SBM_SECTOR_643, WFLASH_SM_SBM_SECTOR_644, WFLASH_SM_SBM_SECTOR_645, WFLASH_SM_SBM_SECTOR_646, WFLASH_SM_SBM_SECTOR_647, WFLASH_SM_SBM_SECTOR_648, WFLASH_SM_SBM_SECTOR_649, WFLASH_SM_SBM_SECTOR_650, WFLASH_SM_SBM_SECTOR_651, WFLASH_SM_SBM_SECTOR_652, WFLASH_SM_SBM_SECTOR_653, WFLASH_SM_SBM_SECTOR_654, WFLASH_SM_SBM_SECTOR_655, WFLASH_SM_SBM_SECTOR_656, WFLASH_SM_SBM_SECTOR_657, WFLASH_SM_SBM_SECTOR_658, WFLASH_SM_SBM_SECTOR_659, WFLASH_SM_SBM_SECTOR_660, WFLASH_SM_SBM_SECTOR_661, WFLASH_SM_SBM_SECTOR_662, WFLASH_SM_SBM_SECTOR_663, WFLASH_SM_SBM_SECTOR_664, WFLASH_SM_SBM_SECTOR_665, WFLASH_SM_SBM_SECTOR_666, WFLASH_SM_SBM_SECTOR_667, WFLASH_SM_SBM_SECTOR_668, WFLASH_SM_SBM_SECTOR_669, WFLASH_SM_SBM_SECTOR_670, WFLASH_SM_SBM_SECTOR_671, WFLASH_SM_SBM_SECTOR_672, WFLASH_SM_SBM_SECTOR_673, WFLASH_SM_SBM_SECTOR_674, WFLASH_SM_SBM_SECTOR_675, WFLASH_SM_SBM_SECTOR_676, WFLASH_SM_SBM_SECTOR_677, WFLASH_SM_SBM_SECTOR_678, WFLASH_SM_SBM_SECTOR_679, WFLASH_SM_SBM_SECTOR_680, WFLASH_SM_SBM_SECTOR_681, WFLASH_SM_SBM_SECTOR_682, WFLASH_SM_SBM_SECTOR_683, WFLASH_SM_SBM_SECTOR_684, WFLASH_SM_SBM_SECTOR_685, WFLASH_SM_SBM_SECTOR_686, WFLASH_SM_SBM_SECTOR_687, WFLASH_SM_SBM_SECTOR_688, WFLASH_SM_SBM_SECTOR_689, WFLASH_SM_SBM_SECTOR_690, WFLASH_SM_SBM_SECTOR_691, WFLASH_SM_SBM_SECTOR_692, WFLASH_SM_SBM_SECTOR_693, WFLASH_SM_SBM_SECTOR_694, WFLASH_SM_SBM_SECTOR_695, WFLASH_SM_SBM_SECTOR_696, WFLASH_SM_SBM_SECTOR_697, WFLASH_SM_SBM_SECTOR_698, WFLASH_SM_SBM_SECTOR_699, WFLASH_SM_SBM_SECTOR_700, WFLASH_SM_SBM_SECTOR_701, WFLASH_SM_SBM_SECTOR_702, WFLASH_SM_SBM_SECTOR_703, WFLASH_SM_SBM_SECTOR_704, WFLASH_SM_SBM_SECTOR_705, WFLASH_SM_SBM_SECTOR_706, WFLASH_SM_SBM_SECTOR_707, WFLASH_SM_SBM_SECTOR_708, WFLASH_SM_SBM_SECTOR_709, WFLASH_SM_SBM_SECTOR_710, WFLASH_SM_SBM_SECTOR_711, WFLASH_SM_SBM_SECTOR_712, WFLASH_SM_SBM_SECTOR_713, WFLASH_SM_SBM_SECTOR_714, WFLASH_SM_SBM_SECTOR_715, WFLASH_SM_SBM_SECTOR_716, WFLASH_SM_SBM_SECTOR_717, WFLASH_SM_SBM_SECTOR_718, WFLASH_SM_SBM_SECTOR_719, WFLASH_SM_SBM_SECTOR_720, WFLASH_SM_SBM_SECTOR_721, WFLASH_SM_SBM_SECTOR_722, WFLASH_SM_SBM_SECTOR_723, WFLASH_SM_SBM_SECTOR_724, WFLASH_SM_SBM_SECTOR_725, WFLASH_SM_SBM_SECTOR_726, WFLASH_SM_SBM_SECTOR_727, WFLASH_SM_SBM_SECTOR_728, WFLASH_SM_SBM_SECTOR_729, WFLASH_SM_SBM_SECTOR_730, WFLASH_SM_SBM_SECTOR_731, WFLASH_SM_SBM_SECTOR_732, WFLASH_SM_SBM_SECTOR_733, WFLASH_SM_SBM_SECTOR_734, WFLASH_SM_SBM_SECTOR_735, WFLASH_SM_SBM_SECTOR_736, WFLASH_SM_SBM_SECTOR_737, WFLASH_SM_SBM_SECTOR_738, WFLASH_SM_SBM_SECTOR_739, WFLASH_SM_SBM_SECTOR_740, WFLASH_SM_SBM_SECTOR_741, WFLASH_SM_SBM_SECTOR_742, WFLASH_SM_SBM_SECTOR_743, WFLASH_SM_SBM_SECTOR_744, WFLASH_SM_SBM_SECTOR_745, WFLASH_SM_SBM_SECTOR_746, WFLASH_SM_SBM_SECTOR_747, WFLASH_SM_SBM_SECTOR_748, WFLASH_SM_SBM_SECTOR_749, WFLASH_SM_SBM_SECTOR_750, WFLASH_SM_SBM_SECTOR_751, WFLASH_SM_SBM_SECTOR_752, WFLASH_SM_SBM_SECTOR_753, WFLASH_SM_SBM_SECTOR_754, WFLASH_SM_SBM_SECTOR_755, WFLASH_SM_SBM_SECTOR_756, WFLASH_SM_SBM_SECTOR_757, WFLASH_SM_SBM_SECTOR_758, WFLASH_SM_SBM_SECTOR_759, WFLASH_SM_SBM_SECTOR_760, WFLASH_SM_SBM_SECTOR_761, WFLASH_SM_SBM_SECTOR_762, WFLASH_SM_SBM_SECTOR_763, WFLASH_SM_SBM_SECTOR_764, WFLASH_SM_SBM_SECTOR_765, WFLASH_SM_SBM_SECTOR_766, WFLASH_SM_SBM_SECTOR_767, WFLASH_SM_SBM_SECTOR_768, WFLASH_SM_SBM_SECTOR_769, WFLASH_SM_SBM_SECTOR_770, WFLASH_SM_SBM_SECTOR_771, WFLASH_SM_SBM_SECTOR_772, WFLASH_SM_SBM_SECTOR_773, WFLASH_SM_SBM_SECTOR_774, WFLASH_SM_SBM_SECTOR_775, WFLASH_SM_SBM_SECTOR_776, WFLASH_SM_SBM_SECTOR_777, WFLASH_SM_SBM_SECTOR_778, WFLASH_SM_SBM_SECTOR_779, WFLASH_SM_SBM_SECTOR_780, WFLASH_SM_SBM_SECTOR_781, WFLASH_SM_SBM_SECTOR_782, WFLASH_SM_SBM_SECTOR_783, WFLASH_SM_SBM_SECTOR_784, WFLASH_SM_SBM_SECTOR_785, WFLASH_SM_SBM_SECTOR_786, WFLASH_SM_SBM_SECTOR_787, WFLASH_SM_SBM_SECTOR_788, WFLASH_SM_SBM_SECTOR_789, WFLASH_SM_SBM_SECTOR_790, WFLASH_SM_SBM_SECTOR_791, WFLASH_SM_SBM_SECTOR_792, WFLASH_SM_SBM_SECTOR_793, WFLASH_SM_SBM_SECTOR_794, WFLASH_SM_SBM_SECTOR_795, WFLASH_SM_SBM_SECTOR_796, WFLASH_SM_SBM_SECTOR_797, WFLASH_SM_SBM_SECTOR_798, WFLASH_SM_SBM_SECTOR_799, WFLASH_SM_SBM_SECTOR_800, WFLASH_SM_SBM_SECTOR_801, WFLASH_SM_SBM_SECTOR_802, WFLASH_SM_SBM_SECTOR_803, WFLASH_SM_SBM_SECTOR_804, WFLASH_SM_SBM_SECTOR_805, WFLASH_SM_SBM_SECTOR_806, WFLASH_SM_SBM_SECTOR_807, WFLASH_SM_SBM_SECTOR_808, WFLASH_SM_SBM_SECTOR_809, WFLASH_SM_SBM_SECTOR_810, WFLASH_SM_SBM_SECTOR_811, WFLASH_SM_SBM_SECTOR_812, WFLASH_SM_SBM_SECTOR_813, WFLASH_SM_SBM_SECTOR_814, WFLASH_SM_SBM_SECTOR_815, WFLASH_SM_SBM_SECTOR_816, WFLASH_SM_SBM_SECTOR_817, WFLASH_SM_SBM_SECTOR_818, WFLASH_SM_SBM_SECTOR_819, WFLASH_SM_SBM_SECTOR_820, WFLASH_SM_SBM_SECTOR_821, WFLASH_SM_SBM_SECTOR_822, WFLASH_SM_SBM_SECTOR_823, WFLASH_SM_SBM_SECTOR_824, WFLASH_SM_SBM_SECTOR_825, WFLASH_SM_SBM_SECTOR_826, WFLASH_SM_SBM_SECTOR_827, WFLASH_SM_SBM_SECTOR_828, WFLASH_SM_SBM_SECTOR_829, WFLASH_SM_SBM_SECTOR_830, WFLASH_SM_SBM_SECTOR_831, WFLASH_SM_SBM_SECTOR_832, WFLASH_SM_SBM_SECTOR_833, WFLASH_SM_SBM_SECTOR_834, WFLASH_SM_SBM_SECTOR_835, WFLASH_SM_SBM_SECTOR_836, WFLASH_SM_SBM_SECTOR_837, WFLASH_SM_SBM_SECTOR_838, WFLASH_SM_SBM_SECTOR_839, WFLASH_SM_SBM_SECTOR_840, WFLASH_SM_SBM_SECTOR_841, WFLASH_SM_SBM_SECTOR_842, WFLASH_SM_SBM_SECTOR_843, WFLASH_SM_SBM_SECTOR_844, WFLASH_SM_SBM_SECTOR_845, WFLASH_SM_SBM_SECTOR_846, WFLASH_SM_SBM_SECTOR_847, WFLASH_SM_SBM_SECTOR_848, WFLASH_SM_SBM_SECTOR_849, WFLASH_SM_SBM_SECTOR_850, WFLASH_SM_SBM_SECTOR_851, WFLASH_SM_SBM_SECTOR_852, WFLASH_SM_SBM_SECTOR_853, WFLASH_SM_SBM_SECTOR_854, WFLASH_SM_SBM_SECTOR_855, WFLASH_SM_SBM_SECTOR_856, WFLASH_SM_SBM_SECTOR_857, WFLASH_SM_SBM_SECTOR_858, WFLASH_SM_SBM_SECTOR_859, WFLASH_SM_SBM_SECTOR_860, WFLASH_SM_SBM_SECTOR_861, WFLASH_SM_SBM_SECTOR_862, WFLASH_SM_SBM_SECTOR_863, WFLASH_SM_SBM_SECTOR_864, WFLASH_SM_SBM_SECTOR_865, WFLASH_SM_SBM_SECTOR_866, WFLASH_SM_SBM_SECTOR_867, WFLASH_SM_SBM_SECTOR_868, WFLASH_SM_SBM_SECTOR_869, WFLASH_SM_SBM_SECTOR_870, WFLASH_SM_SBM_SECTOR_871, WFLASH_SM_SBM_SECTOR_872, WFLASH_SM_SBM_SECTOR_873, WFLASH_SM_SBM_SECTOR_874, WFLASH_SM_SBM_SECTOR_875, WFLASH_SM_SBM_SECTOR_876, WFLASH_SM_SBM_SECTOR_877, WFLASH_SM_SBM_SECTOR_878, WFLASH_SM_SBM_SECTOR_879, WFLASH_SM_SBM_SECTOR_880, WFLASH_SM_SBM_SECTOR_881, WFLASH_SM_SBM_SECTOR_882, WFLASH_SM_SBM_SECTOR_883, WFLASH_SM_SBM_SECTOR_884, WFLASH_SM_SBM_SECTOR_885, WFLASH_SM_SBM_SECTOR_886, WFLASH_SM_SBM_SECTOR_887, WFLASH_SM_SBM_SECTOR_888, WFLASH_SM_SBM_SECTOR_889, WFLASH_SM_SBM_SECTOR_890, WFLASH_SM_SBM_SECTOR_891, WFLASH_SM_SBM_SECTOR_892, WFLASH_SM_SBM_SECTOR_893, WFLASH_SM_SBM_SECTOR_894, WFLASH_SM_SBM_SECTOR_895, WFLASH_SM_SBM_SECTOR_896, WFLASH_SM_SBM_SECTOR_897, WFLASH_SM_SBM_SECTOR_898, WFLASH_SM_SBM_SECTOR_899, WFLASH_SM_SBM_SECTOR_900, WFLASH_SM_SBM_SECTOR_901, WFLASH_SM_SBM_SECTOR_902, WFLASH_SM_SBM_SECTOR_903, WFLASH_SM_SBM_SECTOR_904, WFLASH_SM_SBM_SECTOR_905, WFLASH_SM_SBM_SECTOR_906, WFLASH_SM_SBM_SECTOR_907, WFLASH_SM_SBM_SECTOR_908, WFLASH_SM_SBM_SECTOR_909, WFLASH_SM_SBM_SECTOR_910, WFLASH_SM_SBM_SECTOR_911, WFLASH_SM_SBM_SECTOR_912, WFLASH_SM_SBM_SECTOR_913, WFLASH_SM_SBM_SECTOR_914, WFLASH_SM_SBM_SECTOR_915, WFLASH_SM_SBM_SECTOR_916, WFLASH_SM_SBM_SECTOR_917, WFLASH_SM_SBM_SECTOR_918, WFLASH_SM_SBM_SECTOR_919, WFLASH_SM_SBM_SECTOR_920, WFLASH_SM_SBM_SECTOR_921, WFLASH_SM_SBM_SECTOR_922, WFLASH_SM_SBM_SECTOR_923, WFLASH_SM_SBM_SECTOR_924, WFLASH_SM_SBM_SECTOR_925, WFLASH_SM_SBM_SECTOR_926, WFLASH_SM_SBM_SECTOR_927, WFLASH_SM_SBM_SECTOR_928, WFLASH_SM_SBM_SECTOR_929, WFLASH_SM_SBM_SECTOR_930, WFLASH_SM_SBM_SECTOR_931, WFLASH_SM_SBM_SECTOR_932, WFLASH_SM_SBM_SECTOR_933, WFLASH_SM_SBM_SECTOR_934, WFLASH_SM_SBM_SECTOR_935, WFLASH_SM_SBM_SECTOR_936, WFLASH_SM_SBM_SECTOR_937, WFLASH_SM_SBM_SECTOR_938, WFLASH_SM_SBM_SECTOR_939, WFLASH_SM_SBM_SECTOR_940, WFLASH_SM_SBM_SECTOR_941, WFLASH_SM_SBM_SECTOR_942, WFLASH_SM_SBM_SECTOR_943, WFLASH_SM_SBM_SECTOR_944, WFLASH_SM_SBM_SECTOR_945, WFLASH_SM_SBM_SECTOR_946, WFLASH_SM_SBM_SECTOR_947, WFLASH_SM_SBM_SECTOR_948, WFLASH_SM_SBM_SECTOR_949, WFLASH_SM_SBM_SECTOR_950, WFLASH_SM_SBM_SECTOR_951, WFLASH_SM_SBM_SECTOR_952, WFLASH_SM_SBM_SECTOR_953, WFLASH_SM_SBM_SECTOR_954, WFLASH_SM_SBM_SECTOR_955, WFLASH_SM_SBM_SECTOR_956, WFLASH_SM_SBM_SECTOR_957, WFLASH_SM_SBM_SECTOR_958, WFLASH_SM_SBM_SECTOR_959, WFLASH_SM_SBM_SECTOR_960, WFLASH_SM_SBM_SECTOR_961, WFLASH_SM_SBM_SECTOR_962, WFLASH_SM_SBM_SECTOR_963, WFLASH_SM_SBM_SECTOR_964, WFLASH_SM_SBM_SECTOR_965, WFLASH_SM_SBM_SECTOR_966, WFLASH_SM_SBM_SECTOR_967, WFLASH_SM_SBM_SECTOR_968, WFLASH_SM_SBM_SECTOR_969, WFLASH_SM_SBM_SECTOR_970, WFLASH_SM_SBM_SECTOR_971, WFLASH_SM_SBM_SECTOR_972, WFLASH_SM_SBM_SECTOR_973, WFLASH_SM_SBM_SECTOR_974, WFLASH_SM_SBM_SECTOR_975, WFLASH_SM_SBM_SECTOR_976, WFLASH_SM_SBM_SECTOR_977, WFLASH_SM_SBM_SECTOR_978, WFLASH_SM_SBM_SECTOR_979, WFLASH_SM_SBM_SECTOR_980, WFLASH_SM_SBM_SECTOR_981, WFLASH_SM_SBM_SECTOR_982, WFLASH_SM_SBM_SECTOR_983, WFLASH_SM_SBM_SECTOR_984, WFLASH_SM_SBM_SECTOR_985, WFLASH_SM_SBM_SECTOR_986, WFLASH_SM_SBM_SECTOR_987, WFLASH_SM_SBM_SECTOR_988, WFLASH_SM_SBM_SECTOR_989, WFLASH_SM_SBM_SECTOR_990, WFLASH_SM_SBM_SECTOR_991, WFLASH_SM_SBM_SECTOR_992, WFLASH_SM_SBM_SECTOR_993, WFLASH_SM_SBM_SECTOR_994, WFLASH_SM_SBM_SECTOR_995, WFLASH_SM_SBM_SECTOR_996, WFLASH_SM_SBM_SECTOR_997, WFLASH_SM_SBM_SECTOR_998, WFLASH_SM_SBM_SECTOR_999, WFLASH_SM_SBM_SECTOR_1000, WFLASH_SM_SBM_SECTOR_1001, WFLASH_SM_SBM_SECTOR_1002, WFLASH_SM_SBM_SECTOR_1003, WFLASH_SM_SBM_SECTOR_1004, WFLASH_SM_SBM_SECTOR_1005, WFLASH_SM_SBM_SECTOR_1006, WFLASH_SM_SBM_SECTOR_1007, WFLASH_SM_SBM_SECTOR_1008, WFLASH_SM_SBM_SECTOR_1009, WFLASH_SM_SBM_SECTOR_1010, WFLASH_SM_SBM_SECTOR_1011, WFLASH_SM_SBM_SECTOR_1012, WFLASH_SM_SBM_SECTOR_1013, WFLASH_SM_SBM_SECTOR_1014, WFLASH_SM_SBM_SECTOR_1015, WFLASH_SM_SBM_SECTOR_1016, WFLASH_SM_SBM_SECTOR_1017, WFLASH_SM_SBM_SECTOR_1018, WFLASH_SM_SBM_SECTOR_1019, WFLASH_SM_SBM_SECTOR_1020, WFLASH_SM_SBM_SECTOR_1021, WFLASH_SM_SBM_SECTOR_1022, WFLASH_SM_SBM_SECTOR_1023}, origin=Cypress, set at post-build in variant post-build / pre-compile in variant pre-compile, default-value=WFLASH_LG_SBM_SECTOR_0  # Unique identifier of the sector. This entry will be used for automatic calculation and checking of all other sector parameter. Implementation Type: None.
          integer FlsNumberOfSectors: 1..65534, set at post-build in variant post-build / pre-compile in variant pre-compile, default-value=1  # Number of continuous sectors with identical values for FlsSectorSize and FlsPageSize. The parameter FlsSectorStartAddress denotes the start address of the first sector.
          integer FlsPageSize: 4..4, set at post-build in variant post-build / pre-compile in variant pre-compile, default-value=4  # Size of one page of this sector. Implementation Type: Fls_LengthType.
          integer FlsSectorSize: 128..2048, set at post-build in variant post-build / pre-compile in variant pre-compile, default-value=2048  # Size of this sector. Implementation Type: Fls_LengthType.
          integer FlsSectorStartaddress: 0..4294967295, set at post-build in variant post-build / pre-compile in variant pre-compile, default-value=0  # Start address of this sector. Implementation Type: Fls_AddressType.
    container FlsGeneral  # Container for general parameters of the flash driver. These parameters are always pre-compile.
      boolean FlsAcLoadOnJobStart: set at pre-compile, default-value=false  # The flash driver shall load the flash access code to RAM whenever an erase or write job is started and unload (overwrite) it after that job has been finished or canceled. true: Flash access code loaded on job start / unloaded on job end or error. false: Flash access code not loaded to / unloaded from RAM at all.
      integer FlsBaseAddress: 0..0, set at pre-compile, default-value=0  # The flash memory start address (see also SWS_Fls_00208 and SWS_Fls_00209). This parameter defines the lower boundary for read / write / erase / compare and blank check jobs.
      boolean FlsBlankCheckApi: set at pre-compile, default-value=false  # Compile switch to enable and disable the Fls_BlankCheck function. true: API supported / function provided. false: API not supported / function not provided.
      boolean FlsCancelApi: set at pre-compile, default-value=true  # Compile switch to enable and disable the Fls_Cancel function. true: API supported / function provided. false: API not supported / function not provided.
      boolean FlsCompareApi: set at pre-compile, default-value=true  # Compile switch to enable and disable the Fls_Compare function. true: API supported / function provided. false: API not supported / function not provided.
      boolean FlsDevErrorDetect: set at pre-compile, default-value=true  # Switches the Default Error Tracer (Det) detection and notification ON or OFF. true: enabled (ON). false: disabled (OFF).
      integer FlsDriverIndex: 0..254, scope=ECU, set at pre-compile, symbolic-name-value=true, default-value=0  # Index of the driver, used by Fee(Flash EEPROM Emulation).
      boolean FlsGetJobResultApi: set at pre-compile, default-value=true  # Compile switch to enable and disable the Fls_GetJobResult function. true: API supported / function provided. false: API not supported / function not provided.
      boolean FlsGetStatusApi: set at pre-compile, default-value=true  # Compile switch to enable and disable the Fls_GetStatus function. true: API supported / function provided. false: API not supported / function not provided.
      boolean FlsRuntimeErrorDetect: origin=Cypress, set at pre-compile, default-value=true  # Switches the runtime errors detection and notification ON or OFF. true: enabled (ON). false: disabled (OFF).
      boolean FlsSetModeApi: set at pre-compile, default-value=true  # Compile switch to enable and disable the Fls_SetMode function. true: API supported / function provided. false: API not supported / function not provided.
      integer FlsTotalSize: 0..4294967295, set at pre-compile, default-value=262144  # The total amount of flash memory in bytes (see also SWS_Fls_00208 and SWS_Fls_00209). This parameter in conjunction with FLS_BASE_ADDRESS defines the upper boundary for read / write / erase / compare and blank check jobs.
      boolean FlsUseInterrupts: set at pre-compile, default-value=false  # Job processing triggered by hardware interrupt (only available if supported by underlying flash hardware). true: Job processing triggered by interrupt (hardware controlled). false: Job processing not triggered by interrupt (software controlled).
      boolean FlsVersionInfoApi: set at pre-compile, default-value=true  # Pre-processor switch to enable / disable the API to read out the modules version information. true: Version info API enabled. false: Version info API disabled.
      function name FlsErrorCalloutFunction: origin=Cypress, set at pre-compile, default-value=ErrorCalloutHandler  # Error callout function. Syntax: void ErrorCalloutHandler (uint16 ModuleId, uint8 InstanceId, uint8 ApiId, uint8 ErrorId) The error callout function is called on every error. The ASIL level of this function limits the ASIL level of the Fls driver.
      string FlsIncludeFile [0..*]: multiplicity set at pre-compile, origin=Cypress, set at pre-compile, default-value=ErrorCalloutHandler.h  # A file that shall be included by Fls_Cfg.h. Any application specific symbol that is used by the Fls configuration (e.g. Error callout function) should be included by configuring this parameter.
      boolean FlsEraseVerification: origin=Cypress, set at pre-compile, default-value=true  # Pre-processor switch to enable / disable the erase verification (blank check) after a flash block has been erased. true: The verification enabled. false: The verification disabled.
      boolean FlsBeforeWriteVerification: origin=Cypress, set at pre-compile, default-value=true  # Pre-processor switch to enable / disable the verification (blank check) before writing a flash block. true: The verification enabled. false: The verification disabled.
      boolean FlsWriteVerification: origin=Cypress, set at pre-compile, default-value=true  # Pre-processor switch to enable / disable the write verification (compare) after writing a flash block. true: The verification enabled. false: The verification disabled.
      function name FlsEraseCalloutFunction [0..1]: multiplicity set at pre-compile, origin=Cypress, set at pre-compile, default-value=EraseCalloutHandler  # Erase callout function. Syntax: void EraseCalloutHandler (Fls_AddressType TargetAddress) The erase callout function is called after an erase request is accepted.
      boolean FlsReadImmediateApi: origin=Cypress, set at pre-compile, default-value=false  # Compile switch to enable and disable the Fls_ReadImmediate function. true: API supported / function provided. false: API not supported / function not provided.
      boolean FlsSuspendResumeApi: origin=Cypress, set at pre-compile, default-value=false  # Compile switch to enable and disable the Fls_Suspend / Fls_Resume function. true: API supported / function provided. false: API not supported / function not provided.
      boolean FlsSetCycleModeApi: origin=Cypress, set at pre-compile, default-value=false  # Compile switch to enable and disable the Fls_SetCycleMode function. true: API supported / function provided. false: API not supported / function not provided.
      integer FlsDmaChannel: 0..7, origin=Cypress, set at pre-compile, default-value=0  # DMA channel (No.) for reading from work flash.
      integer FlsAuxiliaryBufferSize: 4..2048, origin=Cypress, set at pre-compile, default-value=128  # The size of auxiliary buffer that stores data which is read from work flash by DMA transfer at a time on verifying, comparing or immediate reading process.
      enumeration FlsSetFlashCtlRegister: {FLS_FLASH_CTL_WORKONLY, FLS_FLASH_CTL_USERVALUE, FLS_FLASH_CTL_NOTSET}, origin=Cypress, set at pre-compile, default-value=FLS_FLASH_CTL_WORKONLY  # This parameter is used for selecting which bit fields of FLASH_CTL register are set by the flash driver.
      integer FlsUserValueForFlashCtlRegister: 0..4294967295, origin=Cypress, set at pre-compile, default-value=22085632  # A value for FLASH_CTL register that is set by user when FlsSetFlashCtlRegister is FLS_FLASH_CTL_USERVALUE.
      boolean FlsSetWorkFlashSafetyRegister: origin=Cypress, set at pre-compile, default-value=true  # This parameter is used for selecting whether WORK_FLASH_SAFETY register is set by the flash driver. true: flash driver sets the WORK_FLASH_SAFETY register. false: flash driver does not set the WORK_FLASH_SAFETY register.
      boolean FlsSetWorkFlashFaultMaskRegister: origin=Cypress, set at pre-compile, default-value=true  # This parameter is used for selecting whether FAULT_STRUCT_MASK register regarding work flash is set by the flash driver. true: flash driver sets the FAULT_STRUCT_MASK register regarding work flash. false: flash driver does not set the FAULT_STRUCT_MASK register regarding work flash.
      boolean FlsDefineWdgClear: origin=Cypress, set at pre-compile, default-value=true  # This parameter is used for selecting whether the function Fls_WdgClear (empty function) to clear the watchdog timer is defined by the flash driver. true: flash driver defines the function Fls_WdgClear. false: flash driver does not define the function Fls_WdgClear.
      boolean FlsUseNonBlockingWrite: origin=Cypress, set at pre-compile, default-value=false  # This parameter is used for selecting whether writing to work flash is performed with non-blocking mode by the flash driver. true: flash driver performs writing with non-blocking mode. false: flash driver performs writing with blocking mode.
      boolean FlsUseDmaForRead: origin=Cypress, set at pre-compile, default-value=true  # This parameter is used for selecting whether reading from work flash is performed by DMA transfer. true: flash driver performs reading with DMA transfer. false: flash driver performs reading without DMA transfer (with CPU transfer).
      boolean FlsReportErrorIfNotBlank: origin=Cypress, set at pre-compile, default-value=true  # This parameter is used for selecting whether error callout functions are called when a blank check job detects non-blank. true: flash driver calls the error callout functions when a blank check job detects non-blank. false: flash driver does not call the error callout functions when a blank check job detects non-blank.
      boolean FlsUseSafetyMechanism: origin=Cypress, set at pre-compile, default-value=false  # Compile switch to enable and disable eCT Flash safety mechanism for write / erase. true: eCT Flash safety mechanism is provided. false: eCT Flash safety mechanism is not provided.
      boolean FlsHsmPresent: origin=Cypress, set at pre-compile, default-value=false  # This parameter indicates whether the HSM (Hardware Security Module) is present. true: HSM is present. false: HSM is not present.
      integer FlsIpcStructure: 0..15, origin=Cypress, set at pre-compile, default-value=7  # IPC structure (No.) used for eCT Flash safety mechanism.
      integer FlsIpcInterruptStructure: 0..15, origin=Cypress, set at pre-compile, default-value=7  # IPC interrupt structure (No.) used for eCT Flash safety mechanism.
      function name FlsWorkEmbeddedNotification: origin=Cypress, set at pre-compile, default-value=WorkEmbeddedNotification  # Work flash embedded notification routine. Syntax: void WorkEmbeddedNotification (void) The notification routine is called after flash embedded (program or erase) operation.
      float FlsArbitrationTimeout: 0.0..60.0, origin=Cypress, set at pre-compile, default-value=0.2  # Tolerant Time for arbitration in (waiting for) finish of flash operation that was started from another core, typically maximum time for erase of one flash sector. This value is given in seconds.
      function name FlsSystemcallCalloutFunction: origin=Cypress, set at pre-compile, default-value=SystemcallCalloutFunction  # Callout function for invocation of system-call in upper layer. Syntax: Std_ReturnType SystemcallCalloutFunction (uint32 *Fls_IpcContext) The callout function is called whenever the flash driver calls the system-call.
      integer FlsFaultStructure: 0..3, origin=Cypress, set at pre-compile, default-value=0  # Fault structure (No.) used for reporting.
    container FlsPublishedInformation  # Additional published parameters not covered by CommonPublishedInformation container. Note that these parameters do not have any configuration class setting, since they are published information.
      integer FlsAcLocationErase: 0..0, set at published-information, default-value=0  # Position in RAM, to which the erase flash access code has to be loaded. Only relevant if the erase flash access code is not position independent. If this information is not provided it is assumed that the erase flash access code is position independent and that therefore the RAM position can be freely configured.
      integer FlsAcLocationWrite: 0..0, set at published-information, default-value=0  # Position in RAM, to which the write flash access code has to be loaded. Only relevant if the write flash access code is not position independent. If this information is not provided it is assumed that the write flash access code is position independent and that therefore the RAM position can be freely configured.
      integer FlsAcSizeErase: 0..0, set at published-information, default-value=0  # Number of bytes in RAM needed for the erase flash access code.
      integer FlsAcSizeWrite: 0..0, set at published-information, default-value=0  # Number of bytes in RAM needed for the write flash access code.
      float FlsEraseTime: 0.16..0.16, set at published-information, default-value=0.16  # Maximum time to erase one complete flash sector in seconds (in all supported derivatives).
      integer FlsErasedValue: 4294967295..4294967295, set at published-information, default-value=4294967295  # The contents of an erased flash memory cell.
      string FlsExpectedHwId: set at published-information, default-value=Traveo  # Unique identifier of the hardware device that is expected by this driver (the device for which this driver has been implemented). Only relevant for external flash drivers.
      integer FlsSpecifiedEraseCycles: 250000..250000, set at published-information, default-value=250000  # Number of erase cycles specified for the flash device (usually given in the device data sheet). If the number of specified erase cycles depends on the operating environment (temperature, voltage, ...) during reprogramming of the flash device, the minimum number for which a data retention of at least 15 years over the temperature range from -40C .. +125C can be guaranteed shall be given. Note: If there are different numbers of specified erase cycles for different flash sectors of the device this parameter has to be extended to a parameter list (similar to the sector list above).
      float FlsWriteTime: 0.001..0.001, set at published-information, default-value=0.001  # Maximum time to program one complete flash page in seconds.
